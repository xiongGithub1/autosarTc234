AUTOSAR XML (schema 4-0-3)
package /MICROSAR
  module config Ea_Rec: definition=Ea, implementation-config-variant=VARIANT-PRE-COMPILE
