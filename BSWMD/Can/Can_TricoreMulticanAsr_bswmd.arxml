AUTOSAR XML (schema 4-0-3)
# COPYRIGHT
# Copyright (c) 2017 by Vector Informatik GmbH. All rights reserved.
# This software is copyright protected and proprietary to Vector Informatik GmbH.
# Vector Informatik GmbH grants to you only those rights as set out in the license conditions.
package /MICROSAR/Can_TricoreMultican
  bsw implementation Can_Impl: programming-language=C, sw-version=3.15.00, used-code-generator=DaVinci Configurator, vendor-id=30, ar-release-version=4.00.03, behavior=Can_TricoreMultican_Behavior, preconfigured-configuration=Can_Pre, recommended-configuration=Can_Rec, vendor-specific-module-def=Can
  module definition Can [0..*]: category=VENDOR_SPECIFIC_MODULE_DEFINITION, refined-module-def=Can, variants pre-compile/link-time/post-build-loadable/post-build-selectable  # This container holds the configuration of a single CAN Driver.
    container CanConfigSet  # This is the multiple configuration set container for CAN Driver.
      container CanController [0..*]  # This container contains the configuration parameters of the CAN controller(s).
        enumeration CanBusoffProcessing: {INTERRUPT, POLLING}, set at pre-compile, default-value=INTERRUPT  # Define the context in which the Busoff will be processed. INTERRUPT: Busoff handling is done in interrupt context by Busoff event. POLLING: Busoff is handled in Function Can_MainFunction_BusOff(). This function has to be called cyclic.
        boolean CanControllerActivation: set at link in variant link-time+post-build-loadable / post-build in variant post-build-selectable / pre-compile in variant pre-compile, default-value=true  # Defines if a CAN controller is used in the configuration.
        integer CanControllerBaseAddress: 0..4294967295, set at link in variant link-time+post-build-loadable / post-build in variant post-build-selectable / pre-compile in variant pre-compile, default-value=0  # Specifies the CAN controller base address.
        integer CanControllerId: 0..255, set at pre-compile, symbolic-name-value=true, default-value=0  # This parameter provides the controller ID which is unique in a given CAN Driver. The value for this parameter starts with 0 and continue without any gaps.
        enumeration CanRxProcessing: {INTERRUPT, POLLING}, set at pre-compile, default-value=INTERRUPT  # Define the context in which the PDU reception will be processed. INTERRUPT: Reception handling is done in interrupt context by event. POLLING: Reception is handled in Function Can_MainFunction_Read(). This function has to be called cyclic.
        enumeration CanTxProcessing: {INTERRUPT, POLLING}, set at pre-compile, default-value=INTERRUPT  # Define the context in which the PDU transmission confirmation will be processed. INTERRUPT: Transmission confirmation handling is done in interrupt context by event. POLLING: Transmission confirmation is handled in Function Can_MainFunction_Write(). This function has to be called cyclic.
        enumeration CanWakeupProcessing: {INTERRUPT, POLLING}, set at pre-compile, default-value=INTERRUPT  # Define the context in which the wakeup event will be processed. INTERRUPT: Wakeup handling is done in interrupt context by event. POLLING: Wakeup is handled in Function Can_MainFunction_Wakeup(). This function has to be called cyclic. RESTRICTIONS: 'CanWakeupProcessing' is only available, if hardware supports this by mean wakeup detection by bus event.
        boolean CanWakeupSupport: set at link in variant link-time+post-build-loadable / post-build in variant post-build-selectable / pre-compile in variant pre-compile, default-value=false  # CAN driver support wakeup over CAN Bus. RESTRICTIONS: 'CanWakeupSupport' is only available when Hardware supports Wakeup over Bus.
        integer CanWakeupSourceId: 0..65535, set at link in variant link-time+post-build-loadable / post-build in variant post-build-selectable / pre-compile in variant pre-compile, origin=Vector Informatik, default-value=0  # Wakeup Source ID given by EcuM RESTRICTIONS: 'CanWakeupSourceId' is only used when no ECU State Manager Reference is available in the ECUC file. Otherwise the value is given by reference to EcuM in CanWakeupSourceRef.
        boolean CanCommonCAN [0..1]: set at pre-compile, origin=Vector Informatik, default-value=false  # Activate this parameter when you like to connect two physical CAN channels to one logical CAN Controller. This allow you to use more FullCAN objects for this Controller. Only Rx FullCAN objects can be configured on second physical channel. RESTRICTIONS: 'CanCommonCAN' is a project specific feature and may is not available/supported for every platform.
        enumeration CanPhysicalNode: set at link in variant link-time+post-build-loadable / post-build in variant post-build-selectable / pre-compile in variant pre-compile, origin=Vector Informatik, default-value=Node0  # This is the mapping between logical controller (Tool view) and physical CAN channel (IO pins).
          Node{0..7}  # MultiCAN Node{0..7}
          Node8_MultiCANR_Node0  # MultiCANR Node0
          Node9_MultiCANR_Node1  # MultiCANR Node1
          Node10_MultiCANR_Node2  # MultiCANR Node2
          Node11_MultiCANR_Node3  # MultiCANR Node3
          Node12_MultiCANR_Node4  # MultiCANR Node4
          Node13_MultiCANR_Node5  # MultiCANR Node5
          Node14_MultiCANR_Node6  # MultiCANR Node6
          Node15_MultiCANR_Node7  # MultiCANR Node7
        enumeration CanIOPort: {b_000, b_001, b_010, b_011, b_100, b_101, b_110, b_111}, set at link in variant link-time+post-build-loadable / post-build in variant post-build-selectable / pre-compile in variant pre-compile, origin=Vector Informatik, default-value=b_000  # Receive Input Selection | This is the value for NPCR.RXSEL which selects one out of 8 possible receive inputs. The CAN receive signal is performed only through the selected input.
        integer CanInterruptPriority: 0..255, set at link in variant link-time+post-build-loadable / post-build in variant post-build-selectable / pre-compile in variant pre-compile, origin=Vector Informatik, default-value=10  # Here you can set the CAN interrupt priority. This setting is irrelevant while using OSEK OS category 2 interrupts.
        integer CanSRC: 0..15, set at link in variant link-time+post-build-loadable / post-build in variant post-build-selectable / pre-compile in variant pre-compile, origin=Vector Informatik, default-value=0  # Used SRC | Used interrupt source control register (unique for each controller within one CAN cell)
        integer CanChannelCanObjectStartIndex: 0..512, set at link in variant link-time / post-build in variant post-build-loadable+post-build-selectable / pre-compile in variant pre-compile, origin=Vector Informatik, default-value=0  # Give the start index for used Mailboxed (no overlapping between controller shall occur check CanChannelCanObjectStartIndex and CanNumberOfCANObj)
        integer CanNumberOfCANObj: 0..256, set at link in variant link-time / post-build in variant post-build-loadable+post-build-selectable / pre-compile in variant pre-compile, origin=Vector Informatik, default-value=7  # Set number of used mailboxes, increase this to allow more FullCAN objects. The number includes normal, LowLevel and FullCAN transmit as well as all BasicCAN including shadow and FullCAN receive mailboxes.
        enumeration CanSrcTos: {CPU0, CPU1, CPU2}, set at pre-compile, origin=Vector Informatik, default-value=CPU0  # Type of Service Control | Set here the Type of Service Control to use for this controller, to select which CPU get the interrupt request. (only relevant for AURIX derivatives)
        integer CanInterruptGroupPriority: 0..7, set at link in variant link-time+post-build-loadable / post-build in variant post-build-selectable / pre-compile in variant pre-compile, origin=Vector Informatik, default-value=0  # XC2000 only Here you can set the CAN interrupt group priority. Value 0 is the lowest priority level. Value 7 is the highest priority level. All interrupt request sources enabled and programmed to the same priority level (ILVL) must always be programmed to different group priorities (GLVL). Otherwise an incorrect interrupt vector will be generated This setting is irrelevant while using OSEK OS category 2 interrupts.
        float CanClockFrequency [0..1]: 1..1000000000, set at link in variant link-time+post-build-loadable / post-build in variant post-build-selectable / pre-compile in variant pre-compile, origin=Vector Informatik, default-value=80000000  # This is the CAN frequency, used instead of CanCpuClockRef to McuClockReferencePoint container. It shall be given in Hz.
        reference CanControllerDefaultBaudrate: set at link in variant link-time / post-build in variant post-build-loadable+post-build-selectable / pre-compile in variant pre-compile, destination=CanControllerBaudrateConfig  # Reference to baudrate configuration container configured for the Can Controller as default.
        reference CanCpuClockRef: set at link in variant link-time+post-build-loadable / post-build in variant post-build-selectable / pre-compile in variant pre-compile, destination=McuClockReferencePoint  # Reference to the CPU clock configuration, which is set in the MCU driver configuration
        symbolic name reference CanWakeupSourceRef [0..1]: set at link in variant link-time+post-build-loadable / post-build in variant post-build-selectable / pre-compile in variant pre-compile, destination=EcuMWakeupSource  # Reference to the Wakeup Source for this controller as defined in the ECU State Manager. Implementation Type: reference to EcuM_WakeupSourceType RESTRICTIONS: 'CanWakeupSourceRef' is only used when an ECU State Manager Reference is available in the ECUC. Else use the parameter CanWakeupSourceId. | Implementation Type: reference to EcuM_WakeupSourceType
        foreign reference CanControllerSystemRef [0..1]: set at link in variant link-time+post-build-loadable / post-build in variant post-build-selectable / pre-compile in variant pre-compile, origin=Vector Informatik, destination-type=CAN-COMMUNICATION-CONTROLLER  # Reference to the CAN communication controller in the system extract. Used to get recommended baudrate settings.
        container CanControllerBaudrateConfig [0..3]: post-build-changeable=true  # This container contains bit timing related configuration parameters of the CAN controller(s). When connecting CANoe to your hardware, you have to use the same settings (CanControllerBaudRate, CanControllerSyncJumpWidth and the Sample point) in your hardware and CANoe.
          integer CanControllerBaudRate: 0..1000, set at link in variant link-time / post-build in variant post-build-loadable+post-build-selectable / pre-compile in variant pre-compile, default-value=500  # This value specifies the baudrate of the CAN controller in kbps.
          integer CanControllerBaudRateConfigID: 0..65535, set at link in variant link-time / post-build in variant post-build-loadable+post-build-selectable / pre-compile in variant pre-compile, origin=Vector Informatik, default-value=0  # Uniquely identifies a specific baud rate configuration. This ID is used by SetBaudrate API.
          integer CanControllerPropSeg: 1..62, set at link in variant link-time / post-build in variant post-build-loadable+post-build-selectable / pre-compile in variant pre-compile, default-value=2  # Specifies propagation delay in time quantas.
          integer CanControllerSeg1: 2..63, set at link in variant link-time / post-build in variant post-build-loadable+post-build-selectable / pre-compile in variant pre-compile, default-value=3  # Specifies phase segment 1 in time quantas.
          integer CanControllerSeg2: 2..32, set at link in variant link-time / post-build in variant post-build-loadable+post-build-selectable / pre-compile in variant pre-compile, default-value=2  # Specifies phase segment 2 in time quantas.
          integer CanControllerSyncJumpWidth: 1..16, set at link in variant link-time / post-build in variant post-build-loadable+post-build-selectable / pre-compile in variant pre-compile, default-value=1  # Specifies the synchronization jump width for the controller in time quantas.
          integer CanBaudrateClock: 1..1000000, set at link in variant link-time / post-build in variant post-build-loadable+post-build-selectable / pre-compile in variant pre-compile, origin=Vector Informatik, default-value=8000  # Quartz frequency in kHertz used for baudrate calculation RESTRICTIONS: The value is derived from CanCpuClockRef and may be modified by CAN cell prescalers.
          integer CanBaudratePrescaler: 1..64, set at link in variant link-time / post-build in variant post-build-loadable+post-build-selectable / pre-compile in variant pre-compile, origin=Vector Informatik, default-value=1  # baud rate prescaler to calculate time quantum out of CanBaudrateClock
          boolean CanBaudrateDiv8: set at link in variant link-time / post-build in variant post-build-loadable+post-build-selectable / pre-compile in variant pre-compile, origin=Vector Informatik, default-value=false  # Divide prescaler clock by 8. The divided clock is used to generate the nominal baudrate.
          container CanControllerFdBaudrateConfig [0..1]: post-build-changeable=true  # This optional container contains bit timing related configuration parameters of the CAN controller(s) for payload and CRC of a CAN FD frame. If this container exists the controller supports CAN FD frames.
            integer CanControllerFdBaudRate: 0..5000, set at link in variant link-time / post-build in variant post-build-loadable+post-build-selectable / pre-compile in variant pre-compile, origin=Vector Informatik, default-value=500  # Specifies the data segment baud rate of the CAN controller in kbps.
            integer CanControllerPropSeg: 1..14, set at link in variant link-time / post-build in variant post-build-loadable+post-build-selectable / pre-compile in variant pre-compile, origin=Vector Informatik, default-value=5  # Specifies propagation delay in time quantas.
            integer CanControllerSeg1: 2..15, set at link in variant link-time / post-build in variant post-build-loadable+post-build-selectable / pre-compile in variant pre-compile, origin=Vector Informatik, default-value=2  # Specifies phase segment 1 in time quantas.
            integer CanControllerSeg2: 2..8, set at link in variant link-time / post-build in variant post-build-loadable+post-build-selectable / pre-compile in variant pre-compile, origin=Vector Informatik, default-value=2  # Specifies phase segment 2 in time quantas.
            integer CanControllerSyncJumpWidth: 1..4, set at link in variant link-time / post-build in variant post-build-loadable+post-build-selectable / pre-compile in variant pre-compile, origin=Vector Informatik, default-value=1  # Specifies the synchronization jump width for the controller in time quantas.
            integer CanControllerTrcvDelayCompensationOffset [0..1]: 0..400, set at link in variant link-time / post-build in variant post-build-loadable+post-build-selectable / pre-compile in variant pre-compile, origin=Vector Informatik, default-value=0  # Specifies the Transceiver Delay Compensation Offset in ns. If not specified Transceiver Delay Compensation is disabled.
            boolean CanControllerTxBitRateSwitch: set at link in variant link-time / post-build in variant post-build-loadable+post-build-selectable / pre-compile in variant pre-compile, origin=Vector Informatik, default-value=true  # Specifies if the bit rate switching shall be used for transmissions. | If FALSE: CAN FD frames shall be sent without bit rate switching.
            integer CanBaudratePrescaler: 1..64, set at link in variant link-time / post-build in variant post-build-loadable+post-build-selectable / pre-compile in variant pre-compile, origin=Vector Informatik, default-value=6  # baud rate prescaler to calculate time quantum out of CanBaudrateClock
        container CanFilterMask [0..*]: post-build-changeable=true  # This container contains the configuration (parameters) of the CAN Filter Mask(s).
          integer CanFilterMaskValue: 0..4294967295, set at link in variant link-time / post-build in variant post-build-loadable+post-build-selectable / pre-compile in variant pre-compile, default-value=0  # Describes a mask for hardware-based filtering of CAN identifiers. The CAN identifiers of incoming messages are masked with the appropriate CanFilterMaskValue. Bits holding a 0 mean don't care, i.e. do not compare the message's identifier in the respective bit position. The Filter is defined by Code and Mask part: pass Filter when: receiveID & Mask == Code & Mask Mask Bit 31 used to mask Extended and Mixed ID | The mask shall be build by filling with leading 0. In case of CanIdType EXTENDED or MIXED a 29 bit mask shall be build. In case of CanIdType STANDARD a 11 bit mask shall be build
          integer CanFilterCodeValue: 0..4294967295, set at link in variant link-time / post-build in variant post-build-loadable+post-build-selectable / pre-compile in variant pre-compile, origin=Vector Informatik, default-value=0  # The Filter is defined by Code and Mask part: pass Filter when: received ID & Mask == Code & Mask Code Bit 31 used to mask Mixed ID This value is equal to CanHardwareObject/CanIdValue if there is only one Filter for the Basic CAN Rx HardwareObject used. But for multiple Filters more than one Id Value is needed.
          boolean IsLocked: set at link in variant link-time / post-build in variant post-build-loadable+post-build-selectable / pre-compile in variant pre-compile, origin=Vector Informatik, default-value=false  # This parameter defines whether the settings in this container CanFilterMask shall stay unchanged during GenTool optimization.
        container CanTTController [0..0]  # Not Used. Not Supported. This container is only included and valid if TTCAN SWS is used and TTCAN is enabled. | This container contains the configuration parameters of the TTCAN controller(s) (which are needed in addition to the configuration parameters of the CAN controller(s)). CanTTController is only included, if the controller supports TTCAN.
          integer CanTTControllerApplWatchdogLimit: 0..255, set at pre-compile in variant link-time+pre-compile / post-build in variant post-build-loadable+post-build-selectable, default-value=0  # Defines the maximum time period (unit is 256 times NTU) after which the application has to serve the watchdog.
          integer CanTTControllerCycleCountMax: 0..63, set at pre-compile in variant link-time+pre-compile / post-build in variant post-build-loadable+post-build-selectable, default-value=0  # Defines the value for cycle_count_max. | Allowed values: 0x00: 1 basic cycle 0x01: 2 basic cycles 0x03: 4 basic cycles 0x07: 8 basic cycles 0x0F: 16 basic cycles 0x1F: 32 basic cycles 0x3F: 64 basic cycles
          integer CanTTControllerExpectedTxTrigger: 0..255, set at pre-compile in variant link-time+pre-compile / post-build in variant post-build-loadable+post-build-selectable, default-value=0  # Number of expected_tx_trigger.
          boolean CanTTControllerExternalClockSynchronisation: set at pre-compile in variant link-time+pre-compile / post-build in variant post-build-loadable+post-build-selectable, default-value=false  # Enables/disables the external clock synchronization. | TRUE: External clock synchronization enabled. FALSE: External clock synchronization disabled. This parameter shall only be configurable if parameter CanTTControllerLevel2 equals TRUE.
          boolean CanTTControllerGlobalTimeFiltering: set at pre-compile in variant link-time+pre-compile / post-build in variant post-build-loadable+post-build-selectable, default-value=false  # Enables/disables the global time filtering. | TRUE: Global time filtering enabled. FALSE: Global time filtering disabled. This parameter shall only be configurable if parameter CanTTControllerLevel2 equals TRUE.
          integer CanTTControllerInitialRefOffset: 0..127, set at pre-compile in variant link-time+pre-compile / post-build in variant post-build-loadable+post-build-selectable, default-value=0  # Defines the initial value for ref trigger offset.
          integer CanTTControllerInterruptEnable: 0..1023, set at pre-compile in variant link-time+pre-compile / post-build in variant post-build-loadable+post-build-selectable, default-value=0  # Enables/disables the respective interrupts. | Bit Position set to 1: Enable respective interrupt. Bit Position set to 0: Disable respective interrupt. Bit Position / Interrupt Source: 10: Application Watchdog. 9: Watch Trigger reached. 8: Initialization Watch Trigger reached. 7: Change of Error Level. 6: Tx Overflow. 5: Tx Underflow. 4: Global Time Error. 3: Gap. 2: Start of Cycle. 1: Time Discontinuity. 0: Master State Change. Bit position "1: Time Discontinuity" and "4: Global Time Error" shall only be configurable if parameter CanTTControllerLevel2 equals TRUE.
          boolean CanTTControllerLevel2: set at pre-compile in variant link-time+pre-compile / post-build in variant post-build-loadable+post-build-selectable, default-value=false  # Defines whether Level 2 or Level 1 is used. | TRUE: Level 2. FALSE: Level 1. If this parameter is set to FALSE then all parameters with dependency to CanTTControllerLevel2 need not be configured.
          float CanTTControllerNTUConfig: 0..100, set at pre-compile in variant link-time+pre-compile / post-build in variant post-build-loadable+post-build-selectable, default-value=0  # Defines the config value for NTU (network time unit). | Value given in microseconds. The value configured shall be greater than 0. Together with the local oscillator period, the TUR (time unit ratio) can be derived from the NTU. This parameter shall only be configurable if parameter CanTTControllerLevel2 equals TRUE.
          enumeration CanTTControllerOperationMode: {CAN_TT_EVENT_SYNC_TIME_TRIGGERED, CAN_TT_EVENT_TRIGGERED, CAN_TT_TIME_TRIGGERED}, set at pre-compile in variant link-time+pre-compile / post-build in variant post-build-loadable+post-build-selectable, default-value=CAN_TT_EVENT_TRIGGERED  # Defines the operation mode.
          float CanTTControllerSyncDeviation: 0..100, set at pre-compile in variant link-time+pre-compile / post-build in variant post-build-loadable+post-build-selectable, default-value=0  # Defines the maximum synchronization deviation: | Given as a percentage value of the NTU (network time unit). The value configured shall be greater than 0. This parameter shall only be configurable if parameter CanTTControllerLevel2 equals TRUE.
          boolean CanTTControllerTURRestore: set at pre-compile in variant link-time+pre-compile / post-build in variant post-build-loadable+post-build-selectable, default-value=false  # Enables/disables the TUR restore. | Note that the value configured for TUR can be derived from the value configured for NTU and the local oscillator preriod. TRUE: TUR restore enabled. FALSE: TUR restore disabled. This parameter shall only be configurable if parameter CanTTControllerLevel2 equals TRUE.
          boolean CanTTControllerTimeMaster: set at pre-compile in variant link-time+pre-compile / post-build in variant post-build-loadable+post-build-selectable, default-value=false  # Defines whether the controller acts as a potential time master. | TRUE: Potential time master. FALSE: Time slave.
          integer CanTTControllerTimeMasterPriority: 0..7, set at pre-compile in variant link-time+pre-compile / post-build in variant post-build-loadable+post-build-selectable, default-value=0  # Defines the time master priority.
          integer CanTTControllerTxEnableWindowLength: 1..16, set at pre-compile in variant link-time+pre-compile / post-build in variant post-build-loadable+post-build-selectable, default-value=1  # Length of the tx enable window given in CAN bit times. | Definition parameter "CanTTControllerTxEnableWindowlength" is used such that: Length of enable window = CanTTControllerTxEnableWindowLength + 1
          integer CanTTControllerWatchTriggerGapTimeMark: 0..65535, set at pre-compile in variant link-time+pre-compile / post-build in variant post-build-loadable+post-build-selectable, default-value=0  # watch trigger time mark after a gap
          integer CanTTControllerWatchTriggerTimeMark: 0..65535, set at pre-compile in variant link-time+pre-compile / post-build in variant post-build-loadable+post-build-selectable, default-value=0  # watch trigger time mark
          enumeration CanTTIRQProcessing: {INTERRUPT, POLLING}, set at pre-compile in variant link-time+pre-compile / post-build in variant post-build-loadable+post-build-selectable, default-value=INTERRUPT  # Enables / disables API Can_MainFunction_BusOff() for handling busoff events in polling mode.
      container CanHardwareObject [0..*]: post-build-changeable=true  # This container contains the configuration (parameters) of CAN Hardware Objects.
        enumeration CanHandleType: {BASIC, FULL}, set at link in variant link-time / post-build in variant post-build-loadable+post-build-selectable / pre-compile in variant pre-compile, default-value=BASIC  # Specifies the type (Full-CAN or Basic-CAN) of a hardware object.
        enumeration CanIdType: {EXTENDED, MIXED, STANDARD}, set at link in variant link-time / post-build in variant post-build-loadable+post-build-selectable / pre-compile in variant pre-compile, default-value=STANDARD  # This parameter defines whether the IdValue is of type EXTENDED: All the CANIDs are of type extended only (29 bit). MIXED: The type of CANIDs can be both Standard or Extended. STANDARD: All the CANIDs are of type standard only (11bit). ImplementationType: Can_IdType | - standard identifier - extended identifier - mixed mode ImplementationType: Can_IdType
        integer CanIdValue: 0..4294967295, set at link in variant link-time / post-build in variant post-build-loadable+post-build-selectable / pre-compile in variant pre-compile, default-value=0  # This value specifies the CAN identifier of the CAN message. Rx FullCAN messages: Contain the ID value of the message. Rx BasicCAN message: Specifies (together with the filter mask) the identifiers range that passes the hardware filter.
        integer CanObjectId: 0..65535, set at link in variant link-time / post-build in variant post-build-loadable+post-build-selectable / pre-compile in variant pre-compile, default-value=0  # Holds the handle ID of HRH or HTH. The value of this parameter is unique in a given CAN Driver, and it should start with 0 and continue without any gaps. Hint: this value is auto-calculated by the generator. Restriction: Tx, RxBasicCAN and RxFullCAN for the same controller has to be grouped without gaps. | The HRH and HTH Ids are defined under two different name-spaces. Example: HRH0-0, HRH1-1, HTH0-2, HTH1-3
        enumeration CanObjectType: {RECEIVE, TRANSMIT}, set at link in variant link-time / post-build in variant post-build-loadable+post-build-selectable / pre-compile in variant pre-compile, default-value=RECEIVE  # Specifies if the HardwareObject is used as Transmit or as Receive object.
        boolean CanHwProcessing: set at link in variant link-time / post-build in variant post-build-loadable+post-build-selectable / pre-compile in variant pre-compile, origin=Vector Informatik, default-value=false  # Enable Polling Processing | Define if this hardware object is polled or not. The usage depends on CanIndividualProcessing switch which has to be enabled.
        enumeration CanCommonCANNode [0..1]: {A, B}, set at link in variant link-time / post-build in variant post-build-loadable+post-build-selectable / pre-compile in variant pre-compile, origin=Vector Informatik, default-value=A  # Use this when Feature 'CanCommonCAN' is activated to select the physical channel for this hardware object. RESTRICTIONS: Feature 'CanCommonCAN' has to be enabled. Only selectable for Rx Full CAN hardware objects (all other will be used on channel 'A')
        integer CanObjectHwSize: 1..65535, set at link in variant link-time / post-build in variant post-build-loadable+post-build-selectable / pre-compile in variant pre-compile, origin=Vector Informatik, default-value=1  # This value specifies the numbers of used hardware buffers for this HardwareObject. For BasicCAN Rx mailboxes with configurable size the user can adapt this. Otherwise it will be filled and used by generator only.
        integer CanObjectHwHandle: 0..65535, set at link in variant link-time / post-build in variant post-build-loadable+post-build-selectable / pre-compile in variant pre-compile, origin=Vector Informatik, default-value=0  # Index for first hardware buffer used by this HardwareObject. Hint: Will be filled and used by generator only.
        integer CanMaxDataLen: 0..64, set at link in variant link-time / post-build in variant post-build-loadable+post-build-selectable / pre-compile in variant pre-compile, origin=Vector Informatik, default-value=8  # specifies the maximum amount of used bytes in case of CAN FD is activated.
        integer CanFdPaddingValue: 0..255, set at link in variant link-time / post-build in variant post-build-loadable+post-build-selectable / pre-compile in variant pre-compile, origin=Vector Informatik, default-value=0  # Specifies the value which is used to pad unspecified data in CAN FD frames > 8 bytes for transmission. This is necessary due to the discrete possible values of the DLC if > 8 bytes. If the length of a PDU which was requested to be sent does not match the allowed DLC values, the remaining bytes up to the next possible value shall be padded with this value.
        boolean CanObjectMultiplexedTransmission: set at link in variant link-time / post-build in variant post-build-loadable+post-build-selectable / pre-compile in variant pre-compile, origin=Vector Informatik, default-value=false  # Define if this hardware object use Multiplexed Transmission. RESTRICTIONS: 'CanObjectMultiplexedTransmission' is only used if hardware supports this and 'CanObjectType' is of type 'TRANSMIT' and 'CanHandleType' is of type 'BASIC'.
        reference CanControllerRef: set at link in variant link-time / post-build in variant post-build-loadable+post-build-selectable / pre-compile in variant pre-compile, destination=CanController  # Reference to CAN Controller to which the HOH is associated to.
        reference CanFilterMaskRef [0..*]: set at link in variant link-time / post-build in variant post-build-loadable+post-build-selectable / pre-compile in variant pre-compile, destination=CanFilterMask  # Reference to the filter mask that is used for hardware filtering together with the CanIdValue Multiple References for more than one basic can Filter. This is only available for some hardware platforms. | The CanFilterMaskRef is omitted for 1) CanHardwareObjects with CanObjectType set to TRANSMIT 2) CanHardwareObjects with CanObjectType set to RECEIVE if only a single Can ID shall be received via this CanHardwareObjects (i.e., exact match with CanIdValue)
        reference CanMainFunctionRWPeriodRef [0..1]: set at link in variant link-time / post-build in variant post-build-loadable+post-build-selectable / pre-compile in variant pre-compile, destination=CanMainFunctionRWPeriods  # Reference to CanMainFunctionRWPeriod to which the HOH is associated to.
        container CanTTHardwareObjectTrigger [0..0]  # Not Used. Not Supported. This container is only included and valid if TTCAN SWS is used and TTCAN is enabled. | This container contains the configuration (parameters) of TTCAN triggers for Hardware Objects, which are additional to the configuration (parameters) of CAN Hardware Objects. CanTTHardwareObjectTrigger is only included, if the controller supports TTCAN.
          integer CanTTHardwareObjectBaseCycle: 0..63, set at pre-compile in variant link-time+pre-compile / post-build in variant post-build-loadable+post-build-selectable, default-value=0  # Defines the cycle_offset. | CanTTHardwareObjectBaseCycle must be not greater than cycle_count_max.
          integer CanTTHardwareObjectCycleRepetition: 1..64, set at pre-compile in variant link-time+pre-compile / post-build in variant post-build-loadable+post-build-selectable, default-value=1  # Defines the repeat_factor. | CanTTHardwareObjectCycleRepetition shall be a power of two (2), greater than cycle_offset but not greater than cycle_count_max + 1.
          integer CanTTHardwareObjectTimeMark: 0..65535, set at pre-compile in variant link-time+pre-compile / post-build in variant post-build-loadable+post-build-selectable, default-value=0  # Defines the point in time, when the trigger will be activated. | Value is given in cycle time.
          integer CanTTHardwareObjectTriggerId: 0..63, set at pre-compile in variant link-time+pre-compile / post-build in variant post-build-loadable+post-build-selectable, symbolic-name-value=true, default-value=0  # Sequential number which allows separation of different TTCAN triggers configured for one and the same hardware object.
          enumeration CanTTHardwareObjectTriggerType: {CAN_TT_RX_TRIGGER, CAN_TT_TX_REF_TRIGGER, CAN_TT_TX_REF_TRIGGER_GAP, CAN_TT_TX_TRIGGER_EXCLUSIVE, CAN_TT_TX_TRIGGER_MERGED, CAN_TT_TX_TRIGGER_SINGLE}, set at pre-compile in variant link-time+pre-compile / post-build in variant post-build-loadable+post-build-selectable, default-value=CAN_TT_RX_TRIGGER  # Defines the type of the trigger associated with the hardware object. This parameter depends on plain CAN parameter CAN_OBJECT_TYPE. | If CAN_OBJECT_TYPE equals RECEIVE than this parameter is fixed to CAN_TT_RX_TRIGGER. If CAN_OBJECT_TYPE equals TRANSMIT than one of the following literals is configurable: CAN_TT_TX_REF_TRIGGER, CAN_TT_TX_REF_TRIGGER_GAP, CAN_TT_TX_TRIGGER_MERGED, CAN_TT_TX_TRIGGER_SINGLE, CAN_TT_TX_TRIGGER_EXCLUSIVE.
    container CanGeneral  # General configuration parameters of the CAN Driver.
      boolean CanChangeBaudrateApi: set at pre-compile, default-value=false  # This parameter defines whether the Can_ChangeBaudrate API is available or not. | If this parameter is set to true the Can_ChangeBaudrate API shall be supported. Otherwise the API is not supported.
      boolean CanDevErrorDetection: set at pre-compile, default-value=true  # This parameter switches the Development Error Detection and Notification ON or OFF. true: Development error detection is enabled. false: Development error detection is disabled. Note: In general, the development error detection is recommended during pre-test phase. It is not recommended to enable the development error detection in production code due to increased runtime and ROM needs.
      boolean CanHardwareCancellation: set at pre-compile, default-value=false  # Transmit Cancellation | This parameter defines if hardware cancellation shall be supported. Support Hardware Transmit Cancelation. Enable/disable the usage of transmit cancelation out of hardware mailboxes, so that the canceled message will not be send. (this avoids internal priority inversion) RESTRICTIONS: 'CanHardwareCancellation' is only available, if hardware supports this by mean of cancel mailboxes and CanIf-Tx-buffer activated.
      boolean CanIdenticalIdCancellation: set at pre-compile, default-value=false  # Enables/disables cancellation of pending PDUs with identical ID. 'Hardware Transmit Cancelation' also cancels messages with same identifier (newer data will be send) out of hardware mailboxes. otherwise only lower prior identifiers will be cancelled. (older data will be send) RESTRICTIONS: 'CanIdenticalIdCancellation' is only used when CAN Interface parameter 'CanIfTransmitCancellation' is set.
      integer CanIndex: 0..255, set at pre-compile, default-value=0  # Specifies the InstanceId of this module instance. If only one instance is present it shall have the Id 0.
      function name CanLPduReceiveCalloutFunction [0..1]: set at pre-compile, default-value=Appl_GenericPrecopy  # Not Used. (Use instead 'CanGenericPrecopy') This parameter defines the existence and the name of a callout function that is called after a successful | reception of a received CAN Rx L-PDU. If this parameter is omitted no callout shall take place.
      float CanMainFunctionBusoffPeriod: 0.001..65.535, set at pre-compile, default-value=0.01  # This value specifies the period for cyclic call to Can_MainFunction_Busoff. EcuC unit is seconds.
      float CanMainFunctionModePeriod: 0.001..65.535, set at pre-compile, default-value=0.01  # This value specifies the period for cyclic call to Can_MainFunction_Mode. EcuC unit is seconds.
      float CanMainFunctionWakeupPeriod: 0.001..65.535, set at pre-compile, default-value=0.01  # This value specifies describes the period for cyclic call to Can_MainFunction_Wakeup. EcuC unit is seconds.
      boolean CanMultiplexedTransmission: set at pre-compile, default-value=false  # Specifies if multiplexed transmission shall be supported ON or OFF. This switch will be set automatically for precompile configurations depend on CanHardwareObject's CanObjectMultiplexedTransmission settings. RESTRICTIONS: 'CanMultiplexedTransmission' is only available, if hardware supports this by mean of multiple priorized mailboxes.
      boolean CanSetBaudrateApi: set at pre-compile, origin=Vector Informatik, default-value=false  # The support of the Can_SetBaudrate API is optional. | If this parameter is set to true the Can_SetBaudrate API shall be supported. Otherwise the API is not supported.
      float CanTimeoutDuration: 1E-06..65.535, set at pre-compile, default-value=0.01  # Specifies the maximum time for blocking function until a timeout is detected. EcuC unit is seconds.
      boolean CanVersionInfoApi: set at pre-compile, default-value=false  # This parameter enables/disables the function Can_GetVersionInfo() to get major, minor and patch version information.
      boolean CanGenericPrecopy: set at pre-compile, origin=Vector Informatik, default-value=false  # This parameter defines whether the Generic Precopy function is called or not. This function is called for any Rx event.
      boolean CanHardwareLoopCheck: set at pre-compile, origin=Vector Informatik, default-value=true  # This parameter enables hardware loop check(s) to avoid endless loops. Under some conditions, the CAN driver has to wait for hardware dependent events. This will be done in a so-called 'Hardware Loop'. Refer to the technical reference documentation for usage of this kind of loops. To secure that this loop will not run infinitely, a timeout (CanTimeoutDuration) can be configured. A DET notification appears in this case. RESTRICTIONS: CanHardwareLoopCheck is only available, if hardware supports/needs this.
      boolean CanSecureTempBuffer: set at pre-compile, origin=Vector Informatik, default-value=false  # This parameter defines the usage of Secure Temp Buffers for hw-mailbox objects. RESTRICTIONS: 'CanSecureTempBuffer' is only available, if hardware supports a secure memory section for rx data buffering.
      string CanUserConfigFile [0..1]: set at pre-compile, origin=Vector Informatik, default-value=UserCfg  # Reference to an external text file that will be included during generation to Can_Cfg.h. The content of the user configuration file will be added at the end of the generated module configuration file and allows altering or extending the generated code. Caution: User configuration files can cause the software module to malfunction and must only be used with great care!
      boolean CanRxFullCANSupport: set at pre-compile, origin=Vector Informatik, default-value=true  # This parameter defines whether Rx FullCAN mailboxes shall be used or not. Deactivate it to save ROM and runtime consumption.
      boolean CanTxFullCANSupport: set at pre-compile, origin=Vector Informatik, default-value=true  # This parameter defines whether Tx FullCAN mailboxes shall be used or not. Deactivate it to save ROM and runtime consumption.
      boolean CanRxBasicCANSupport: set at pre-compile, origin=Vector Informatik, default-value=true  # This parameter defines whether Rx BasicCAN mailboxes shall be used or not. Deactivate it to save ROM and runtime consumption.
      boolean CanUseNestedCANInterrupts: set at pre-compile, origin=Vector Informatik, default-value=false  # This parameter defines whether CAN ISRs from different controllers can interrupt each other (only with higher priority). Deactivate this parameter to reduce runtime consumption. RESTRICTIONS: 'CanUseNestedCANInterrupts' is only available, if hardware supports this by mean of higher prior interrupts can be configured to interrupt CAN interrupts.Only adjustable if OS CAT1 Interrupts are configured.
      boolean CanHardwareCancelByAppl: set at pre-compile, origin=Vector Informatik, default-value=false  # This parameter defines whether the application can cancel a hardware loop check. 'CanTimeoutDuration' will then be ignored ApplCanTimerStart() ApplCanTimerLoop() ApplCanTimerEnd() Callbacks have to be implemented in application. RESTRICTIONS: 'CanHardwareCancelByAppl' is only available, if 'CanHardwareLoopCheck' is enabled.
      boolean CanIndividualProcessing: set at pre-compile, origin=Vector Informatik, default-value=false  # Activate this when you like to configure each Rx and Tx mailbox object separate (deactivate to reduce runtime and memory consumption). RESTRICTIONS: 'CanIndividualProcessing' influences the settings of 'CanRxProcessing' and 'CanTxProcessing'. It is only available, if hardware supports/needs this and Highend licence is given.
      boolean CanGenericConfirmation: set at pre-compile, origin=Vector Informatik, default-value=false  # This parameter defines whether the Generic Confirmation function shall be called or not. The generic confirmation function is called for all Tx events.
      boolean CanRxQueue: set at pre-compile, origin=Vector Informatik, default-value=false  # This parameter defines whether the Rx Queue shall be active or not. All Rx events will be queued in interrupt (id, dlc and data) and processed when calling Can_MainFunction_Read(). RESTRICTIONS: 'CanRxQueue' is only available, if hardware supports/needs this and Highend licence is given.
      boolean CanSupportMixedID: set at pre-compile, origin=Vector Informatik, default-value=false  # This parameter defines to force the code to contain mixed ID handling to be free afterwards using standard, extended or mixed IDs. No more ID type optimization! RESTRICTIONS: 'CanSupportMixedID' is only available, if hardware supports mixed ID handling. And it is not modify-able when mixed ID used in database.
      integer CanRxQueueSize: 1..65535, set at pre-compile, origin=Vector Informatik, default-value=10  # This value specifies the size of the Rx Queue in messages. If no Can_Mainfunction_Read() is called there will be overruns after receive this amount of messages. RESTRICTIONS: 'CanRxQueueSize' is only available, if 'CanRxQueue' is enabled.
      boolean CanMultipleBasicCANObjects: set at pre-compile, origin=Vector Informatik, default-value=false  # Activated when you use multiple BasicCAN hardware messages to optimize reception. (this allowes to use more hardware message filters, and hardware message buffers). RESTRICTIONS: 'CanMultipleBasicCANObjects' is only available, if hardware supports/needs this and Highend licence is given.
      boolean CanMultipleBasicCANTxObjects: set at pre-compile, origin=Vector Informatik, default-value=false  # Activated when you use multiple TX BasicCAN hardware messages to optimize transmission. (this allowes to use more hardware message buffers). RESTRICTIONS: 'CanMultipleBasicCANTxObjects' is only available, if hardware supports/needs this and Highend licence is given.
      enumeration CanHardwareHandleType: {UINT8, UINT16}, set at pre-compile, origin=Vector Informatik, default-value=UINT8  # Depend on the Platform, there is the need to use more than 8bit 'hardware mailbox handles' (defined by AutoSar 3.x). So it is possible to use 8bit or 16bit types (defined by AutoSar 4.x). RESTRICTIONS: 'CanHardwareHandleType' need to be set to 8bit when CanInterface without this support is used (Vector Interface >= 4.12 support 16bit).
      boolean CanOptimizeOneController: set at pre-compile, origin=Vector Informatik, default-value=false  # This parameter defines whether the code shall be optimized for one controller. RESTRICTIONS: 'CanOptimizeOneController' does only work when one controller is used,
      enumeration CanInterruptCategory: {CATEGORY2, CATEGORY1, VOIDFUNCVOID}, set at pre-compile, origin=Vector Informatik, default-value=CATEGORY2  # Specifies the type of Interrupt Function. Category 1: Interrupt Function has to be added to the interrupt vector table. Category 2: Interrupt Function is defined with ISR() define. void Func(void): Interrupt Function is defined as void Func(void) function. RESTRICTIONS: 'Category 2' is only relevant when AutoSar or OSEK OS is used otherwise the Interrupt will be Category 1.
      boolean CanGetStatus: set at pre-compile, origin=Vector Informatik, default-value=false  # This parameter defines whether the Can_GetStatus() API is available or not. The API returns the hardware states: CAN_STATUS_STOP, CAN_STATUS_INIT, CAN_STATUS_INCONSISTENT, CAN_STATUS_WARNING, CAN_STATUS_PASSIVE, CAN_STATUS_BUSOFF, CAN_STATUS_SLEEP
      enumeration CanInterruptLock: {DRIVER, APPL, BOTH}, set at pre-compile, origin=Vector Informatik, default-value=DRIVER  # This parameter defines who handles the interrupt locking. Disable and Restore Can Interrupt by CAN Driver or Application or CAN Driver and Application. Reason may be, that the CAN driver should not access the Interrupt controller for CAN interrupts or there are other restrictions (special security level) or Application has to care about additional Interrupts like Wakeup.
      boolean CanWakeupSupport: set at pre-compile, origin=Vector Informatik, default-value=false  # This parameter defines whether the CAN driver supports wakeup over CAN Bus (global switch for optimization). This switch will be set automatically for precompile configurations depend on CanController's CanWakeupSupport settings. RESTRICTIONS: 'CanWakeupSupport' is only available when Hardware supports Wakeup over Bus.
      enumeration CanRamCheck: {None, Active, MailboxNotification, Extended}, set at pre-compile, origin=Vector Informatik, default-value=None  # This parameter defines whether the RAM check for Rx and Tx mailboxes is active or not. The application notification functions "ApplCanCorruptMailbox" and "ApplCanMemCheckFailed" are called in case of RAM is corrupted. Controller will be deactivated and no communication will be processed. - None: Feature deactive - Active: "ApplCanMemCheckFailed" will be called in case of issue in any mailbox ID,DLC or data register. - Mailbox Notification: "ApplCanMemCheckFailed" and "ApplCanCorruptMailbox" will be called for dedicated mailbox ID,DLC or data register. - Extended: All relevant mailbox and controller register will be checked. Controller and mailbox failure will be notified and and objects deactivated. There is a possibility to activate mailboxes and controllers again.
      enumeration CanOverrunNotification: {None, DET, Application}, set at pre-compile, origin=Vector Informatik, default-value=DET  # This parameter defines whether the Rx Overrun Notification is active or not. Please note that overruns for Rx BasicCAN objects cannot always be detected (see TechRef). None: Nothing is done. DET: DET is called. Application: Appl_CanOverrun is called.
      boolean CanReinitStart: set at pre-compile, origin=Vector Informatik, default-value=false  # ReInitialization While Start Transition | This parameter defines whether to process a full controller reinitialization at start transition (include hardware Rx and Tx mailboxes and control registers) or not. This cause significant runtime.
      boolean CanGenericPreTransmit: set at pre-compile, origin=Vector Informatik, default-value=false  # This parameter defines whether a generic pretransmit common for all Tx messages will be called when this checkbox is enabled. Use this to change data or abort transmission right before the message will be send.
      enumeration CanFdSupport: {NONE, BRS, FULL}, set at pre-compile, origin=Vector Informatik, default-value=NONE  # Specifies the kind of CAN FD support. NONE: CAN FD is deactivated BRS: Bitrate switching is activated but DLC is 8 at maximum FULL: Bitrate switching is activated and DLC can be 64 at maximum
      boolean CanRuntimeMeasurementSupport: set at pre-compile, origin=Vector Informatik, default-value=false  # If enabled runtime measurement points are added to the BSW module code and are added to the module configuration of MICROSAR RTM. The available measurement points can be seen and configured in the RTM module configuration. Availability of the MICROSAR RTM module is a prerequisite to make use of the runtime measurement functionality. Runtime measurement should be disabled in production code as measurement points may inflict additional runtime.
      integer CanMaxRxDataLen: 0..64, set at link in variant link-time / post-build in variant post-build-loadable+post-build-selectable / pre-compile in variant pre-compile, origin=Vector Informatik, default-value=8  # specifies the maximum amount of used bytes for receive buffers in case of CAN FD is activated.
      integer CanMaxTxDataLen: 0..64, set at link in variant link-time / post-build in variant post-build-loadable+post-build-selectable / pre-compile in variant pre-compile, origin=Vector Informatik, default-value=8  # specifies the maximum amount of used bytes for transmit buffers in case of CAN FD is activated.
      boolean CanUsePeripheralAccessApi: set at pre-compile, origin=Vector Informatik, default-value=false  # Use Peripheral Access API for access to those peripheral registers which need supervisor permissions. This allows the CAN driver to run in an untrusted OS Application.
      boolean CanEnableMultipleCanDriver: set at pre-compile, origin=Vector Informatik, default-value=false  # Allow using of multiple CAN driver instances. Common registers like FDR or CLC will not be initialized and SRC register usage as well as start / stop indexes of used mailboxes can be configured on each controller.
      integer CanMaxNumberOfHwCANChannels: 1..8, set at pre-compile, origin=Vector Informatik, default-value=4  # Max Hw Channels MultiCAN | Amount of CAN channels available on MultiCAN for this derivative. Get value from your hardware manual. RESTRICTIONS: This value is only used for Generic Derivative TC1xxx and TC2xx
      integer CanMaxNumberOfHwCANChannelsR: 0..8, set at pre-compile, origin=Vector Informatik, default-value=0  # Max Hw Channels MultiCANR | Amount of CAN channels available on MultiCANR for this derivative. Get value from your hardware manual. RESTRICTIONS: This value is only used for Generic Derivative TC1xxx and TC2xx
      integer CanMaxNumberOfHwCANObj: 16..256, set at pre-compile, origin=Vector Informatik, default-value=128  # Max Hw Objects MultiCAN | Amount of CAN mailbox objects available on MultiCAN for this derivative. (over all channels) Get value from your hardware manual. RESTRICTIONS: This value is only used for Generic Derivative TC1xxx and TC2xx.
      integer CanMaxNumberOfHwCANObjR: 0..256, set at pre-compile, origin=Vector Informatik, default-value=0  # Max Hw Objects MultiCANR | Amount of CAN mailbox objects available on MultiCANR for this derivative. (over all channels) Get value from your hardware manual. RESTRICTIONS: This value is only used for Generic Derivative TC1xxx and TC2xx.
      enumeration CanClockDividerMode: {NORMAL, FRACTIONAL}, set at pre-compile, origin=Vector Informatik, default-value=NORMAL  # Select the divider mode that should be used to generate the CAN cell clock. NORMAL: fCAN = fSYS x 1/n FRACTIONAL: fCAN = fSYS x n/1024 with n = 'CanClockDivider' RESTRICTIONS: 'CanClockDividerMode' use 'CanClockDivider'
      integer CanClockDivider: 1..1024, set at pre-compile, origin=Vector Informatik, default-value=1  # The CPU clock is divided by the specified divider, the result is the CAN clock, used to generate the baudrate. The divider is used for all channels. RESTRICTIONS: usage of 'CanClockDivider' depend on 'CanClockDividerMode'
      integer CanBaseAddress: 1..4294967295, set at pre-compile, origin=Vector Informatik, default-value=4026548224  # Base Address MultiCAN | CAN cell base address for MultiCAN cell please refer to derivative specific hardware manual.
      integer CanBaseAddressR: 0..4294967295, set at pre-compile, origin=Vector Informatik, default-value=0  # Base Address MultiCANR | CAN cell base address for MultiCANR cell please refer to derivative specific hardware manual.
      integer CanSrcAddress: 0..4294967295, set at pre-compile, origin=Vector Informatik, default-value=4026763520  # SRC Address MultiCAN | Address of first SRC register for MultiCAN purpose. Get value form derivative specific hardware manual.
      integer CanSrcAddressR: 0..4294967295, set at pre-compile, origin=Vector Informatik, default-value=4026763584  # SRC Address MultiCANR | Address of first SRC register for MultiCANR purpose. Get value form derivative specific hardware manual.
      enumeration CanClockSourceSelection: set at pre-compile, origin=Vector Informatik, default-value=NotUsed  # Beneath the PLL different clock sources are possible to allow an independent clocking of the baud rate logic. This offers the possibility to change the frequency of the CAN cell without effecting the CAN communication. The following clock sources are enabled today for the baudrate logic: NotUsed: disable the clock of the baudrate logic (with this reset setting no communication is possible) Fclc/asyn_can: PLL (as today) Fosc: Direct oscillator drive ErayPll: can be used for FlexRay devices HardWiredZero: disable the clock of the baudrate logic
        NotUsed  # Not Used
        Fclc  # Fclc CLC frequency used
        Fosc  # OSC frequency used
        ErayPll  # ERAY PLL clock used
        HardWiredZero  # Hard Wired to Zero
      boolean CanFreezeDisable: set at pre-compile, origin=Vector Informatik, default-value=false  # This bit controls the freeze function for the CAN cell. This bit may not be available for all derivatives see Technical Reference for your derivative Register 'FDR.FDIS'
      boolean CanMirrorModeSupport: set at pre-compile, origin=Vector Informatik, default-value=false  # Use CDD Mirror component to route messages to other controllers. See specification of CDD Mirror component.
      boolean CanUseOsInterruptControl: set at pre-compile, origin=Vector Informatik, default-value=false  # This parameter specifies whether the interrupt registers are acessed directly or over the OS. TRUE: Interrupt sources are controlled by the OS. Can uses API osDisableInterruptSource, osEnableInterruptSource and osClearPendingInterrupt to access the interrupt control registers. FALSE: Interrupt sources are controlled directly by this module.
      boolean CanRxHwFiFoFullNotification: set at pre-compile, origin=Vector Informatik, default-value=false  # During Rx Basiccan reception the CAN driver notifies the application if the FIFO is fiiled full. Depending on the usecase it may be necessary to expand the Rx FiFo size. Note: There is no notification for a FIFO overrun, only a FIFO full notification.
      boolean CanFdIsoSupport: set at pre-compile, origin=Vector Informatik, default-value=false  # FD ISO Support | This parameter specifies whether your derivative is CAN FD ISO 11898-1 capable. If it is, the setttings for CanFdNiso/CanFdPed become relevant. Please refer to the hardware manual for your sepecific derivative step. Attention: If your derivative supports this mode the register CAN_NBTRx.DIV8 is not valid any more. TRUE: ISO 11898-1 is supported and NISO/PED can be configured. FALSE: ISO mode is not supported but register CAN_NBTRx.DIV8 will be available for baudrate settings.
      boolean CanFdNiso: set at pre-compile, origin=Vector Informatik, default-value=false  # FD Non ISO Operation | Non ISO Operation (NISO). Activate this option if you want to make your ECU runable in a non ISO CAN FD network. TRUE: no ISO 11898-1 CRC is used. FALSE: ISO 11898-1 CRC is used.
      boolean CanFdPed: set at pre-compile, origin=Vector Informatik, default-value=false  # FD Protocol Exception Disable | Protocol Exception Disable (PED). Disable Protocol Exception on recessive "res" bit. This is only necessary for future use. TRUE: disable the protocol exection. FALSE: enable protocol exception.
      boolean CanSilentModeSupport: set at pre-compile, origin=Vector Informatik, default-value=false  # This parameter defines whether the CAN driver supports silent mode for CAN Bus (global switch for optimization).
      boolean CanSafeBswChecks: set at pre-compile, origin=Vector Informatik, default-value=false  # Selects if safety checks are used. These checks improve robustness as e.g. invalid parameters are checked before function is executed. This attribute has to be enabled for safety projects where this component is mapped to an ASIL partition.
      reference CanCounterRef: set at pre-compile, destination=OsCounter  # This parameter contains a reference to a OS-counter, which is used by the CAN driver, to handle timeouts while mode transition and Hardware Loop timeouts.
      reference CanSupportTTCANRef [0..0]: set at pre-compile, destination=CanIfPrivateCfg  # Not Used. Not Supported. The parameter refers to CanIfSupportTTCAN parameter in the CAN Interface Module configuration. | The CanIfSupportTTCAN parameter defines whether TTCAN is supported.
      container CanMainFunctionRWPeriods  # This container contains the read and write periods (referred by CanHardwareObject).
        float CanMainFunctionReadPeriod [0..*]: 0.001..65.535, set at pre-compile, default-value=0.01  # This value specifies the period for cyclic call to Can_MainFunction_Read. EcuC unit is seconds. Different poll-cycles will be configurable if more than one CanMainFunctionReadPeriod is configured. In this case multiple Can_MainFunction_Read() will be provided by the CAN Driver module.
        float CanMainFunctionWritePeriod [0..*]: 0.001..65.535, set at pre-compile, default-value=0.01  # This value specifies the period for cyclic call to Can_MainFunction_Write. EcuC unit is seconds. Different poll-cycles will be configurable if more than one CanMainFunctionWritePeriod is configured. In this case multiple Can_MainFunction_Write() will be provided by the CAN Driver module.
  module config Can_Pre: definition=Can
  module config Can_Rec: definition=Can
