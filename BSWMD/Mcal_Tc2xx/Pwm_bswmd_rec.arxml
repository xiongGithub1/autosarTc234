AUTOSAR XML (schema 4-0-3)
package /AURIX
  module config Pwm_Rec: definition=Pwm
  bsw implementation Pwm_Impl: programming-language=C, vendor-id=17, behavior=PwmBehavior, recommended-configuration=Pwm_Rec, vendor-api-infix=Gtm, vendor-specific-module-def=Pwm
