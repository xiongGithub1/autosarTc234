AUTOSAR XML (schema 4-0-3)
# COPYRIGHT
# Copyright (c) 2017 by Vector Informatik GmbH. All rights reserved.
# This software is copyright protected and proprietary to Vector Informatik GmbH.
# Vector Informatik GmbH grants to you only those rights as set out in the license conditions.
package /MICROSAR/Eep_30_XXspi01
  bsw implementation Eep_Impl: programming-language=C, sw-version=3.00.01, used-code-generator=DaVinci Configurator, vendor-id=30, ar-release-version=4.00.03, behavior=Eep_30_XXspi01Behavior, preconfigured-configuration=Eep_30_XXspi01_Pre, recommended-configuration=Eep_30_XXspi01_Rec, vendor-api-infix=XXspi01, vendor-specific-module-def=Eep
  module definition Eep [0..2]: category=VENDOR_SPECIFIC_MODULE_DEFINITION, refined-module-def=Eep, variants pre-compile  # Configuration of the Eep (internal or external EEPROM driver) module. Its multiplicity describes the number of EEPROM drivers present, so there will be one container for each EEPROM driver in the ECUC template. When no EEPROM driver is present then the multiplicity is 0. | Its multiplicity describes the number of EEPROM drivers present, so there will be one container for each EEPROM driver in the ECUC template. When no EEPROM driver is present then the multiplicity is 0.
    container EepGeneral  # Container for general configuration parameters of the EEPROM driver. These parameters are always pre-compile.
      boolean EepDevErrorDetect: set at pre-compile, default-value=true  # Development Error Detection | Pre-processor switch to enable and disable development error detection and reporting. | true: Development error detection enabled. false: Development error detection disabled.
      integer EepDriverIndex: 0..254, set at pre-compile, symbolic-name-value=true  # Index of the driver, used by EA.
      boolean EepUseInterrupts: set at pre-compile, default-value=false  # Switches to activate or deactivate interrupt controlled job processing. Not used (always deactivated). | true: Interrupt controlled job processing enabled. false: Interrupt controlled job processing disabled.
      boolean EepVersionInfoApi: set at pre-compile, default-value=false  # Pre-processor switch to enable / disable the API to read out the modules version information. | true: Version info API enabled. false: Version info API disabled.
      boolean EepWriteCycleReduction: set at pre-compile, default-value=false  # Switches to activate or deactivate write cycle reduction (EEPROM value is read and compared before being overwritten). Not used (always deactivated). | true: Write cycle reduction enabled. false: Write cycle reduction disabled.
      boolean EepIncRegPartition: set at pre-compile, origin=Vector Informatik, default-value=false  # Pre-processor switch to enable the incremental area registers support. Before to activate this feature it must be checked if the EEPROM chip provides such a hardware feature and if the behavior is compatible with the STMicroelectronics M35SWxx family.
      boolean EepResetLatch: set at pre-compile, origin=Vector Informatik, default-value=false  # Pre-processor switch to enable sending a WRDI command before every READ command. This feature is recomend to be activated for environments that are strongly disturbed. This feature ensures that the EEPROM is not unintentionally written if READ is interpreted as WRITE/ WRINC due the perturbations. Background: the write enable latch in EEPROM might remain set in several cases: - ECU reset - write failure - after cancel service
      boolean EepRearrangeData: set at pre-compile, origin=Vector Informatik, default-value=false  # Pre-processor switch to enable the data rearrangement, i.e. before the data internal copied as following: - Spi_DataType -> uint8 before an SPI write transaction - uint8 -> Spi_DataType after an SPI read transaction For a correct behavior of this EEPROM driver the feature must be activated if Spi_DataType != uint8. If Spi_DataType == uint8, this feature should not be activated because of efficiency reason, but this EEPROM driver will work correctly.
      boolean EepTestComApi: set at pre-compile, origin=Vector Informatik, default-value=false  # Pre-processor switch to enable / disable the API to test the communication. | true: Version info API enabled. false: Version info API disabled.
      boolean EepUnlockEepromApi: set at pre-compile, origin=Vector Informatik, default-value=false  # Pre-processor switch to enable / disable the API to unlock the EEPROM chip - Eep_30_XXspi01_Unlock(). The EEPROM will be released from HPM and/ or SPM if the chips find itself in any of this write protection modes.
      integer EepMaxAllowedReadBlockSize: 1..8192, set at pre-compile, origin=Vector Informatik, default-value=16  # This parameter represents the maximum allowed read size for the slow (normal) and fast mode. Background: this parameters serves to generation of the data buffer(s) size and to EepFastReadBlockSize and EepNormalReadBlockSize parameters validation.
      boolean EepSafeBswChecks: set at pre-compile, origin=Vector Informatik, default-value=false  # Safe Bsw Checks | Selects if safety checks are used. These checks improve robustness as e.g. invalid parameters are checked before function is executed. This attribute has to be enabled for safety projects where this component is mapped to an ASIL partition.
    container EepInitConfiguration  # Container for runtime configuration parameters of the EEPROM driver. | Implementation Type: Eep_ConfigType.
      integer EepBaseAddress: 0..4294967295, set at pre-compile, default-value=0  # This parameter is the EEPROM device base address. | Implementation Type: Eep_AddressType.
      enumeration EepDefaultMode: {MEMIF_MODE_FAST, MEMIF_MODE_SLOW}, set at pre-compile, default-value=MEMIF_MODE_SLOW  # This parameter is the default EEPROM device mode after initialization. | Implementation Type: MemIf_ModeType.
      integer EepFastReadBlockSize: 0..4294967295, set at pre-compile, default-value=16  # Number of bytes read within one job processing cycle in fast mode. If the hardware does not support burst mode this parameter shall be set to the same value as EepNormalReadBlockSize. | Implementation Type: Eep_LengthType.
      integer EepFastWriteBlockSize: 0..4294967295, set at pre-compile, default-value=16  # Number of bytes written within one job processing cycle in fast mode. If the hardware does not support burst mode this parameter shall be set to the same value as EepNormalWriteBlockSize. | Implementation Type: Eep_LengthType.
      float EepJobCallCycle: 0.001..1, set at pre-compile, default-value=0.005  # Call cycle time of the EEPROM driver's main function. Unit: [s]
      function name EepJobEndNotification [0..1]: set at pre-compile  # This parameter is a reference to a callback function for positive job result (see EEP045).
      function name EepJobErrorNotification [0..1]: set at pre-compile  # This parameter is a reference to a callback function for negative job result (see EEP046).
      integer EepNormalReadBlockSize: 0..4294967295, set at pre-compile, default-value=16  # Number of bytes read within one job processing cycle in normal mode. | Implementation Type: Eep_LengthType.
      integer EepNormalWriteBlockSize: 0..4294967295, set at pre-compile, default-value=16  # Number of bytes written within one job processing cycle in normal mode. | Implementation Type: Eep_LengthType.
      integer EepSize: 0..4294967295, set at pre-compile  # This parameter is the used size of EEPROM device in bytes. | Implementation Type: Eep_LengthType.
      enumeration EepDefaultHandling: {EEP_30_XXSPI01_HANDLING_BURST, EEP_30_XXSPI01_HANDLING_RECURRENT}, set at pre-compile, origin=Vector Informatik, default-value=EEP_30_XXSPI01_HANDLING_RECURRENT  # This parameter is the default main function handling after initialization. | Implementation Type: MemIf_ModeType.
      integer EepNbOfBurstQueries: 0..65535, set at pre-compile, origin=Vector Informatik, default-value=65535  # This parameter is the number of queries (status register retrieval) when the main function is not called with a recurrence. | Implementation Type: uint16.
      string EepCfgIncludeList [0..2]: set at pre-compile, origin=Vector Informatik  # This parameter specifies the header files containing the prototypes of notification functions.
      reference EepDeviceInformationRef: set at pre-compile, origin=Vector Informatik, destination=EepDeviceInformation  # Select a EEPROM device from the list or add a "custom" device in case none of the listed EEPROM devices are compatible. In the latter case it is necessary to enter the device's properties manually.
      container EepDemEventParameterRefs [0..1]  # Container for the references to DemEventParameter elements which shall be invoked using the API Dem_ReportErrorStatus API in case the corresponding error occurs. The EventId is taken from the referenced DemEventParameter's DemEventId value. The standardized errors are provided in the container and can be extended by vendor specific error references.
        symbolic name reference EEP_E_COMPARE_FAILED: set at pre-compile, destination=DemEventParameter  # Reference to the DemEventParameter which shall be issued when the error "EEPROM compare failed (HW)" has occurred.
        symbolic name reference EEP_E_ERASE_FAILED: set at pre-compile, destination=DemEventParameter  # Reference to the DemEventParameter which shall be issued when the error "EEPROM erase failed (HW)" has occurred.
        symbolic name reference EEP_E_READ_FAILED: set at pre-compile, destination=DemEventParameter  # Reference to the DemEventParameter which shall be issued when the error "EEPROM read failed (HW)" has occurred.
        symbolic name reference EEP_E_WRITE_FAILED: set at pre-compile, destination=DemEventParameter  # Reference to the DemEventParameter which shall be issued when the error "EEPROM write failed (HW)" has occurred.
        symbolic name reference EEP_E_TEST_COM_FAILED [0..1]: set at pre-compile, origin=Vector Informatik, destination=DemEventParameter  # Reference to the DemEventParameter which shall be issued when the error "EEPROM test communication failed (HW)" has occurred.
        symbolic name reference EEP_E_SET_LOCK_LEVEL_FAILED [0..1]: set at pre-compile, origin=Vector Informatik, destination=DemEventParameter  # Reference to the DemEventParameter which shall be issued when the error "EEPROM set lock level failed (HW)" has occurred.
      container EepExternalDriver  # This container is present for external EEPROM drivers only. Internal EEPROM drivers do not use the parameter listed in this container, hence its multiplicity is 0 for internal drivers.
        symbolic name reference EepSpiReference [0..2]: set at pre-compile, destination=SpiSequence  # Reference to SPI sequence (required for external EEPROM drivers).
        symbolic name reference EepDioReference [0..1]: set at pre-compile, origin=Vector Informatik, destination=DioChannel  # Reference to DIO channel (required for external EEPROM drivers if write protect signal is supported).
      container EepSpiInterface [0..1]  # Eep Spi Interface | This container is used to announce manually the API service names and the include file of the Spi driver.
        string EepSpiIncludeFile: set at pre-compile, origin=Vector Informatik, default-value=Spi.h  # Spi Include File | This parameter defines the name of the header file of the SPI Driver.
        string EepSpiSetupEB: set at pre-compile, origin=Vector Informatik, default-value=Spi_SetupEB  # Spi SetupEB API | This parameter defines the name of the Spi SetupEB API.
        string EepSpiAsyncTransmit: set at pre-compile, origin=Vector Informatik, default-value=Spi_AsyncTransmit  # Spi AsyncTransmit API | This parameter defines the name of the Spi AsyncTransmit API.
        string EepSpiGetSequenceResult: set at pre-compile, origin=Vector Informatik, default-value=Spi_GetSequenceResult  # Spi GetSequenceResult API | This parameter defines the name of the Spi GetSequenceResult API.
    container EepDeviceInformation [1..*]  # Information about a supported EEPROM device used for automated configuration.
      integer EepAllowedWriteCycles: 1000..4294967295, set at pre-compile, origin=Vector Informatik, default-value=100000  # This parameter represents the EEPROM endurance. For details please check the device users manual. Background: this parameters is used by EA for own calculations.
      integer EepMinimumAddressType: 8..64, set at pre-compile, origin=Vector Informatik, default-value=16  # This parameter represents the number of address bits. It depends on EEPROM total size. For details please check the device users manual.
      integer EepTotalSize: 128..4294967295, set at pre-compile, origin=Vector Informatik, default-value=16384  # This parameter represents the EEPROM total addressing area in bytes. For details please check the device users manual. Background: this parameters serves to EepBaseAddress and Eep_Size parameters validation.
      float EepWriteTime: 0..1, set at pre-compile, origin=Vector Informatik, default-value=0.005  # This parameter represents the EEPROM internal write cycle period in seconds. For details please check the device users manual.
      enumeration EepPageSize: set at pre-compile, origin=Vector Informatik, default-value=EepPageSize32  # This parameter represents the physical EEPROM page size in bytes. For details please check the device users manual. Background: this parameters serves to generation of the data buffer(s) size and to EepFastWritedBlockSize and EepNormalWriteBlockSize parameters validation.
        EepPageSize16  # 16
        EepPageSize32  # 32
        EepPageSize64  # 64
        EepPageSize128  # 128
        EepPageSize256  # 256
        EepPageSize512  # 512
        EepPageSize1024  # 1024
        EepPageSize2048  # 2048
        EepPageSize4096  # 4096
        EepPageSize8192  # 8192
      boolean EepIncRegSupport: set at pre-compile, origin=Vector Informatik, default-value=false  # This parameter represents the EEPROM incremental register hardware support. For details please check the device users manual. Background: this parameters serves to EepIncRegPartition parameter validation.
      boolean EepSpmSupport: set at pre-compile, origin=Vector Informatik, default-value=false  # This parameter represents the EEPROM SPM (software protection mode) support. For details please check the device users manual. Background: this parameters serves to EepUnlockEepromApi parameter validation.
      boolean EepHpmSupport: set at pre-compile, origin=Vector Informatik, default-value=false  # This parameter represents the EEPROM HPM (hardware protection mode) support. For details please check the device users manual. Background: this parameters serves to EepUnlockEepromApi and EepDioReference parameters validation.
    container EepPublishedInformation  # Additional published parameters not covered by CommonPublishedInformation container. | Note that these parameters do not have any configuration class setting, since they are published information.
      integer EepAllowedWriteCycles: 0..4294967295, set at published-information, default-value=100000  # Specified maximum number of write cycles under worst case conditions of specific EEPROM hardware (e.g. +90°C) The current EA version accesses this parameter, but the future plan is to get rid of that (due to generic implementation and support of more EERPROM devices provided by several manufacturers). To be replaced by EepDeviceInformation->EepAllowedWriteCycles.
      float EepEraseTime: 0..4294967295, set at published-information, default-value=0  # Maximum time for erasing one EEPROM data unit. Not used (due to generic implementation and support of more EERPROM devices provided by several manufacturers).
      integer EepEraseUnitSize: 0..4294967295, set at published-information, default-value=1  # Size of smallest erasable EEPROM data unit in bytes. There is a generic implementation in order to support more EERPROM devices provided by several manufacturers. For all these EEPROMs this value is always 1.
      integer EepEraseValue: 0..255, set at published-information, default-value=255  # Value of an erased EEPROM cell. There is a generic implementation in order to support more EERPROM devices provided by several manufacturers. For all these EEPROMs this value is always 255.
      integer EepMinimumAddressType: 0..4294967295, set at published-information, default-value=24  # Minimum expected size of Eep_AddressType. The current EA version accesses this parameter, but the future plan is to get rid of that (due to generic implementation and support of more EERPROM devices provided by several manufacturers). To be replaced by EepDeviceInformation->EepMinimumAddressType.
      integer EepMinimumLengthType: 0..4294967295, set at published-information, default-value=0  # Minimum expected size of Eep_LengthType. Not used (due to generic implementation and support of more EERPROM devices provided by several manufacturers).
      integer EepReadUnitSize: 0..4294967295, set at published-information, default-value=1  # Size of smallest readable EEPROM data unit in bytes. There is a generic implementation in order to support more EERPROM devices provided by several manufacturers. For all these EEPROMs this value is always 1.
      integer EepSpecifiedEraseCycles: 0..4294967295, set at published-information, default-value=0  # Number of erase cycles specified for the EEP device (usually given in the device data sheet). Not used (due to generic implementation and support of more EERPROM devices provided by several manufacturers).
      integer EepTotalSize: 0..4294967295, set at published-information, default-value=131072  # Total size of EEPROM in bytes. The current DaVinci CFG5 generator performs a check based on this parameter, thus the value shown here is the maximum size that the EEP can address (the default value is fixed by EepDeviceInformation->EepMinimumAddressType). The real total size corresponding to the used EEPROM can be found under EepDeviceInformation->EepTotalSize. | Implementation Type: Eep_LengthType.
      float EepWriteTime: 0..4294967295, set at published-information, default-value=0  # Maximum time for writing one EEPROM data unit. Not used (due to generic implementation and support of more EERPROM devices provided by several manufacturers).
      integer EepWriteUnitSize: 0..4294967295, set at published-information, default-value=1  # Size of smallest writeable EEPROM data unit in bytes. There is a generic implementation in order to support more EERPROM devices provided by several manufacturers. For all these EEPROMs this value is always 1.
  module config Eep_30_XXspi01_Pre: definition=Eep
  module config Eep_30_XXspi01_Rec: definition=Eep, implementation-config-variant=VARIANT-PRE-COMPILE
