AUTOSAR XML (schema 4-0-3)
# COPYRIGHT
# Copyright (c) by Vector Informatik GmbH. All rights reserved.
# This software is copyright protected and proprietary to Vector Informatik GmbH.
# Vector Informatik GmbH grants to you only those rights as set out in the license conditions.
package /MICROSAR/Eep_30_XXspi01
  module config Eep_30_XXspi01_Pre: definition=Eep
    54 x EepDeviceInformation:
      Atmel_AT25080B: EepAllowedWriteCycles=1000000, EepMinimumAddressType=16, EepTotalSize=1024, EepWriteTime=0.005, EepPageSize=EepPageSize32, EepIncRegSupport=false, EepSpmSupport=true, EepHpmSupport=true  # Atmel AT25080B
      Atmel_AT25160B: EepAllowedWriteCycles=1000000, EepMinimumAddressType=16, EepTotalSize=2048, EepWriteTime=0.005, EepPageSize=EepPageSize32, EepIncRegSupport=false, EepSpmSupport=true, EepHpmSupport=true  # Atmel AT25160B
      Atmel_AT25128: EepAllowedWriteCycles=100000, EepMinimumAddressType=16, EepTotalSize=16384, EepWriteTime=0.005, EepPageSize=EepPageSize64, EepIncRegSupport=false, EepSpmSupport=true, EepHpmSupport=true  # Atmel AT25128
      Atmel_AT25256: EepAllowedWriteCycles=100000, EepMinimumAddressType=16, EepTotalSize=32768, EepWriteTime=0.005, EepPageSize=EepPageSize64, EepIncRegSupport=false, EepSpmSupport=true, EepHpmSupport=true  # Atmel AT25256
      Atmel_AT25256B: EepAllowedWriteCycles=1000000, EepMinimumAddressType=16, EepTotalSize=32768, EepWriteTime=0.005, EepPageSize=EepPageSize64, EepIncRegSupport=false, EepSpmSupport=true, EepHpmSupport=true  # Atmel AT25256B
      Atmel_AT25320B: EepAllowedWriteCycles=1000000, EepMinimumAddressType=16, EepTotalSize=4096, EepWriteTime=0.005, EepPageSize=EepPageSize32, EepIncRegSupport=false, EepSpmSupport=true, EepHpmSupport=true  # Atmel AT25320B
      Cypress_FM25V01A: EepAllowedWriteCycles=4294967295, EepMinimumAddressType=16, EepTotalSize=16384, EepWriteTime=0, EepPageSize=EepPageSize32, EepIncRegSupport=false, EepSpmSupport=true, EepHpmSupport=true  # Cypress FM25V01A
      Everspin_MR25H40: EepAllowedWriteCycles=4294967295, EepMinimumAddressType=16, EepTotalSize=65536, EepWriteTime=0, EepPageSize=EepPageSize32, EepIncRegSupport=false, EepSpmSupport=true, EepHpmSupport=true  # Everspin MR25H40
      Microchip_25LC040A: EepAllowedWriteCycles=1000000, EepMinimumAddressType=8, EepTotalSize=512, EepWriteTime=0.005, EepPageSize=EepPageSize16, EepIncRegSupport=false, EepSpmSupport=true, EepHpmSupport=true  # Microchip 25LC040A
      Microchip_25LC080A: EepAllowedWriteCycles=1000000, EepMinimumAddressType=16, EepTotalSize=1024, EepWriteTime=0.005, EepPageSize=EepPageSize16, EepIncRegSupport=false, EepSpmSupport=true, EepHpmSupport=true  # Microchip 25LC080A
      Microchip_25LC080B: EepAllowedWriteCycles=1000000, EepMinimumAddressType=16, EepTotalSize=1024, EepWriteTime=0.005, EepPageSize=EepPageSize32, EepIncRegSupport=false, EepSpmSupport=true, EepHpmSupport=true  # Microchip 25LC080B
      Microchip_25AA128: EepAllowedWriteCycles=1000000, EepMinimumAddressType=16, EepTotalSize=16384, EepWriteTime=0.005, EepPageSize=EepPageSize64, EepIncRegSupport=false, EepSpmSupport=true, EepHpmSupport=true  # Microchip 25AA128
      Microchip_25LC128: EepAllowedWriteCycles=1000000, EepMinimumAddressType=16, EepTotalSize=16384, EepWriteTime=0.005, EepPageSize=EepPageSize64, EepIncRegSupport=false, EepSpmSupport=true, EepHpmSupport=true  # Microchip 25LC128
      Microchip_25LC160A: EepAllowedWriteCycles=1000000, EepMinimumAddressType=16, EepTotalSize=2048, EepWriteTime=0.005, EepPageSize=EepPageSize16, EepIncRegSupport=false, EepSpmSupport=true, EepHpmSupport=true  # Microchip 25LC160A
      Microchip_25LC160B: EepAllowedWriteCycles=1000000, EepMinimumAddressType=16, EepTotalSize=2048, EepWriteTime=0.005, EepPageSize=EepPageSize32, EepIncRegSupport=false, EepSpmSupport=true, EepHpmSupport=true  # Microchip 25LC160B
      Microchip_25LC256: EepAllowedWriteCycles=1000000, EepMinimumAddressType=16, EepTotalSize=32768, EepWriteTime=0.005, EepPageSize=EepPageSize64, EepIncRegSupport=false, EepSpmSupport=true, EepHpmSupport=true  # Microchip 25LC256
      Microchip_25LC320A: EepAllowedWriteCycles=1000000, EepMinimumAddressType=16, EepTotalSize=4096, EepWriteTime=0.005, EepPageSize=EepPageSize32, EepIncRegSupport=false, EepSpmSupport=true, EepHpmSupport=true  # Microchip 25LC320A
      Microchip_25LC512: EepAllowedWriteCycles=1000000, EepMinimumAddressType=16, EepTotalSize=65536, EepWriteTime=0.005, EepPageSize=EepPageSize128, EepIncRegSupport=false, EepSpmSupport=true, EepHpmSupport=true  # Microchip 25LC512
      Microchip_25LC640A: EepAllowedWriteCycles=1000000, EepMinimumAddressType=16, EepTotalSize=8192, EepWriteTime=0.005, EepPageSize=EepPageSize32, EepIncRegSupport=false, EepSpmSupport=true, EepHpmSupport=true  # Microchip 25LC640A
      Microchip_25LC1024: EepAllowedWriteCycles=1000000, EepMinimumAddressType=24, EepTotalSize=131072, EepWriteTime=0.006, EepPageSize=EepPageSize256, EepIncRegSupport=false, EepSpmSupport=true, EepHpmSupport=true  # Microchip 25LC1024
      ONSemiconductor_CAT25080: EepAllowedWriteCycles=1000000, EepMinimumAddressType=16, EepTotalSize=1024, EepWriteTime=0.005, EepPageSize=EepPageSize32, EepIncRegSupport=false, EepSpmSupport=true, EepHpmSupport=true  # ON Semiconductor CAT25080
      ONSemiconductor_CAT25160: EepAllowedWriteCycles=1000000, EepMinimumAddressType=16, EepTotalSize=2048, EepWriteTime=0.005, EepPageSize=EepPageSize32, EepIncRegSupport=false, EepSpmSupport=true, EepHpmSupport=true  # ON Semiconductor CAT25160
      ONSemiconductor_CAT25C256: EepAllowedWriteCycles=100000, EepMinimumAddressType=16, EepTotalSize=32768, EepWriteTime=0.010, EepPageSize=EepPageSize64, EepIncRegSupport=false, EepSpmSupport=true, EepHpmSupport=true  # ON Semiconductor CAT25C256
      ONSemiconductor_CAT25M02: EepAllowedWriteCycles=1000000, EepMinimumAddressType=24, EepTotalSize=262144, EepWriteTime=0.006, EepPageSize=EepPageSize256, EepIncRegSupport=false, EepSpmSupport=true, EepHpmSupport=true  # ON Semiconductor CAT25M02
      ONSemiconductor_CAV25128: EepAllowedWriteCycles=100000, EepMinimumAddressType=16, EepTotalSize=16384, EepWriteTime=0.005, EepPageSize=EepPageSize64, EepIncRegSupport=false, EepSpmSupport=true, EepHpmSupport=true  # ON Semiconductor CAV25128
      ONSemiconductor_CAV25512: EepAllowedWriteCycles=1000000, EepMinimumAddressType=16, EepTotalSize=65536, EepWriteTime=0.004, EepPageSize=EepPageSize128, EepIncRegSupport=false, EepSpmSupport=true, EepHpmSupport=true  # ON Semiconductor CAV25512
      ONSemiconductor_CAV25640: EepAllowedWriteCycles=1000000, EepMinimumAddressType=16, EepTotalSize=8192, EepWriteTime=0.005, EepPageSize=EepPageSize64, EepIncRegSupport=false, EepSpmSupport=true, EepHpmSupport=true  # ON Semiconductor CAV25640
      Ramtron_FM25W256: EepAllowedWriteCycles=4294967295, EepMinimumAddressType=16, EepTotalSize=32768, EepWriteTime=0, EepPageSize=EepPageSize32, EepIncRegSupport=false, EepSpmSupport=true, EepHpmSupport=true  # Ramtron FM25W256
      Ramtron_FM25640: EepAllowedWriteCycles=4294967295, EepMinimumAddressType=16, EepTotalSize=8192, EepWriteTime=0, EepPageSize=EepPageSize32, EepIncRegSupport=false, EepSpmSupport=true, EepHpmSupport=true  # Ramtron FM25640
      Ramtron_FM25CL64: EepAllowedWriteCycles=4294967295, EepMinimumAddressType=16, EepTotalSize=8192, EepWriteTime=0, EepPageSize=EepPageSize32, EepIncRegSupport=false, EepSpmSupport=true, EepHpmSupport=true  # Ramtron FM25CL64
      Rohm_BR25G1M: EepAllowedWriteCycles=1000000, EepMinimumAddressType=24, EepTotalSize=131072, EepWriteTime=0.005, EepPageSize=EepPageSize256, EepIncRegSupport=false, EepSpmSupport=true, EepHpmSupport=true  # Rohm BR25G1M
      Rohm_BR25H640: EepAllowedWriteCycles=1000000, EepMinimumAddressType=16, EepTotalSize=8192, EepWriteTime=0.004, EepPageSize=EepPageSize32, EepIncRegSupport=false, EepSpmSupport=true, EepHpmSupport=true  # Rohm BR25H640
      Rohm_BR35H128: EepAllowedWriteCycles=300000, EepMinimumAddressType=16, EepTotalSize=16384, EepWriteTime=0.005, EepPageSize=EepPageSize64, EepIncRegSupport=false, EepSpmSupport=false, EepHpmSupport=false  # Rohm BR35H128
      Seiko_S25A160A: EepAllowedWriteCycles=1000000, EepMinimumAddressType=16, EepTotalSize=2048, EepWriteTime=0.004, EepPageSize=EepPageSize32, EepIncRegSupport=false, EepSpmSupport=true, EepHpmSupport=true  # Seiko S25A160A
      Seiko_S25A256B: EepAllowedWriteCycles=1000000, EepMinimumAddressType=16, EepTotalSize=32768, EepWriteTime=0.005, EepPageSize=EepPageSize64, EepIncRegSupport=false, EepSpmSupport=true, EepHpmSupport=true  # Seiko S25A256B
      Seiko_S25A320A: EepAllowedWriteCycles=1000000, EepMinimumAddressType=16, EepTotalSize=4096, EepWriteTime=0.004, EepPageSize=EepPageSize32, EepIncRegSupport=false, EepSpmSupport=true, EepHpmSupport=true  # Seiko S25A320A
      Seiko_S25A320B: EepAllowedWriteCycles=1000000, EepMinimumAddressType=16, EepTotalSize=4096, EepWriteTime=0.005, EepPageSize=EepPageSize32, EepIncRegSupport=false, EepSpmSupport=true, EepHpmSupport=true  # Seiko S25A320B
      Seiko_S25A640A: EepAllowedWriteCycles=1000000, EepMinimumAddressType=16, EepTotalSize=8192, EepWriteTime=0.004, EepPageSize=EepPageSize32, EepIncRegSupport=false, EepSpmSupport=true, EepHpmSupport=true  # Seiko S25A640A
      Seiko_S25A640B: EepAllowedWriteCycles=1000000, EepMinimumAddressType=16, EepTotalSize=8192, EepWriteTime=0.005, EepPageSize=EepPageSize32, EepIncRegSupport=false, EepSpmSupport=true, EepHpmSupport=true  # Seiko S25A640B
      Seiko_S25C010A: EepAllowedWriteCycles=1000000, EepMinimumAddressType=8, EepTotalSize=128, EepWriteTime=0.004, EepPageSize=EepPageSize16, EepIncRegSupport=false, EepSpmSupport=true, EepHpmSupport=true  # Seiko S25C010A
      Seiko_S25C020A: EepAllowedWriteCycles=1000000, EepMinimumAddressType=8, EepTotalSize=256, EepWriteTime=0.004, EepPageSize=EepPageSize16, EepIncRegSupport=false, EepSpmSupport=true, EepHpmSupport=true  # Seiko S25C020A
      Seiko_S25C040A: EepAllowedWriteCycles=1000000, EepMinimumAddressType=8, EepTotalSize=512, EepWriteTime=0.004, EepPageSize=EepPageSize16, EepIncRegSupport=false, EepSpmSupport=true, EepHpmSupport=true  # Seiko S25C040A
      Seiko_S25C128A: EepAllowedWriteCycles=1000000, EepMinimumAddressType=16, EepTotalSize=16384, EepWriteTime=0.005, EepPageSize=EepPageSize64, EepIncRegSupport=false, EepSpmSupport=true, EepHpmSupport=true  # Seiko S25C128A
      STMicroelectronics_M35S128: EepAllowedWriteCycles=1000000, EepMinimumAddressType=16, EepTotalSize=16384, EepWriteTime=0.004, EepPageSize=EepPageSize64, EepIncRegSupport=true, EepSpmSupport=true, EepHpmSupport=true  # ST Microelectronics M35S128
      STMicroelectronics_M35SW08: EepAllowedWriteCycles=1000000, EepMinimumAddressType=16, EepTotalSize=1024, EepWriteTime=0.005, EepPageSize=EepPageSize32, EepIncRegSupport=true, EepSpmSupport=true, EepHpmSupport=true  # ST Microelectronics M35SW08
      STMicroelectronics_M35SW16: EepAllowedWriteCycles=1000000, EepMinimumAddressType=16, EepTotalSize=2048, EepWriteTime=0.005, EepPageSize=EepPageSize32, EepIncRegSupport=true, EepSpmSupport=true, EepHpmSupport=true  # ST Microelectronics M35SW16
      STMicroelectronics_M95080: EepAllowedWriteCycles=1000000, EepMinimumAddressType=16, EepTotalSize=1024, EepWriteTime=0.005, EepPageSize=EepPageSize32, EepIncRegSupport=false, EepSpmSupport=true, EepHpmSupport=true  # ST Microelectronics M95080
      STMicroelectronics_M95128: EepAllowedWriteCycles=1000000, EepMinimumAddressType=16, EepTotalSize=16384, EepWriteTime=0.005, EepPageSize=EepPageSize64, EepIncRegSupport=false, EepSpmSupport=true, EepHpmSupport=true  # ST Microelectronics M95128
      STMicroelectronics_M95160: EepAllowedWriteCycles=1000000, EepMinimumAddressType=16, EepTotalSize=2048, EepWriteTime=0.005, EepPageSize=EepPageSize32, EepIncRegSupport=false, EepSpmSupport=true, EepHpmSupport=true  # ST Microelectronics M95160
      STMicroelectronics_M95256: EepAllowedWriteCycles=1000000, EepMinimumAddressType=16, EepTotalSize=32768, EepWriteTime=0.005, EepPageSize=EepPageSize64, EepIncRegSupport=false, EepSpmSupport=true, EepHpmSupport=true  # ST Microelectronics M95256
      STMicroelectronics_M95320: EepAllowedWriteCycles=1000000, EepMinimumAddressType=16, EepTotalSize=4096, EepWriteTime=0.005, EepPageSize=EepPageSize32, EepIncRegSupport=false, EepSpmSupport=true, EepHpmSupport=true  # ST Microelectronics M95320
      STMicroelectronics_M95640: EepAllowedWriteCycles=1000000, EepMinimumAddressType=16, EepTotalSize=8192, EepWriteTime=0.005, EepPageSize=EepPageSize32, EepIncRegSupport=false, EepSpmSupport=true, EepHpmSupport=true  # ST Microelectronics M95640
      STMicroelectronics_M95M01: EepAllowedWriteCycles=1200000, EepMinimumAddressType=24, EepTotalSize=131072, EepWriteTime=0.004, EepPageSize=EepPageSize256, EepIncRegSupport=false, EepSpmSupport=true, EepHpmSupport=true  # ST Microelectronics M95M01
      STMicroelectronics_M95M02: EepAllowedWriteCycles=1200000, EepMinimumAddressType=24, EepTotalSize=262144, EepWriteTime=0.005, EepPageSize=EepPageSize256, EepIncRegSupport=false, EepSpmSupport=true, EepHpmSupport=true  # ST Microelectronics M95M02
  module config Eep_30_XXspi01_Rec: definition=Eep, implementation-config-variant=VARIANT-PRE-COMPILE
