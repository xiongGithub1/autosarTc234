AUTOSAR XML (schema 4-3-0)
package /ECUCompositionTypes
  composition sw component type ECU_Composition
package /EndToEndProtections
  end to end protection set EndToEndConnections
package /Systems
  system TsiStandard: category=SYSTEM_EXTRACT
    system mapping TsiStandard_MPPNG
    root-software-compositions:
      root sw composition prototype ECU_Composition: software-composition=ECU_Composition
