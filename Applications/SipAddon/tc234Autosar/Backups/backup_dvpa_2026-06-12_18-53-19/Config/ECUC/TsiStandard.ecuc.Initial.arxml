AUTOSAR XML (schema 4-2-1)
package /InitialEcuC
  ecuc value collection InitialEcuC: ecuc-values=[Can, CanIf, CanSM, Com, ComM, EcuC, EcuM, PduR]
  module config Can
    CanConfigSet
      CT_CAN00_e98c47e6 (CanController):
        CanControllerActivation = true
        CanControllerDefaultBaudrate = CanControllerBaudrateConfig
        CanControllerSystemRef = CT_CAN00
        CanWakeupSourceRef = EcuMCommonConfiguration/CAN00_f26020e5
        CanControllerBaudrateConfig
      CN_CAN00_e98c47e6_Rx_Std (CanHardwareObject): CanHandleType=BASIC, CanIdType=STANDARD, CanIdValue=0, CanObjectType=RECEIVE, CanControllerRef=CanConfigSet/CT_CAN00_e98c47e6
      CN_CAN00_e98c47e6_Tx (CanHardwareObject): CanHandleType=BASIC, CanIdValue=0, CanObjectType=TRANSMIT, CanControllerRef=CanConfigSet/CT_CAN00_e98c47e6
    CanGeneral: CanIndex=0
  module config CanIf
    Can (CanIfCtrlDrvCfg): CanIfCtrlDrvInitHohConfigRef=CanIfInitHohCfg, CanIfCtrlDrvNameRef=CanGeneral
      CT_CAN00_e98c47e6 (CanIfCtrlCfg): CanIfCtrlCanCtrlRef=CanConfigSet/CT_CAN00_e98c47e6
    CanIfInitCfg
      CanIfBufferCfg_0fb271d2 (CanIfBufferCfg): CanIfBufferSize=0, CanIfBufferHthRef=CanIfInitHohCfg/CN_CAN00_e98c47e6_Tx  # CHNL
      CanIfInitHohCfg: CanIfInitRefCfgSet=CanConfigSet
        CN_CAN00_e98c47e6_Rx_Std (CanIfHrhCfg): CanIfHrhCanCtrlIdRef=Can/CT_CAN00_e98c47e6, CanIfHrhIdSymRef=CanConfigSet/CN_CAN00_e98c47e6_Rx_Std
        CN_CAN00_e98c47e6_Tx (CanIfHthCfg): CanIfHthCanCtrlIdRef=Can/CT_CAN00_e98c47e6, CanIfHthIdSymRef=CanConfigSet/CN_CAN00_e98c47e6_Tx
      msg_Receive_oCAN00_Rx_3abd61be (CanIfRxPduCfg):
        CanIfRxPduCanId = 528
        CanIfRxPduCanIdType = STANDARD_CAN
        CanIfRxPduDlc = 1
        CanIfRxPduUserRxIndicationName = PduR_CanIfRxIndication
        CanIfRxPduUserRxIndicationUL = PDUR
        CanIfRxPduHrhIdRef = CanIfInitHohCfg/CN_CAN00_e98c47e6_Rx_Std
        CanIfRxPduRef = PT_msg_Receive_PP_msg_Receive_Rx_0fb271d2_5e566ad9
      msg_MyECU_Lamp_oCAN00_Tx_3abd61be (CanIfTxPduCfg):
        CanIfTxPduCanId = 1297
        CanIfTxPduCanIdType = STANDARD_CAN
        CanIfTxPduDlc = 8
        CanIfTxPduUserTxConfirmationName = PduR_CanIfTxConfirmation
        CanIfTxPduUserTxConfirmationUL = PDUR
        CanIfTxPduBufferRef = CanIfBufferCfg_0fb271d2
        CanIfTxPduRef = PT_msg_MyECU_Lamp_PP_msg_MyECU_Lamp_Tx_0fb271d2_5e566ad9
      msg_Transmit_oCAN00_Tx_3abd61be (CanIfTxPduCfg):
        CanIfTxPduCanId = 512
        CanIfTxPduCanIdType = STANDARD_CAN
        CanIfTxPduDlc = 1
        CanIfTxPduUserTxConfirmationName = PduR_CanIfTxConfirmation
        CanIfTxPduUserTxConfirmationUL = PDUR
        CanIfTxPduBufferRef = CanIfBufferCfg_0fb271d2
        CanIfTxPduRef = PT_msg_Transmit_PP_msg_Transmit_Tx_0fb271d2_5e566ad9
    CanIfPrivateCfg: CanIfPrivateSoftwareFilterType=LINEAR
    CanIfPublicCfg: CanIfPublicPnSupport=false
  module config CanSM
    CanSMConfiguration
      CHNL_f276589c (CanSMManagerNetwork): CanSMComMNetworkHandleRef=ComMConfigSet/CAN00_f26020e5
        CT_CAN00_e98c47e6 (CanSMController): CanSMControllerId=Can/CT_CAN00_e98c47e6
  module config Com
    ComConfig
      3 x ComIPdu, all with ComIPduType=NORMAL:
        msg_MyECU_Lamp_oCAN00_3abd61be: ComIPduDirection=SEND, ComIPduGroupRef=MyECU_oCAN00_Tx_fcef2243, ComIPduSignalRef=sig_LampCnt_818e1651, ComPduIdRef=PT_msg_MyECU_Lamp_PP_msg_MyECU_Lamp_Tx_0fb271d2_5e566ad9
          ComTxIPdu: ComMinimumDelayTime=0, ComTxIPduUnusedAreasDefault=0
            ComTxModeFalse
              ComTxMode: ComTxModeMode=PERIODIC, ComTxModeTimeOffset=0, ComTxModeTimePeriod=0.1
            ComTxModeTrue
              ComTxMode: ComTxModeMode=PERIODIC, ComTxModeTimeOffset=0, ComTxModeTimePeriod=0.1
        msg_Receive_oCAN00_3abd61be: ComIPduDirection=RECEIVE, ComIPduGroupRef=MyECU_oCAN00_Rx_fcef2243, ComIPduSignalRef=sig_State_RearInteriorLight_2b456e3f, ComIPduSignalRef=sig_State_RearLeftDoor_2b456e3f, ComIPduSignalRef=sig_State_RearRightDoor_2b456e3f, ComPduIdRef=PT_msg_Receive_PP_msg_Receive_Rx_0fb271d2_5e566ad9
        msg_Transmit_oCAN00_3abd61be: ComIPduDirection=SEND, ComIPduGroupRef=MyECU_oCAN00_Tx_fcef2243, ComIPduSignalRef=sig_RearInteriorLight_0723e95e, ComPduIdRef=PT_msg_Transmit_PP_msg_Transmit_Tx_0fb271d2_5e566ad9
          ComTxIPdu: ComMinimumDelayTime=0, ComTxIPduUnusedAreasDefault=0
            ComTxModeFalse
              ComTxMode: ComTxModeMode=PERIODIC, ComTxModeTimeOffset=0, ComTxModeTimePeriod=0.1
            ComTxModeTrue
              ComTxMode: ComTxModeMode=PERIODIC, ComTxModeTimeOffset=0, ComTxModeTimePeriod=0.1
      MyECU_oCAN00_Rx_fcef2243 (ComIPduGroup)
      MyECU_oCAN00_Tx_fcef2243 (ComIPduGroup)
      5 x ComSignal, all with ComSignalInitValue=0:
        sig_LampCnt_818e1651: ComBitPosition=7, ComBitSize=8, ComSignalEndianness=BIG_ENDIAN, ComSignalType=UINT8, ComTransferProperty=PENDING, ComSystemTemplateSystemSignalRef=sig_LampCnt
        sig_RearInteriorLight_0723e95e: ComBitPosition=0, ComBitSize=1, ComSignalEndianness=LITTLE_ENDIAN, ComSignalType=BOOLEAN, ComTransferProperty=PENDING, ComSystemTemplateSystemSignalRef=sig_RearInteriorLight
        sig_State_RearInteriorLight_2b456e3f: ComBitPosition=2, ComBitSize=1, ComSignalEndianness=LITTLE_ENDIAN, ComSignalType=BOOLEAN, ComTimeout=0, ComSystemTemplateSystemSignalRef=sig_State_RearInteriorLight
        sig_State_RearLeftDoor_2b456e3f: ComBitPosition=0, ComBitSize=1, ComSignalEndianness=LITTLE_ENDIAN, ComSignalType=BOOLEAN, ComTimeout=0, ComSystemTemplateSystemSignalRef=sig_State_RearLeftDoor
        sig_State_RearRightDoor_2b456e3f: ComBitPosition=1, ComBitSize=1, ComSignalEndianness=LITTLE_ENDIAN, ComSignalType=BOOLEAN, ComTimeout=0, ComSystemTemplateSystemSignalRef=sig_State_RearRightDoor
    ComGeneral
  module config ComM
    ComMConfigSet: ComMPncEnabled=false
      CAN00_f26020e5 (ComMChannel): ComMBusType=COMM_BUS_TYPE_CAN, ComMChannelId=0  # CN_CAN00
        ComMNetworkManagement: ComMNmVariant=NONE
        CHNL_f276589c (ComMUserPerChannel): ComMUserChannel=USR_CHNL_f276589c  # CN_CAN00
      USR_CHNL_f276589c (ComMUser): ComMUserIdentifier=0  # CN_CAN00
    ComMGeneral: ComMPncIdCounting=COMM_PNC_ID_COUNT_FROM_NM_MESSAGE, ComMPncSupport=false
  module config EcuC
    EcucPduCollection: PduIdTypeEnum=UINT8, PduLengthTypeEnum=UINT8
      3 x Pdu:
        PT_msg_MyECU_Lamp_PP_msg_MyECU_Lamp_Tx_0fb271d2_5e566ad9: PduLength=8, SysTPduToFrameMappingRef=msg_MyECU_Lamp  # msg_MyECU_Lamp_oCAN00
        PT_msg_Receive_PP_msg_Receive_Rx_0fb271d2_5e566ad9: PduLength=1, SysTPduToFrameMappingRef=msg_Receive  # msg_Receive_oCAN00
        PT_msg_Transmit_PP_msg_Transmit_Tx_0fb271d2_5e566ad9: PduLength=1, SysTPduToFrameMappingRef=msg_Transmit  # msg_Transmit_oCAN00
  module config EcuM
    EcuMConfiguration
      EcuMCommonConfiguration
        EcuMDriverInitListOne
        EcuMDriverRestartList
        CAN00_f26020e5 (EcuMWakeupSource): EcuMWakeupSourceId=5, EcuMComMChannelRef=ComMConfigSet/CAN00_f26020e5  # CN_CAN00
      EcuMFlexConfiguration: EcuMFlexModuleConfigurationRef=CanConfigSet
  module config PduR
    PduRGeneral
    PduRRoutingTables
      PduRRoutingTable
        3 x PduRRoutingPath:
          Can_PT_msg_MyECU_Lamp_0fb271d2  # msg_MyECU_Lamp_oCAN00
            DST_Can_PT_msg_MyECU_Lamp_0fb271d2 (PduRDestPdu): PduRDestPduRef=PT_msg_MyECU_Lamp_PP_msg_MyECU_Lamp_Tx_0fb271d2_5e566ad9
            SRC_Can_PT_msg_MyECU_Lamp_0fb271d2 (PduRSrcPdu): PduRSrcPduRef=PT_msg_MyECU_Lamp_PP_msg_MyECU_Lamp_Tx_0fb271d2_5e566ad9
          Can_PT_msg_Receive_0fb271d2  # msg_Receive_oCAN00
            DST_Can_PT_msg_Receive_0fb271d2 (PduRDestPdu): PduRDestPduRef=PT_msg_Receive_PP_msg_Receive_Rx_0fb271d2_5e566ad9
            SRC_Can_PT_msg_Receive_0fb271d2 (PduRSrcPdu): PduRSrcPduRef=PT_msg_Receive_PP_msg_Receive_Rx_0fb271d2_5e566ad9
          Can_PT_msg_Transmit_0fb271d2  # msg_Transmit_oCAN00
            DST_Can_PT_msg_Transmit_0fb271d2 (PduRDestPdu): PduRDestPduRef=PT_msg_Transmit_PP_msg_Transmit_Tx_0fb271d2_5e566ad9
            SRC_Can_PT_msg_Transmit_0fb271d2 (PduRSrcPdu): PduRSrcPduRef=PT_msg_Transmit_PP_msg_Transmit_Tx_0fb271d2_5e566ad9
