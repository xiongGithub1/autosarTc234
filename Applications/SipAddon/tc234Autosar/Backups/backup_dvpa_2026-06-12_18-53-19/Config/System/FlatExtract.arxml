AUTOSAR XML (schema 4-3-0)
package /COM/VECTOR/CFG/WORKFLOW/SYSDESC/SYNC
  system SYSTEM: category=ECU_EXTRACT
    system mapping MAPPINGS
    root-software-compositions:
      root sw composition prototype COMPOSITIONTYPE: flat-map=FLATMAP, software-composition=COMPOSITIONTYPE
  composition sw component type COMPOSITIONTYPE  # UB:Derived from original system description
    10 x component:
      BswM: type=BswM
      ComM: type=ComM
      DemMaster_0: type=DemMaster_0
      DemSatellite_0: type=DemSatellite_0
      Det: type=Det
      EcuM: type=EcuM
      Dcm: type=Dcm
      Os_OsCore_Core0_swc: type=Os_OsCore_Core0_swc
      IoHwAb: type=IoHwAb
      StartApplication: type=StartApplication
    connect BswM.Switch_ESH_ModeSwitch -> BswM.Notification_ESH_ModeNotification
    connect EcuM.EcuM_ShutdownTarget -> StartApplication.EcuM_ShutdownTarget
    connect DemSatellite_0.Event_DEM_EVENT_StartApplication -> StartApplication.PpDiagnosticMonitor_DEM_EVENT_StartApplication
    connect DemMaster_0.OpCycle_PowerCycle -> StartApplication.PpDemOpCycle_PowerCycle
    connect StartApplication.PpDcmDataService_DID_StartApplication -> Dcm.DataServices_Data_DID_StartApplication
    connect StartApplication.PpDemDataService_DemDataElementClass_StartApplication -> DemMaster_0.CBReadData_DemDataElementClass_StartApplication
    connect BswM.Provide_BswMRteModeRequestPort -> BswM.Request_ESH_PostRunRequest_0
  end to end protection set E2EPROTECTIONSET
  port interface mapping set PORTINTERFACEMAPPINGSET
