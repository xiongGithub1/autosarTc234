AUTOSAR XML (schema 4-2-1)
package /MICROSAR
  bsw implementation CanNm_Impl: programming-language=C, sw-version=6.03.00, used-code-generator=DaVinci Configurator, vendor-id=30, ar-release-version=4.00.03
