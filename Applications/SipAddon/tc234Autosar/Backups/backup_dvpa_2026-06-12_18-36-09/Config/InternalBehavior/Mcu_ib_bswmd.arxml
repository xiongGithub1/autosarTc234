AUTOSAR XML (schema 4-2-1)
package /AURIX/Mcu_ib_bswmd/BswModuleDescriptions
  bsw module description Mcu
    bsw internal behavior McuBehavior
