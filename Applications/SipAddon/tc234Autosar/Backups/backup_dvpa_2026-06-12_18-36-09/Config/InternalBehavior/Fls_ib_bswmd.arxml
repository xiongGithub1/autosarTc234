AUTOSAR XML (schema 4-2-1)
package /AURIX/Fls_ib_bswmd/BswModuleDescriptions
  bsw module description Fls: provided-entrys=Fls_17_Pmu_MainFunction
    bsw internal behavior FlsBehavior
      5 x exclusive area:
        Init
        Erase
        Write
        Main
        ResumeErase
      bsw schedulable entity Fls_17_Pmu_MainFunction: implemented-entry=Fls_17_Pmu_MainFunction
      bsw timing event Fls_17_Pmu_MainFunctionTimingEvent0: starts-on-event=Fls_17_Pmu_MainFunction, period=0.01
