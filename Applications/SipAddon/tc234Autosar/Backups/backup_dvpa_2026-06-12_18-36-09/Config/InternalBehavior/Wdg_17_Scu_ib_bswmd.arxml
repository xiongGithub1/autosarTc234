AUTOSAR XML (schema 4-2-1)
package /AURIX/Wdg_ib_bswmd/BswModuleDescriptions
  bsw module description Wdg
    bsw internal behavior WdgBehavior
      6 x exclusive area:
        SafetyInit
        SafetyTrigger
        SafetyOffMode
        Trigger
        TimerHandling
        ChangeMode
