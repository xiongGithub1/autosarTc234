[part 1 of 2: package /ActiveEcuC]
AUTOSAR XML (schema 4-2-1)
package /ActiveEcuC
  ecuc value collection ActiveEcuC: ecu-extract=SYSTEM
    ecuc-values:
      Os
      EcuC
      Com
      Rte
      Xcp
      ComM
      Dem
      Dcm
      CanIf
      Can
      CanTp
      CanNm
      Det
      PduR
      EcuM
      CanSM
      BswM
      Nm
      Resource
      Dio
      Fls
      Wdg
      Adc
      Port
      Icu
      Spi
      Gpt
      Pwm
      Irq
      Mcu
      Fee
      Crc
      IoHwAb
      MemIf
      NvM
      WdgIf
      WdgM
      Cdd_Com
  module config Os: implementation-config-variant=VARIANT-PRE-COMPILE, module-description=Os_Impl
    SystemTimer (OsCounter):
      OsCounterMaxAllowedValue = 2147483647
      OsCounterMinCycle = 1
      OsCounterType = HARDWARE
      OsSecondsPerTick = 0.001
      OsCounterTicksPerBase = 60000
      OsCounterAccessingApplication = SystemApplication_OsCore_Core0
      OsDriver: OsDriverHighResolution=false, OsDriverHardwareTimerChannelRef=STM0_Ch0, OsDriverIsrRef=CounterIsr_SystemTimer
    OsOS:
      OsStackMonitoring = true
      OsStatus = STANDARD
      OsUseGetServiceId = false
      OsUseParameterAccess = false
      OsUseResScheduler = false
      OsForcibleTermination = false
      OsGenerateCalloutStubs = true
      OsGenerateMemMap = COMPLETE
      OsGenerateMemMapForNearAddressing = true
      OsGenerateMemMapForThreads = false
      OsServiceProtection = false
      OsStackUsageMeasurement = false
      OsUseXSignalAsyncApiCalls = false
      OsScalabilityClass = SC1
      OsNumberOfCores = 1
      OsMasterCore = OsCore_Core0
      OsSystemTimer = SystemTimer
      OsHooks: OsErrorHook=true, OsPostTaskHook=false, OsPreTaskHook=false, OsShutdownHook=false, OsStartupHook=false
    OSDEFAULTAPPMODE (OsAppMode)
    OS_APPMODE_ANY (OsAppMode)
    OsPublishedInformation: OsKernelVersion=7, OsPlatformName=TriCoreAurix
      TC23x (OsDerivativeInformation):
        OsMpuAlignment = 8
        OsStackAlignment = 8
        OsExceptionVectorTableAlignment = 32
        OsInterruptVectorTableAlignment = 32
        OsHardwareManuals = User Manual: tc23x_tc22x_tc21x_um_v1.1.pdf V1.1 Errata Sheet: TC22x_TC21x_AB_Errata_Sheet_v1_2_03804A.pdf V1.2 Safety Manual: AURIX Safety Manual_3.pdf V1.3 2015-09
        Core0 (OsPhysicalCore):
          OsPhysicalCoreId = 0
          OsPhysicalCoreDefaultEntrySymbol = _start_tc0
          OsPhysicalCoreType = TC1.6.1E
          OsPhysicalCoreExceptionSources = 8
          OsPhysicalCoreMasterStartAllowed = true
          OsPhysicalCorePrivelegedHwAccess = true
          OsPhysicalCoreIsAutostart = true
          OsPhysicalCoreStackProtectionUnit = OsPhysicalCore0DataMpu
          OsPhysicalCore0DataMpu (OsPhysicalCoreMpu): OsPhysicalCoreMpuId=0, OsPhysicalCoreMpuMaxRegions=15, OsPhysicalCoreMpuType=DATA
          OsPhysicalCore0CodeMpu (OsPhysicalCoreMpu): OsPhysicalCoreMpuId=1, OsPhysicalCoreMpuMaxRegions=8, OsPhysicalCoreMpuType=CODE
        STM0 (OsHardwareTimer): OsHardwareTimerSize=32, OsHardwareTimerUnit=FRT, OsHardwareTimerBaseAddress=4026531840, OsHardwareTimerId=0, OsHardwareTimerType=STM
          STM0_Ch0 (OsHardwareTimerChannel): OsHardwareTimerChannelIntSource=1168, OsHardwareTimerChannelOffset=0, OsHardwareTimerChannelId=0
          STM0_Ch1 (OsHardwareTimerChannel): OsHardwareTimerChannelIntSource=1172, OsHardwareTimerChannelOffset=1, OsHardwareTimerChannelId=1
        AURIXTC2XX_IR (OsSystemIntCtrl): OsSystemIntCtrlMaxPrios=255, OsSystemIntCtrlPrioOrder=ASC, OsSystemIntCtrlMaxSources=8192, OsSystemIntCtrlBaseAddress=4026757120
        GPT (OsHardwareTimer): OsHardwareTimerSize=16, OsHardwareTimerUnit=PIT, OsHardwareTimerBaseAddress=4026543616, OsHardwareTimerId=0, OsHardwareTimerType=PIT
          GPT_Ch0 (OsHardwareTimerChannel): OsHardwareTimerChannelIntSource=1128, OsHardwareTimerChannelOffset=0, OsHardwareTimerChannelId=0
          GPT_Ch1 (OsHardwareTimerChannel): OsHardwareTimerChannelIntSource=1140, OsHardwareTimerChannelOffset=1, OsHardwareTimerChannelId=1
        OsMemoryRegionSpecifics
          12 x OsMemoryRegionAccess:
            PS0_R: OsMemoryRegionAccessRights=R, OsMemoryRegionAccessType=PROTECTION_SET0
            PS0_W: OsMemoryRegionAccessRights=W, OsMemoryRegionAccessType=PROTECTION_SET0
            PS0_X: OsMemoryRegionAccessRights=X, OsMemoryRegionAccessType=PROTECTION_SET0
            PS1_R: OsMemoryRegionAccessRights=R, OsMemoryRegionAccessType=PROTECTION_SET1
            PS1_W: OsMemoryRegionAccessRights=W, OsMemoryRegionAccessType=PROTECTION_SET1
            PS1_X: OsMemoryRegionAccessRights=X, OsMemoryRegionAccessType=PROTECTION_SET1
            PS2_R: OsMemoryRegionAccessRights=R, OsMemoryRegionAccessType=PROTECTION_SET2
            PS2_W: OsMemoryRegionAccessRights=W, OsMemoryRegionAccessType=PROTECTION_SET2
            PS2_X: OsMemoryRegionAccessRights=X, OsMemoryRegionAccessType=PROTECTION_SET2
            PS3_R: OsMemoryRegionAccessRights=R, OsMemoryRegionAccessType=PROTECTION_SET3
            PS3_W: OsMemoryRegionAccessRights=W, OsMemoryRegionAccessType=PROTECTION_SET3
            PS3_X: OsMemoryRegionAccessRights=X, OsMemoryRegionAccessType=PROTECTION_SET3
    OsCore_Core0 (OsCore):
      OsCoreIsAutostart = true
      OsCoreIsAutosar = true
      OsCoreEntrySymbol = _start_tc0
      OsCorePhysicalCoreRef = TC23x/Core0
      OsCoreIdleTask = IdleTask_OsCore_Core0
      OsCoreSystemApplication = SystemApplication_OsCore_Core0
      OsCoreEcucCoreRef = EcucHardware/Core0
      OsCoreStacks:
        OsCoreKernelStackSize = 1024
        OsCoreStartupStackSize = 1024
        OsCoreShutdownStackSize = 1024
        OsCoreErrorStackSize = 1024
        OsCoreProtectionStackSize = 1024
        OsCoreInitStackSize = 1024
    IdleTask_OsCore_Core0 (OsTask):
      OsTaskActivation = 1
      OsTaskPriority = 4294967295
      OsTaskSchedule = FULL
      OsTaskStackSharing = false
      OsTaskStackSize = 1024
      OsTaskType = AUTO
      OsTaskAccessingApplication = SystemApplication_OsCore_Core0
      OsTaskAutostart: OsTaskAppModeRef=OS_APPMODE_ANY
    SystemApplication_OsCore_Core0 (OsApplication):
      OsTrusted = true
      OsTrustedApplicationDelayTimingViolationCall = false
      OsTrustedApplicationWithProtection = false
      OsApplicationIsPrivileged = true
      OsAppUseTrustedFunctionStubs = false
      OsAppTaskRef = IdleTask_OsCore_Core0
      OsApplicationCoreRef = EcucHardware/Core0
      OsAppIsrRef = CounterIsr_SystemTimer
      OsAppTaskRef = Default_Appl_Init_Task
      OsAppTaskRef = Default_Appl_Task
      OsAppTaskRef = Default_BSW_Async_Task
      OsAppTaskRef = Default_BSW_Sync_Task
      OsAppTaskRef = Default_Background_Task
      OsAppTaskRef = Default_Init_Task
      OsAppTaskRef = Default_RTE_Mode_switch_Task
      OsAppCounterRef = SystemTimer
      OsAppIsrRef = CanIsr_0
      OsAppAlarmRef = Os/Rte_Al_TE2_Default_BSW_Async_Task_0_10ms
      OsAppAlarmRef = Os/Rte_Al_TE2_Default_BSW_Async_Task_0_20ms
      OsAppAlarmRef = Os/Rte_Al_TE2_Default_BSW_Async_Task_0_5ms
      OsAppAlarmRef = Os/Rte_Al_TE_StartApplication_StartApplication_Cyclic1000ms
      OsAppAlarmRef = Os/Rte_Al_TE_StartApplication_StartApplication_Cyclic10ms
      OsAppAlarmRef = Os/Rte_Al_TE_StartApplication_StartApplication_Cyclic1ms
      OsAppAlarmRef = Os/Rte_Al_TE_StartApplication_StartApplication_Cyclic250ms
      OsApplicationHooks: OsAppErrorHook=false, OsAppShutdownHook=false, OsAppStartupHook=false
    7 x OsTask, all with OsTaskActivation=1, OsTaskSchedule=NON, OsTaskStackSharing=false, OsTaskType=AUTO, OsTaskAccessingApplication=SystemApplication_OsCore_Core0:
      Default_Init_Task: OsTaskPriority=50, OsTaskStackSize=1024, OsTaskResourceRef=OsResource_EcuM
        OsTaskAutostart: OsTaskAppModeRef=OSDEFAULTAPPMODE
      Default_BSW_Sync_Task: OsTaskPriority=40, OsTaskStackSize=1024
      Default_BSW_Async_Task: OsTaskPriority=30, OsTaskStackSize=2048, OsTaskResourceRef=OsResource_EcuM, OsTaskEventRef=Rte_Ev_Cyclic2_Default_BSW_Async_Task_0_10ms, OsTaskEventRef=Rte_Ev_Cyclic2_Default_BSW_Async_Task_0_20ms, OsTaskEventRef=Rte_Ev_Cyclic2_Default_BSW_Async_Task_0_5ms
      Default_RTE_Mode_switch_Task: OsTaskPriority=10, OsTaskStackSize=1024
      Default_Appl_Task: OsTaskPriority=5, OsTaskStackSize=1024, OsTaskEventRef=Rte_Ev_Run_StartApplication_StartApplication_Cyclic1000ms, OsTaskEventRef=Rte_Ev_Run_StartApplication_StartApplication_Cyclic10ms, OsTaskEventRef=Rte_Ev_Run_StartApplication_StartApplication_Cyclic1ms, OsTaskEventRef=Rte_Ev_Run_StartApplication_StartApplication_Cyclic250ms, OsTaskEventRef=Rte_Ev_Run_StartApplication_StartApplication_OnDataRec_RxCtrl, OsTaskEventRef=Rte_Ev_Run_StartApplication_StartApplication_OnDataRec_RxData
      Default_Background_Task: OsTaskPriority=0, OsTaskStackSize=1024
        OsTaskAutostart: OsTaskAppModeRef=OSDEFAULTAPPMODE
      Default_Appl_Init_Task: OsTaskPriority=45, OsTaskStackSize=1024
    CanIsr_0 (OsIsr):  # Os Interrupt Service Routine PLAIN_TEXT Can transmit, receive and busoff events of controller CT_CAN_e98c47e6. This OsIsr container has been created automatically based on the driver configuration.
      OsIsrCategory = CATEGORY_2
      OsIsrInterruptType = EXTERNAL
      OsIsrInterruptSource = 2304
      OsIsrInterruptPriority = 10
      OsIsrStackSize = 1024
      OsIsrEnableNesting = false
    OsResource_EcuM (OsResource): OsResourceProperty=STANDARD, OsResourceAccessingApplication=SystemApplication_OsCore_Core0
    CounterIsr_SystemTimer (OsIsr):
      OsIsrCategory = CATEGORY_2
      OsIsrInterruptType = EXTERNAL
      OsIsrInterruptSource = 1168
      OsIsrInterruptPriority = 1
      OsIsrStackSize = 1024
      OsIsrEnableNesting = false
      OsIsrSpecialFunctionName = Os_TimerPfrtIsr
    3 x OsAlarm, all with OsAlarmCounterRef=SystemTimer, OsAlarmAccessingApplication=SystemApplication_OsCore_Core0:
      Rte_Al_TE2_Default_BSW_Async_Task_0_10ms
        OsAlarmAction
          OsAlarmSetEvent: OsAlarmSetEventRef=Rte_Ev_Cyclic2_Default_BSW_Async_Task_0_10ms, OsAlarmSetEventTaskRef=Default_BSW_Async_Task
      Rte_Al_TE2_Default_BSW_Async_Task_0_20ms
        OsAlarmAction
          OsAlarmSetEvent: OsAlarmSetEventRef=Rte_Ev_Cyclic2_Default_BSW_Async_Task_0_20ms, OsAlarmSetEventTaskRef=Default_BSW_Async_Task
      Rte_Al_TE2_Default_BSW_Async_Task_0_5ms
        OsAlarmAction
          OsAlarmSetEvent: OsAlarmSetEventRef=Rte_Ev_Cyclic2_Default_BSW_Async_Task_0_5ms, OsAlarmSetEventTaskRef=Default_BSW_Async_Task
    3 x OsEvent:
      Rte_Ev_Cyclic2_Default_BSW_Async_Task_0_10ms
      Rte_Ev_Cyclic2_Default_BSW_Async_Task_0_20ms
      Rte_Ev_Cyclic2_Default_BSW_Async_Task_0_5ms
    4 x OsAlarm, all with OsAlarmCounterRef=SystemTimer, OsAlarmAccessingApplication=SystemApplication_OsCore_Core0:
      Rte_Al_TE_StartApplication_StartApplication_Cyclic1000ms
        OsAlarmAction
          OsAlarmSetEvent: OsAlarmSetEventRef=Rte_Ev_Run_StartApplication_StartApplication_Cyclic1000ms, OsAlarmSetEventTaskRef=Default_Appl_Task
      Rte_Al_TE_StartApplication_StartApplication_Cyclic10ms
        OsAlarmAction
          OsAlarmSetEvent: OsAlarmSetEventRef=Rte_Ev_Run_StartApplication_StartApplication_Cyclic10ms, OsAlarmSetEventTaskRef=Default_Appl_Task
      Rte_Al_TE_StartApplication_StartApplication_Cyclic1ms
        OsAlarmAction
          OsAlarmSetEvent: OsAlarmSetEventRef=Rte_Ev_Run_StartApplication_StartApplication_Cyclic1ms, OsAlarmSetEventTaskRef=Default_Appl_Task
      Rte_Al_TE_StartApplication_StartApplication_Cyclic250ms
        OsAlarmAction
          OsAlarmSetEvent: OsAlarmSetEventRef=Rte_Ev_Run_StartApplication_StartApplication_Cyclic250ms, OsAlarmSetEventTaskRef=Default_Appl_Task
    6 x OsEvent:
      Rte_Ev_Run_StartApplication_StartApplication_Cyclic1000ms
      Rte_Ev_Run_StartApplication_StartApplication_Cyclic10ms
      Rte_Ev_Run_StartApplication_StartApplication_Cyclic1ms
      Rte_Ev_Run_StartApplication_StartApplication_Cyclic250ms
      Rte_Ev_Run_StartApplication_StartApplication_OnDataRec_RxCtrl
      Rte_Ev_Run_StartApplication_StartApplication_OnDataRec_RxData
  module config EcuC: implementation-config-variant=VARIANT-PRE-COMPILE, module-description=EcuC_Impl
    EcucGeneral:
      CPUType = CPU32Bit
      SizeOfInt = Size32Bit
      ByteOrder = LITTLE_ENDIAN
      BitOrder = LSB_to_MSB
      AtomicBitAccessInBitfield = false
      AtomicVariableAccess = Atomic32BitAccess
      SizeOfEnum = Size8Bit
      SizeOfROMPointer = Size32Bit
      SizeOfRAMPointer = Size32Bit
      BitFieldDataType = INT
      StructAlignment = Auto
      ArrayAlignment = Align8Bit
      StructInArrayAlignment = Auto
      DummyFunction = false
      EcuCSafeBswChecks = false
      DummyStatement = true
      DummyStatementKind = None
      ConditionalGenerating = true
      EcucBswImplementationCodeType = EcuCSourceCode
      EcuCUseStdReturnTypeForRte = false
      PostbuildLoadable: AlignmentFillPattern=90, PBROMStartAddress=0, PBRAMStartAddress=0, PBROMEndAddress=0, PBRAMEndAddress=0
      BswInitialization
        47 x InitFunction:
          BswM_Init: Header=BswM.h, InitPhase=NO_INIT, ConfigType=BswM_ConfigType, ConfigPtrName=BswM_Config_Ptr, ConfigPtrClass=BSWM_INIT_DATA, ModuleRef=BswM
          BswM_InitMemory: Header=BswM.h, InitPhase=INIT_MEMORY, ModuleRef=BswM
          CanIf_InitMemory: Header=CanIf.h, InitPhase=INIT_MEMORY, ModuleRef=CanIf
          CanIf_Init: Header=CanIf.h, InitPhase=INIT_TWO_IF, ConfigType=CanIf_ConfigType, ConfigPtrName=CanIf_Config_Ptr, ConfigPtrClass=CANIF_INIT_DATA, ModuleRef=CanIf
          CanNm_Init: Header=CanNm.h, InitPhase=INIT_TWO_NM, ConfigType=CanNm_ConfigType, ConfigPtrName=CanNm_Config_Ptr, ConfigPtrClass=CANNM_INIT_DATA, ModuleRef=CanNm
          CanNm_InitMemory: Header=CanNm.h, InitPhase=INIT_MEMORY, ModuleRef=CanNm
          CanSM_Init: Header=CanSM_EcuM.h, InitPhase=INIT_TWO_SM, ConfigType=CanSM_ConfigType, ConfigPtrName=CanSM_Config_Ptr, ConfigPtrClass=CANSM_INIT_DATA, ModuleRef=CanSM
          CanSM_InitMemory: Header=CanSM_EcuM.h, InitPhase=INIT_MEMORY, ModuleRef=CanSM
          CanTp_InitMemory: Header=CanTp.h, InitPhase=INIT_MEMORY, ModuleRef=CanTp
          CanTp_Init: Header=CanTp.h, InitPhase=INIT_TWO_TP, ConfigType=CanTp_ConfigType, ConfigPtrName=CanTp_Config_Ptr, ConfigPtrClass=CANTP_INIT_DATA, ModuleRef=CanTp
          Can_InitMemory: Header=Can.h, InitPhase=INIT_MEMORY, ModuleRef=Can
          Can_Init: Header=Can.h, InitPhase=INIT_TWO_DRV, ConfigType=Can_ConfigType, ConfigPtrName=Can_Config_Ptr, ConfigPtrClass=CAN_INIT_DATA, ModuleRef=Can
          ComM_InitMemory: Header=ComM.h, InitPhase=INIT_MEMORY, ModuleRef=ComM
          ComM_Init: Header=ComM.h, InitPhase=INIT_TWO_POST_NVMREADALL, ModuleRef=ComM
          Com_InitMemory: Header=Com.h, InitPhase=INIT_MEMORY, ModuleRef=Com
          Com_Init: Header=Com.h, InitPhase=INIT_TWO_COM, ConfigType=Com_ConfigType, ConfigPtrName=Com_Config_Ptr, ConfigPtrClass=COM_INIT_DATA, ModuleRef=Com
          Dcm_Init: Header=Dcm.h, InitPhase=INIT_TWO_POST_NVMREADALL, ConfigType=Dcm_ConfigType, ConfigPtrName=NULL_PTR, ConfigPtrClass=DCM_CONST, ModuleRef=Dcm
          Dcm_InitMemory: Header=Dcm.h, InitPhase=INIT_MEMORY, ModuleRef=Dcm
          Dem_Init: Header=Dem.h, InitPhase=INIT_TWO_POST_NVMREADALL, ConfigType=Dem_ConfigType, ConfigPtrName=Dem_Config_Ptr, ConfigPtrClass=DEM_INIT_DATA, ModuleRef=Dem
          Dem_InitMemory: Header=Dem.h, InitPhase=INIT_MEMORY, ModuleRef=Dem
          Dem_PreInit: Header=Dem.h, InitPhase=INIT_ZERO, ConfigType=Dem_ConfigType, ConfigPtrName=Dem_Config_Ptr, ConfigPtrClass=DEM_INIT_DATA, ModuleRef=Dem
          Det_InitMemory: Header=Det.h, InitPhase=INIT_MEMORY, ModuleRef=Det
          Det_Init: Header=Det.h, InitPhase=INIT_ZERO, ConfigType=Det_ConfigType, ConfigPtrName=Det_Config_Ptr, ConfigPtrClass=DET_INIT_DATA, ModuleRef=Det
          EcuM_Init: Header=EcuM.h, InitPhase=NO_INIT, ConfigType=EcuM_PbConfigType, ConfigPtrName=EcuM_Config_Ptr, ConfigPtrClass=ECUM_INIT_DATA, ModuleRef=EcuM
          Nm_Init: Header=Nm.h, InitPhase=INIT_TWO_NM, ModuleRef=Nm
          Nm_InitMemory: Header=Nm.h, InitPhase=INIT_MEMORY, ModuleRef=Nm
          PduR_Init: Header=PduR.h, InitPhase=INIT_TWO_COM, ConfigType=PduR_PBConfigType, ConfigPtrName=PduR_Config_Ptr, ConfigPtrClass=PDUR_INIT_DATA, ModuleRef=PduR
          PduR_InitMemory: Header=PduR.h, InitPhase=INIT_MEMORY, ModuleRef=PduR
          Rte_InitMemory: Header=Rte_Main.h, InitPhase=INIT_MEMORY, ModuleRef=Rte
          SchM_Init: Header=Rte_Main.h, InitPhase=NO_INIT, ModuleRef=Rte
          Xcp_InitMemory: Header=Xcp.h, InitPhase=INIT_MEMORY, ModuleRef=Xcp
          Xcp_Init: Header=Xcp.h, InitPhase=INIT_TWO_TP, ModuleRef=Xcp
          Mcu_Init: Header=Mcu.h, InitPhase=INIT_ONE_EARLY, ConfigType=Mcu_ConfigType, ConfigPtrName=Mcu_ConfigRoot, ConfigPtrClass=const, ModuleRef=Mcu
          Adc_Init: Header=Adc.h, InitPhase=INIT_ONE_LATE, ConfigType=Adc_ConfigType, ConfigPtrName=Adc_ConfigRoot, ConfigPtrClass=const, ModuleRef=Adc
          Dio_Init: Header=Dio.h, InitPhase=INIT_ONE, ConfigType=Dio_ConfigType, ConfigPtrName=Dio_ConfigRoot, ConfigPtrClass=const, ModuleRef=Dio
          Fls_17_Pmu_Init: Header=Fls_17_Pmu.h, InitPhase=INIT_ONE, ConfigType=Fls_17_Pmu_ConfigType, ConfigPtrName=Fls_17_Pmu_ConfigRoot, ConfigPtrClass=const, ModuleRef=Fls
          Gpt_Init: Header=Gpt.h, InitPhase=INIT_ONE, ConfigType=Gpt_ConfigType, ConfigPtrName=Gpt_ConfigRoot, ConfigPtrClass=const, ModuleRef=Gpt
          Icu_17_GtmCcu6_Init: Header=Icu_17_GtmCcu6.h, InitPhase=INIT_ONE_LATE, ConfigType=Icu_17_GtmCcu6_ConfigType, ConfigPtrName=Icu_ConfigRoot, ConfigPtrClass=const, ModuleRef=Icu
          Port_Init: Header=Port.h, InitPhase=INIT_ONE_EARLY, ConfigType=Port_ConfigType, ConfigPtrName=Port_ConfigRoot, ConfigPtrClass=const, ModuleRef=Port
          Pwm_17_Gtm_Init: Header=Pwm_17_Gtm.h, InitPhase=INIT_ONE, ConfigType=Pwm_17_Gtm_ConfigType, ConfigPtrName=Pwm_ConfigRoot, ConfigPtrClass=const, ModuleRef=Pwm
          Spi_Init: Header=Spi.h, InitPhase=INIT_ONE, ConfigType=Spi_ConfigType, ConfigPtrName=Spi_ConfigRoot, ConfigPtrClass=const, ModuleRef=Spi
          Wdg_17_Scu_Init: Header=Wdg_17_Scu.h, InitPhase=INIT_ONE, ConfigType=Wdg_17_Scu_ConfigType, ConfigPtrName=Wdg_ConfigRoot, ConfigPtrClass=const, ModuleRef=Wdg
          IoHwAb_Init: Header=IoHwAb.h, InitPhase=INIT_TWO_POST_NVMREADALL, ModuleRef=IoHwAb
          NvM_Init: Header=NvM.h, InitPhase=INIT_TWO_SYS, ModuleRef=NvM
          WdgM_Init: Header=WdgM.h, InitPhase=INIT_TWO_IF, ConfigType=WdgM_ConfigType, ConfigPtrName=&WdgMConfig_Mode0_core0, ConfigPtrClass=WDGM_APPL_CONST, ModuleRef=WdgM
          CanXcp_InitMemory: Header=CanXcp.h, InitPhase=INIT_MEMORY, ModuleRef=Xcp
          CanXcp_Init: Header=CanXcp.h, InitPhase=INIT_TWO_TP, ConfigType=CanXcp_ConfigType, ConfigPtrName=NULL_PTR, ConfigPtrClass=CANXCP_CONST, ModuleRef=Xcp
    EcucHardware
      Core0 (EcucCoreDefinition): EcucCoreId=0
    EcucPduCollection: PduIdTypeEnum=UINT8, PduLengthTypeEnum=UINT16
      25 x Pdu, all with J1939Requestable=false:
        PT_msg_TxCycle1000_10_PP_msg_TxCycle1000_10_Tx_346f2748_fe6ecc87: PduLength=2, SysTPduToFrameMappingRef=msg_TxCycle1000_10  # msg_TxCycle1000_10_oCAN
        PT_msg_TxEvent_10_PP_msg_TxEvent_10_Tx_346f2748_fe6ecc87: PduLength=7, SysTPduToFrameMappingRef=msg_TxEvent_10  # msg_TxEvent_10_oCAN
        PT_msg_diag_RequestGlobal_PP_msg_diag_RequestGlobal_Rx_346f2748_fe6ecc87: PduLength=7  # msg_diag_RequestGlobal_oCAN
        PT_msg_diag_RequestGlobal_Tp_PP_msg_diag_RequestGlobal_Tp_Rx_346f2748_fe6ecc87: PduLength=8, SysTPduToFrameMappingRef=msg_diag_RequestGlobal_Tp  # msg_diag_RequestGlobal_Tp_oCAN
        PT_msg_RxCycle500_20_PP_msg_RxCycle500_20_Rx_346f2748_fe6ecc87: PduLength=6, SysTPduToFrameMappingRef=msg_RxCycle500_20  # msg_RxCycle500_20_oCAN
        PT_msg_XCP_Request_MyECU_PP_msg_XCP_Request_MyECU_Rx_346f2748_fe6ecc87: PduLength=8, SysTPduToFrameMappingRef=msg_XCP_Request_MyECU  # msg_XCP_Request_MyECU_oCAN
        PT_msg_TxCycle_E2eProf1C_500_30_PP_msg_TxCycle_E2eProf1C_500_30_Tx_346f2748_fe6ecc87: PduLength=8, SysTPduToFrameMappingRef=msg_TxCycle_E2eProf1C_500_30  # msg_TxCycle_E2eProf1C_500_30_oCAN
        PT_msg_diag_Response_MyECU_Slave3_PP_msg_diag_Response_MyECU_Slave3_Tx_346f2748_fe6ecc87: PduLength=8, SysTPduToFrameMappingRef=msg_diag_Response_MyECU_Slave3  # msg_diag_Response_MyECU_Slave3_oCAN
        PT_msg_diag_Request_MyECU_Tp_PP_msg_diag_Request_MyECU_Tp_Rx_346f2748_fe6ecc87: PduLength=8, SysTPduToFrameMappingRef=msg_diag_Request_MyECU_Tp  # msg_diag_Request_MyECU_Tp_oCAN
        PT_GlobalTimeMaster_PP_GlobalTimeMaster_Rx_346f2748_fe6ecc87: PduLength=8, SysTPduToFrameMappingRef=GlobalTimeMaster  # GlobalTimeMaster_oCAN
        PT_msg_diag_Request_MyECU_Slave3_PP_msg_diag_Request_MyECU_Slave3_Rx_346f2748_fe6ecc87: PduLength=8, SysTPduToFrameMappingRef=msg_diag_Request_MyECU_Slave3  # msg_diag_Request_MyECU_Slave3_oCAN
        PT_msg_XCP_Response_MyECU_PP_msg_XCP_Response_MyECU_Tx_346f2748_fe6ecc87: PduLength=8, SysTPduToFrameMappingRef=msg_XCP_Response_MyECU  # msg_XCP_Response_MyECU_oCAN
        PT_msg_diag_Response_MyECU_PP_msg_diag_Response_MyECU_Tx_346f2748_fe6ecc87: PduLength=8  # msg_diag_Response_MyECU_oCAN
        PT_msg_nm_MyECU_PP_msg_nm_MyECU_Tx_346f2748_fe6ecc87: PduLength=8, SysTPduToFrameMappingRef=msg_nm_MyECU  # msg_nm_MyECU_oCAN
        PT_msg_diag_Uudt_Response_MyECU_PP_msg_diag_Uudt_Response_MyECU_Tx_346f2748_fe6ecc87: PduLength=8, SysTPduToFrameMappingRef=msg_diag_Uudt_Response_MyECU  # msg_diag_Uudt_Response_MyECU_oCAN
        PT_msg_RxEvent_20_PP_msg_RxEvent_20_Rx_346f2748_fe6ecc87: PduLength=4, SysTPduToFrameMappingRef=msg_RxEvent_20  # msg_RxEvent_20_oCAN
        PT_msg_diag_Response_MyECU_Tp_PP_msg_diag_Response_MyECU_Tp_Tx_346f2748_fe6ecc87: PduLength=8, SysTPduToFrameMappingRef=msg_diag_Response_MyECU_Tp  # msg_diag_Response_MyECU_Tp_oCAN
        PT_msg_RxCycle100_0_PP_msg_RxCycle100_0_Rx_346f2748_fe6ecc87: PduLength=1, SysTPduToFrameMappingRef=msg_RxCycle100_0  # msg_RxCycle100_0_oCAN
        PT_msg_StartAppl_Rx_MyECU_PP_msg_StartAppl_Rx_MyECU_Rx_346f2748_fe6ecc87: PduLength=8, SysTPduToFrameMappingRef=msg_StartAppl_Rx_MyECU  # msg_StartAppl_Rx_MyECU_oCAN
        NmUsrData_msg_nm_MyECU_oCAN_3abd61be: PduLength=6  # msg_nm_MyECU_oCAN
        PT_msg_diag_Request_MyECU_PP_msg_diag_Request_MyECU_Rx_346f2748_fe6ecc87: PduLength=8  # msg_diag_Request_MyECU_oCAN
        PT_msg_StartAppl_Tx_MyECU_PP_msg_StartAppl_Tx_MyECU_Tx_346f2748_fe6ecc87: PduLength=8, SysTPduToFrameMappingRef=msg_StartAppl_Tx_MyECU  # msg_StartAppl_Tx_MyECU_oCAN
        MyECU_NmRxPdu_5f8bc0cc: PduLength=8
        PT_msg_RxCycle_E2eProf1C_500_10_PP_msg_RxCycle_E2eProf1C_500_10_Rx_346f2748_fe6ecc87: PduLength=8, SysTPduToFrameMappingRef=msg_RxCycle_E2eProf1C_500_10  # msg_RxCycle_E2eProf1C_500_10_oCAN
        PT_msg_TxCycle10_0_PP_msg_TxCycle10_0_Tx_346f2748_fe6ecc87: PduLength=7, SysTPduToFrameMappingRef=msg_TxCycle10_0  # msg_TxCycle10_0_oCAN
  module config Brs: implementation-config-variant=VARIANT-PRE-COMPILE, module-description=Brs_Impl
    BrsGeneral:
      BrsEnableTgfSupport = false
      BrsEnableOsSupport = true
      BrsEnableOsEmulation = false
      BrsEnableTfwSupport = false
      BrsEnableSupportLEDs = false
      BrsEnableSafeContextSupport = false
      BrsEnableMcalTrustedOnly = false
      BrsEnableMultiCoreSupport = false
      BrsEnableSafeWdgSupport = false
      BrsEnableSafeWdgMultiCoreSupport = false
      BrsEnableHLPTestSupport = false
      BrsEnableTcmSupport = false
      BrsEnableExternalWakeup = false
  module config Com: implementation-config-variant=VARIANT-PRE-COMPILE, module-description=Com_Impl
    ComGeneration:
      ComOutOfBoundsWriteProtectionStrategy = NONE
      ComOutOfBoundsWriteSanitizer = false
      ComOutOfBoundsReadSanitizer = false
      ComReduceConstantData2Define = false
      ComBoolDataInArrayOfStructStrategy = BOOLEAN
      ComDeduplicateIndirectedData = true
      ComDataDeduplicationStrategy = WITH_CAST
      ComReduceBoolDataByNegationThreshold = 2
      ComReduceBoolDataByNumericalComparisonThreshold = 2
      ComReduceBoolDataByNumericalRelationThreshold = 2
      ComReduceBoolDataByNumericalOperandStrategy = WITH_ANY_VALUE
      ComReduceNumericalDataByOffsetThreshold = 2
      ComReduceNumericalDataByArraySubtractionThreshold = 2
      ComReduceDataByStreaming = false
      ComShortSymbols = false
      ComInterfacesForDeactivatedData = false
      ComReferringKeysInComments = false
    ComOptimization:
      ComTxCyclicProcessingISRLockThreshold = 1
      ComTxDeadlineMonitoringISRLockThreshold = 1
      ComTxProcessingISRLockThreshold = 1
      ComRxDeadlineMonitoringISRLockThreshold = 1
      ComRxDeferredProcessingISRLockThreshold = 1
      ComGatewayProcessingISRLockThreshold = 1
      ComGatewayDescriptionProcessingISRLockThreshold = 1
      ComIPduGroupISRLockThreshold = 1
    ComConfig: ComConfigurationId=0, ComRxDeferredNotificationCacheSize=1, ComRxImmediateNotificationCacheSize=0
      Signal_Tx4bit_Cyclic_d74aed68 (ComSignal):
        ComBitPosition = 10
        ComBitSize = 4
        ComSignalEndianness = LITTLE_ENDIAN
        ComSignalInitValue = 0
        ComSignalType = UINT8
        ComTransferProperty = PENDING
        ComSignalAccess = ACCESS_NOT_NEEDED
        ComSystemTemplateSystemSignalRef = Signal_Tx4bit_Cyclic
      msg_TxCycle_E2eProf1C_500_30_oCAN_3abd61be (ComIPdu):
        ComIPduDirection = SEND
        ComIPduType = NORMAL
        ComIPduHandleId = 3
        ComIPduSignalProcessing = DEFERRED
        ComIPduCancellationSupport = false
        ComIPduGroupRef = MyECU_oCAN_Tx_fcef2243
        ComIPduSignalGroupRef = SG_SgTx_Prof1C_TxCycle_eeefc687
        ComPduIdRef = PT_msg_TxCycle_E2eProf1C_500_30_PP_msg_TxCycle_E2eProf1C_500_30_Tx_346f2748_fe6ecc87
        ComTxIPdu: ComMinimumDelayTime=0, ComTxIPduUnusedAreasDefault=0
          ComTxModeTrue
            ComTxMode: ComTxModeMode=PERIODIC, ComTxModeTimeOffset=0.03, ComTxModeTimePeriod=0.5
          ComTxModeFalse
            ComTxMode: ComTxModeMode=PERIODIC, ComTxModeTimeOffset=0.03, ComTxModeTimePeriod=0.5
      Signal_Rx8bit_Cyclic_a691adb3 (ComSignal):
        ComBitPosition = 0
        ComBitSize = 8
        ComSignalEndianness = LITTLE_ENDIAN
        ComSignalInitValue = 15
        ComSignalType = UINT8
        ComTimeout = 0
        ComSignalAccess = ACCESS_NOT_NEEDED
        ComSystemTemplateSystemSignalRef = Signal_Rx8bit_Cyclic
      msg_RxEvent_20_oCAN_3abd61be (ComIPdu):
        ComIPduDirection = RECEIVE
        ComIPduType = NORMAL
        ComIPduHandleId = 3
        ComIPduSignalProcessing = DEFERRED
        ComIPduCancellationSupport = false
        ComIPduGroupRef = MyECU_oCAN_Rx_fcef2243
        ComIPduSignalRef = Signal_Rx11bit_OnWrite_a1df81ad
        ComIPduSignalRef = Signal_Rx15bit_OnWrite_a1df81ad
        ComPduIdRef = PT_msg_RxEvent_20_PP_msg_RxEvent_20_Rx_346f2748_fe6ecc87
      3 x ComSignal, all with ComSignalEndianness=LITTLE_ENDIAN, ComTimeout=0, ComSignalAccess=ACCESS_NOT_NEEDED:
        Signal_StartAppl_RxCtrl_MyECU_0da3c1e2: ComBitPosition=0, ComBitSize=8, ComSignalInitValue=0, ComSignalType=UINT8, ComSystemTemplateSystemSignalRef=Signal_StartAppl_RxCtrl_MyECU
        Signal_RearLeftDoor_1e247d16: ComBitPosition=1, ComBitSize=1, ComSignalInitValue=0, ComSignalType=BOOLEAN, ComSystemTemplateSystemSignalRef=Signal_RearLeftDoor
        Signal_Rx11bit_OnWrite_a1df81ad: ComBitPosition=0, ComBitSize=11, ComSignalInitValue=50, ComSignalType=UINT16, ComSystemTemplateSystemSignalRef=Signal_Rx11bit_OnWrite
      MyECU_oCAN_Tx_fcef2243 (ComIPduGroup): ComIPduGroupHandleId=1
      msg_RxCycle_E2eProf1C_500_10_oCAN_3abd61be (ComIPdu):
        ComIPduDirection = RECEIVE
        ComIPduType = NORMAL
        ComIPduHandleId = 2
        ComIPduSignalProcessing = DEFERRED
        ComIPduCancellationSupport = false
        ComIPduGroupRef = MyECU_oCAN_Rx_fcef2243
        ComIPduSignalGroupRef = SG_RgRx_Prof1C_RxCycle_e8110737
        ComPduIdRef = PT_msg_RxCycle_E2eProf1C_500_10_PP_msg_RxCycle_E2eProf1C_500_10_Rx_346f2748_fe6ecc87
      msg_RxCycle500_20_oCAN_3abd61be (ComIPdu):
        ComIPduDirection = RECEIVE
        ComIPduType = NORMAL
        ComIPduHandleId = 1
        ComIPduSignalProcessing = DEFERRED
        ComIPduCancellationSupport = false
        ComIPduGroupRef = MyECU_oCAN_Rx_fcef2243
        ComIPduSignalRef = Signal_Rx16bit_Cyclic_a691adb3
        ComIPduSignalRef = Signal_Rx20bit_Cyclic_a691adb3
        ComIPduSignalRef = Signal_Rx8bit_Cyclic_a691adb3
        ComPduIdRef = PT_msg_RxCycle500_20_PP_msg_RxCycle500_20_Rx_346f2748_fe6ecc87
      Signal_Tx24bit_Cyclic_85bf3e37 (ComSignal):
        ComBitPosition = 32
        ComBitSize = 24
        ComSignalEndianness = LITTLE_ENDIAN
        ComSignalInitValue = 0
        ComSignalType = UINT32
        ComTransferProperty = PENDING
        ComSignalAccess = ACCESS_NEEDED_BY_SWC_OR_COM
        ComHandleId = 0
        ComSystemTemplateSystemSignalRef = Signal_Tx24bit_Cyclic
      Signal_Tx24bit_OnWrite_b2cd4fc2 (ComSignal):
        ComBitPosition = 32
        ComBitSize = 24
        ComSignalEndianness = LITTLE_ENDIAN
        ComSignalInitValue = 63
        ComSignalType = UINT32
        ComTransferProperty = TRIGGERED_WITHOUT_REPETITION
        ComSignalAccess = ACCESS_NOT_NEEDED
        ComSystemTemplateSystemSignalRef = Signal_Tx24bit_OnWrite
      msg_TxCycle10_0_oCAN_3abd61be (ComIPdu):
        ComIPduDirection = SEND
        ComIPduType = NORMAL
        ComIPduHandleId = 1
        ComIPduSignalProcessing = DEFERRED
        ComIPduCancellationSupport = false
        ComIPduGroupRef = MyECU_oCAN_Tx_fcef2243
        ComIPduSignalRef = Signal_Tx24bit_Cyclic_85bf3e37
        ComIPduSignalRef = Signal_Tx32bit_Cyclic_85bf3e37
        ComPduIdRef = PT_msg_TxCycle10_0_PP_msg_TxCycle10_0_Tx_346f2748_fe6ecc87
        ComTxIPdu: ComMinimumDelayTime=0, ComTxIPduUnusedAreasDefault=0
          ComTxModeTrue
            ComTxMode: ComTxModeMode=PERIODIC, ComTxModeTimeOffset=0, ComTxModeTimePeriod=0.01
          ComTxModeFalse
            ComTxMode: ComTxModeMode=PERIODIC, ComTxModeTimeOffset=0, ComTxModeTimePeriod=0.01
      msg_TxCycle1000_10_oCAN_3abd61be (ComIPdu):
        ComIPduDirection = SEND
        ComIPduType = NORMAL
        ComIPduHandleId = 2
        ComIPduSignalProcessing = DEFERRED
        ComIPduCancellationSupport = false
        ComIPduGroupRef = MyECU_oCAN_Tx_fcef2243
        ComIPduSignalRef = Signal_Tx10bit_Cyclic_d74aed68
        ComIPduSignalRef = Signal_Tx4bit_Cyclic_d74aed68
        ComPduIdRef = PT_msg_TxCycle1000_10_PP_msg_TxCycle1000_10_Tx_346f2748_fe6ecc87
        ComTxIPdu: ComMinimumDelayTime=0, ComTxIPduUnusedAreasDefault=0
          ComTxModeTrue
            ComTxMode: ComTxModeMode=PERIODIC, ComTxModeTimeOffset=0.01, ComTxModeTimePeriod=1
          ComTxModeFalse
            ComTxMode: ComTxModeMode=PERIODIC, ComTxModeTimeOffset=0.01, ComTxModeTimePeriod=1
      Signal_Rx15bit_OnWrite_a1df81ad (ComSignal):
        ComBitPosition = 12
        ComBitSize = 15
        ComSignalEndianness = LITTLE_ENDIAN
        ComSignalInitValue = 25
        ComSignalType = UINT16
        ComTimeout = 0
        ComSignalAccess = ACCESS_NEEDED_BY_SWC_OR_COM
        ComHandleId = 0
        ComNotification = Rte_COMCbk_Signal_Rx15bit_OnWrite_a1df81ad
        ComSystemTemplateSystemSignalRef = Signal_Rx15bit_OnWrite
      Signal_StartAppl_RxData_MyECU_0da3c1e2 (ComSignal):
        ComBitPosition = 8
        ComBitSize = 8
        ComSignalEndianness = LITTLE_ENDIAN
        ComSignalInitValue = 0
        ComSignalType = UINT8
        ComTimeout = 0
        ComSignalAccess = ACCESS_NOT_NEEDED
        ComSystemTemplateSystemSignalRef = Signal_StartAppl_RxData_MyECU
      SG_RgRx_Prof1C_RxCycle_e8110737 (ComSignalGroup): ComTimeout=0, ComTransferProperty=PENDING, ComSignalGroupAccess=ACCESS_NOT_NEEDED, ComSystemTemplateSignalGroupRef=SG_RgRx_Prof1C_RxCycle
        6 x ComGroupSignal, all with ComSignalEndianness=LITTLE_ENDIAN, ComSignalInitValue=0, ComSignalAccess=ACCESS_NOT_NEEDED:
          SigRx_Prof1C_Sig32Bit_0fb90f33: ComBitPosition=24, ComBitSize=32, ComSignalType=UINT32, ComSystemTemplateSystemSignalRef=SigRx_Prof1C_Sig32Bit
          SigRx_Prof1C_Sig4Bit_0fb90f33: ComBitPosition=16, ComBitSize=4, ComSignalType=UINT8, ComSystemTemplateSystemSignalRef=SigRx_Prof1C_Sig4Bit
          SigRx_Prof1C_DataId_HiByte_LoNib_0fb90f33: ComBitPosition=12, ComBitSize=4, ComSignalType=UINT8, ComSystemTemplateSystemSignalRef=SigRx_Prof1C_DataId_HiByte_LoNib
          SigRx_Prof1C_SQ_0fb90f33: ComBitPosition=8, ComBitSize=4, ComSignalType=UINT8, ComSystemTemplateSystemSignalRef=SigRx_Prof1C_SQ
          SigRx_Prof1C_CRC_0fb90f33: ComBitPosition=0, ComBitSize=8, ComSignalType=UINT8, ComSystemTemplateSystemSignalRef=SigRx_Prof1C_CRC
          SigRx_Prof1C_Sig3Bit_0fb90f33: ComBitPosition=21, ComBitSize=3, ComSignalType=UINT8, ComSystemTemplateSystemSignalRef=SigRx_Prof1C_Sig3Bit
      Signal_RearRightDoor_1e247d16 (ComSignal):
        ComBitPosition = 2
        ComBitSize = 1
        ComSignalEndianness = LITTLE_ENDIAN
        ComSignalInitValue = 0
        ComSignalType = BOOLEAN
        ComTimeout = 0
        ComSignalAccess = ACCESS_NOT_NEEDED
        ComSystemTemplateSystemSignalRef = Signal_RearRightDoor
      3 x ComIPdu, all with ComIPduType=NORMAL, ComIPduSignalProcessing=DEFERRED, ComIPduCancellationSupport=false:
        msg_RxCycle100_0_oCAN_3abd61be: ComIPduDirection=RECEIVE, ComIPduHandleId=0, ComIPduGroupRef=MyECU_oCAN_Rx_fcef2243, ComIPduSignalRef=Signal_RearInteriorLight_1e247d16, ComIPduSignalRef=Signal_RearLeftDoor_1e247d16, ComIPduSignalRef=Signal_RearRightDoor_1e247d16, ComPduIdRef=PT_msg_RxCycle100_0_PP_msg_RxCycle100_0_Rx_346f2748_fe6ecc87
        msg_TxEvent_10_oCAN_3abd61be: ComIPduDirection=SEND, ComIPduHandleId=4, ComIPduGroupRef=MyECU_oCAN_Tx_fcef2243, ComIPduSignalRef=Signal_Tx24bit_OnWrite_b2cd4fc2, ComIPduSignalRef=Signal_Tx32bit_OnWrite_b2cd4fc2, ComPduIdRef=PT_msg_TxEvent_10_PP_msg_TxEvent_10_Tx_346f2748_fe6ecc87
          ComTxIPdu: ComMinimumDelayTime=0, ComTxIPduUnusedAreasDefault=0
            ComTxModeTrue
              ComTxMode: ComTxModeMode=DIRECT, ComTxModeNumberOfRepetitions=0, ComTxModeRepetitionPeriod=0
            ComTxModeFalse
              ComTxMode: ComTxModeMode=DIRECT, ComTxModeNumberOfRepetitions=0, ComTxModeRepetitionPeriod=0
        msg_StartAppl_Rx_MyECU_oCAN_3abd61be: ComIPduDirection=RECEIVE, ComIPduHandleId=4, ComIPduGroupRef=MyECU_oCAN_Rx_fcef2243, ComIPduSignalRef=Signal_StartAppl_RxCtrl_MyECU_0da3c1e2, ComIPduSignalRef=Signal_StartAppl_RxData_MyECU_0da3c1e2, ComPduIdRef=PT_msg_StartAppl_Rx_MyECU_PP_msg_StartAppl_Rx_MyECU_Rx_346f2748_fe6ecc87
      ComTimeBase: ComRxTimeBase=0.01, ComTxTimeBase=0.01, ComGwTimeBase=0.01
      3 x ComSignal, all with ComSignalEndianness=LITTLE_ENDIAN:
        Signal_Rx16bit_Cyclic_a691adb3: ComBitPosition=32, ComBitSize=16, ComSignalInitValue=32768, ComSignalType=UINT16, ComTimeout=0, ComSignalAccess=ACCESS_NEEDED_BY_SWC_OR_COM, ComHandleId=1, ComNotification=Rte_COMCbk_Signal_Rx16bit_Cyclic_a691adb3, ComSystemTemplateSystemSignalRef=Signal_Rx16bit_Cyclic
        NmUd_MyECU_32bit_c97b60cc: ComBitPosition=16, ComBitSize=32, ComSignalInitValue=0, ComSignalType=UINT32, ComTransferProperty=PENDING, ComSignalAccess=ACCESS_NOT_NEEDED, ComSystemTemplateSystemSignalRef=NmUd_MyECU_32bit
        Signal_Tx32bit_OnWrite_b2cd4fc2: ComBitPosition=0, ComBitSize=32, ComSignalInitValue=31, ComSignalType=UINT32, ComTransferProperty=TRIGGERED_WITHOUT_REPETITION, ComSignalAccess=ACCESS_NEEDED_BY_SWC_OR_COM, ComHandleId=1, ComSystemTemplateSystemSignalRef=Signal_Tx32bit_OnWrite
      SG_SgTx_Prof1C_TxCycle_eeefc687 (ComSignalGroup): ComTransferProperty=PENDING, ComSignalGroupAccess=ACCESS_NOT_NEEDED, ComSystemTemplateSignalGroupRef=SG_SgTx_Prof1C_TxCycle
        7 x ComGroupSignal, all with ComSignalEndianness=LITTLE_ENDIAN, ComSignalInitValue=0, ComTransferProperty=PENDING, ComSignalAccess=ACCESS_NOT_NEEDED:
          SigTx_Prof1C_SQ_06e38486: ComBitPosition=8, ComBitSize=4, ComSignalType=UINT8, ComSystemTemplateSystemSignalRef=SigTx_Prof1C_SQ
          SigTx_Prof1C_Sig2Bit_06e38486: ComBitPosition=30, ComBitSize=2, ComSignalType=UINT8, ComSystemTemplateSystemSignalRef=SigTx_Prof1C_Sig2Bit
          SigTx_Prof1C_Sig4Bit_06e38486: ComBitPosition=16, ComBitSize=4, ComSignalType=UINT8, ComSystemTemplateSystemSignalRef=SigTx_Prof1C_Sig4Bit
          SigTx_Prof1C_DataId_HiByte_LoNib_06e38486: ComBitPosition=12, ComBitSize=4, ComSignalType=UINT8, ComSystemTemplateSystemSignalRef=SigTx_Prof1C_DataId_HiByte_LoNib
          SigTx_Prof1C_Sig8Bit_06e38486: ComBitPosition=48, ComBitSize=8, ComSignalType=UINT8, ComSystemTemplateSystemSignalRef=SigTx_Prof1C_Sig8Bit
          SigTx_Prof1C_CRC_06e38486: ComBitPosition=0, ComBitSize=8, ComSignalType=UINT8, ComSystemTemplateSystemSignalRef=SigTx_Prof1C_CRC
          SigTx_Prof1C_Sig16Bit_06e38486: ComBitPosition=32, ComBitSize=16, ComSignalType=UINT16, ComSystemTemplateSystemSignalRef=SigTx_Prof1C_Sig16Bit
      msg_StartAppl_Tx_MyECU_oCAN_3abd61be (ComIPdu):
        ComIPduDirection = SEND
        ComIPduType = NORMAL
        ComIPduHandleId = 0
        ComIPduSignalProcessing = DEFERRED
        ComIPduCancellationSupport = false
        ComIPduGroupRef = MyECU_oCAN_Tx_fcef2243
        ComIPduSignalRef = Signal_StartAppl_TxCtrl_MyECU_ad461e3f
        ComIPduSignalRef = Signal_StartAppl_TxData_MyECU_ad461e3f
        ComPduIdRef = PT_msg_StartAppl_Tx_MyECU_PP_msg_StartAppl_Tx_MyECU_Tx_346f2748_fe6ecc87
        ComTxIPdu: ComMinimumDelayTime=0, ComTxIPduUnusedAreasDefault=0
          ComTxModeTrue
            ComTxMode: ComTxModeMode=PERIODIC, ComTxModeTimeOffset=0, ComTxModeTimePeriod=0.05
          ComTxModeFalse
            ComTxMode: ComTxModeMode=PERIODIC, ComTxModeTimeOffset=0, ComTxModeTimePeriod=0.05
      Signal_Rx20bit_Cyclic_a691adb3 (ComSignal):
        ComBitPosition = 8
        ComBitSize = 20
        ComSignalEndianness = LITTLE_ENDIAN
        ComSignalInitValue = 1
        ComSignalType = UINT32
        ComTimeout = 0
        ComSignalAccess = ACCESS_NOT_NEEDED
        ComSystemTemplateSystemSignalRef = Signal_Rx20bit_Cyclic
      msg_nm_MyECU_oCAN_3abd61be (ComIPdu):
        ComIPduDirection = SEND
        ComIPduType = NORMAL
        ComIPduHandleId = 5
        ComIPduSignalProcessing = DEFERRED
        ComIPduCancellationSupport = false
        ComIPduSignalRef = NmUd_MyECU_16bit_c97b60cc
        ComIPduSignalRef = NmUd_MyECU_32bit_c97b60cc
        ComPduIdRef = EcucPduCollection/NmUsrData_msg_nm_MyECU_oCAN_3abd61be
        ComTxIPdu: ComTxIPduUnusedAreasDefault=0, ComMinimumDelayTime=0
          ComTxModeTrue
            ComTxMode: ComTxModeMode=NONE
          ComTxModeFalse
            ComTxMode: ComTxModeMode=NONE
      Signal_StartAppl_TxCtrl_MyECU_ad461e3f (ComSignal):
        ComBitPosition = 0
        ComBitSize = 8
        ComSignalEndianness = LITTLE_ENDIAN
        ComSignalInitValue = 0
        ComSignalType = UINT8
        ComTransferProperty = PENDING
        ComSignalAccess = ACCESS_NOT_NEEDED
        ComSystemTemplateSystemSignalRef = Signal_StartAppl_TxCtrl_MyECU
      Signal_StartAppl_TxData_MyECU_ad461e3f (ComSignal):
        ComBitPosition = 8
        ComBitSize = 8
        ComSignalEndianness = LITTLE_ENDIAN
        ComSignalInitValue = 0
        ComSignalType = UINT8
        ComTransferProperty = PENDING
        ComSignalAccess = ACCESS_NOT_NEEDED
        ComSystemTemplateSystemSignalRef = Signal_StartAppl_TxData_MyECU
      MyECU_oCAN_Rx_fcef2243 (ComIPduGroup): ComIPduGroupHandleId=0
      4 x ComSignal, all with ComBitPosition=0, ComSignalEndianness=LITTLE_ENDIAN, ComSignalInitValue=0, ComSignalAccess=ACCESS_NOT_NEEDED:
        Signal_Tx10bit_Cyclic_d74aed68: ComBitSize=10, ComSignalType=UINT16, ComTransferProperty=PENDING, ComSystemTemplateSystemSignalRef=Signal_Tx10bit_Cyclic
        NmUd_MyECU_16bit_c97b60cc: ComBitSize=16, ComSignalType=UINT16, ComTransferProperty=PENDING, ComSystemTemplateSystemSignalRef=NmUd_MyECU_16bit
        Signal_Tx32bit_Cyclic_85bf3e37: ComBitSize=32, ComSignalType=UINT32, ComTransferProperty=PENDING, ComSystemTemplateSystemSignalRef=Signal_Tx32bit_Cyclic
        Signal_RearInteriorLight_1e247d16: ComBitSize=1, ComSignalType=BOOLEAN, ComTimeout=0, ComSystemTemplateSystemSignalRef=Signal_RearInteriorLight
    ComGeneral:
      ComConfigurationUseDet = true
      ComEnableSignalGroupArrayApi = false
      ComRetryFailedTransmitRequests = true
      ComSupportedIPduGroups = 2
      ComVersionInfoApi = false
      ComAdvancedIPduCallouts = true
      ComOptimizedIPduGroupHandling = false
      ComMetaDataSupport = false
      ComReceiveSignalMacroAPI = false
      ComDeferredEventCacheSupport = false
      ComMainfunctionTimingDomainSupport = false
      ComDescriptionRoutingCodeGeneration = false
      ComSafeBswChecks = false
      ComUserCbkHeaderFile = Rte_Cbk.h
  module config Rte: implementation-config-variant=VARIANT-PRE-COMPILE, module-description=Rte_Impl
    RteInitializationBehavior: RteInitializationStrategy=RTE_INITIALIZATION_STRATEGY_AT_DATA_DECLARATION, RteSectionInitializationPolicy=INIT
    RteGeneration:
      RteGenerationMode = COMPATIBILITY_MODE
      RteIocInteractionReturnValue = RTE_IOC
      RteValueRangeCheckEnabled = false
      RteCalibrationSupport = INITIALIZED_RAM
      RteCodeVendorId = 30
      RteDevErrorDetect = true
      RteDevErrorDetectUninit = false
      RteMeasurementSupport = true
      RteOptimizationMode = MEMORY
      RteVfbTraceEnabled = false
      RteXcpEventSupport = true
    RteBswGeneral: RteSchMVersionInfoApi=false, RteUseComShadowSignalApi=false
    RteOsInteraction
      7 x RteUsedOsActivation, all with RteExpectedActivationOffset=0, RteExpectedTickDuration=0:
        Rte_Al_TE2_Default_BSW_Async_Task_0_10ms: RteActivationOsAlarmRef=Os/Rte_Al_TE2_Default_BSW_Async_Task_0_10ms, RteActivationOsTaskRef=Default_BSW_Async_Task
        Rte_Al_TE2_Default_BSW_Async_Task_0_20ms: RteActivationOsAlarmRef=Os/Rte_Al_TE2_Default_BSW_Async_Task_0_20ms, RteActivationOsTaskRef=Default_BSW_Async_Task
        Rte_Al_TE2_Default_BSW_Async_Task_0_5ms: RteActivationOsAlarmRef=Os/Rte_Al_TE2_Default_BSW_Async_Task_0_5ms, RteActivationOsTaskRef=Default_BSW_Async_Task
        Rte_Al_TE_StartApplication_StartApplication_Cyclic1000ms: RteActivationOsAlarmRef=Os/Rte_Al_TE_StartApplication_StartApplication_Cyclic1000ms, RteActivationOsTaskRef=Default_Appl_Task
        Rte_Al_TE_StartApplication_StartApplication_Cyclic10ms: RteActivationOsAlarmRef=Os/Rte_Al_TE_StartApplication_StartApplication_Cyclic10ms, RteActivationOsTaskRef=Default_Appl_Task
        Rte_Al_TE_StartApplication_StartApplication_Cyclic1ms: RteActivationOsAlarmRef=Os/Rte_Al_TE_StartApplication_StartApplication_Cyclic1ms, RteActivationOsTaskRef=Default_Appl_Task
        Rte_Al_TE_StartApplication_StartApplication_Cyclic250ms: RteActivationOsAlarmRef=Os/Rte_Al_TE_StartApplication_StartApplication_Cyclic250ms, RteActivationOsTaskRef=Default_Appl_Task
    16 x RteBswModuleInstance:
      BswM: RteBswImplementationRef=BswM_Impl, RteBswModuleConfigurationRef=BswM
        BswM_MainFunctionTimingEvent0 (RteBswEventToTaskMapping):
          RteBswImmediateRestart = false
          RteBswPositionInTask = 0
          RteBswEventRef = BswM_MainFunctionTimingEvent0
          RteBswMappedToTaskRef = Default_BSW_Async_Task
          RteBswUsedOsEventRef = Rte_Ev_Cyclic2_Default_BSW_Async_Task_0_10ms
          RteBswUsedOsAlarmRef = Os/Rte_Al_TE2_Default_BSW_Async_Task_0_10ms
        BSWM_EXCLUSIVE_AREA_0 (RteBswExclusiveAreaImpl): RteExclusiveAreaImplMechanism=ALL_INTERRUPT_BLOCKING, RteBswExclusiveAreaRef=BSWM_EXCLUSIVE_AREA_0
      Can: RteBswImplementationRef=Can_Impl, RteBswModuleConfigurationRef=Can
        3 x RteBswEventToTaskMapping, all with RteBswImmediateRestart=false, RteBswMappedToTaskRef=Default_BSW_Async_Task, RteBswUsedOsEventRef=Rte_Ev_Cyclic2_Default_BSW_Async_Task_0_10ms, RteBswUsedOsAlarmRef=Os/Rte_Al_TE2_Default_BSW_Async_Task_0_10ms:
          Can_MainFunction_BusOffTimingEvent0: RteBswPositionInTask=5, RteBswEventRef=Can_MainFunction_BusOffTimingEvent0
          Can_MainFunction_WakeupTimingEvent0: RteBswPositionInTask=7, RteBswEventRef=Can_MainFunction_WakeupTimingEvent0
          Can_MainFunction_ModeTimingEvent0: RteBswPositionInTask=6, RteBswEventRef=Can_MainFunction_ModeTimingEvent0
        7 x RteBswExclusiveAreaImpl, all with RteExclusiveAreaImplMechanism=ALL_INTERRUPT_BLOCKING:
          CAN_EXCLUSIVE_AREA_{0..6}: RteBswExclusiveAreaRef=CAN_EXCLUSIVE_AREA_{0..6}
      CanIf: RteBswImplementationRef=CanIf_Impl, RteBswModuleConfigurationRef=CanIf
        8 x RteBswExclusiveAreaImpl, all with RteExclusiveAreaImplMechanism=ALL_INTERRUPT_BLOCKING:
          CANIF_EXCLUSIVE_AREA_{0..7}: RteBswExclusiveAreaRef=CANIF_EXCLUSIVE_AREA_{0..7}
      CanNm: RteBswImplementationRef=CanNm_Impl, RteBswModuleConfigurationRef=CanNm
        CanNm_MainFunctionTimingEvent0 (RteBswEventToTaskMapping):
          RteBswImmediateRestart = false
          RteBswPositionInTask = 1
          RteBswEventRef = CanNm_MainFunctionTimingEvent0
          RteBswMappedToTaskRef = Default_BSW_Async_Task
          RteBswUsedOsEventRef = Rte_Ev_Cyclic2_Default_BSW_Async_Task_0_10ms
          RteBswUsedOsAlarmRef = Os/Rte_Al_TE2_Default_BSW_Async_Task_0_10ms
        6 x RteBswExclusiveAreaImpl, all with RteExclusiveAreaImplMechanism=ALL_INTERRUPT_BLOCKING:
          CANNM_EXCLUSIVE_AREA_{0..5}: RteBswExclusiveAreaRef=CANNM_EXCLUSIVE_AREA_{0..5}
      CanSM: RteBswImplementationRef=CanSM_Impl, RteBswModuleConfigurationRef=CanSM
        CanSM_MainFunctionTimingEvent0 (RteBswEventToTaskMapping):
          RteBswImmediateRestart = false
          RteBswPositionInTask = 2
          RteBswEventRef = CanSM_MainFunctionTimingEvent0
          RteBswMappedToTaskRef = Default_BSW_Async_Task
          RteBswUsedOsEventRef = Rte_Ev_Cyclic2_Default_BSW_Async_Task_0_10ms
          RteBswUsedOsAlarmRef = Os/Rte_Al_TE2_Default_BSW_Async_Task_0_10ms
        6 x RteBswExclusiveAreaImpl, all with RteExclusiveAreaImplMechanism=ALL_INTERRUPT_BLOCKING:
          CANSM_EXCLUSIVE_AREA_{1..6}: RteBswExclusiveAreaRef=CANSM_EXCLUSIVE_AREA_{1..6}
      CanTp: RteBswImplementationRef=CanTp_Impl, RteBswModuleConfigurationRef=CanTp
        CanTp_MainFunctionTimingEvent0 (RteBswEventToTaskMapping):
          RteBswImmediateRestart = false
          RteBswPositionInTask = 3
          RteBswEventRef = CanTp_MainFunctionTimingEvent0
          RteBswMappedToTaskRef = Default_BSW_Async_Task
          RteBswUsedOsEventRef = Rte_Ev_Cyclic2_Default_BSW_Async_Task_0_5ms
          RteBswUsedOsAlarmRef = Os/Rte_Al_TE2_Default_BSW_Async_Task_0_5ms
        CANTP_EXCLUSIVE_AREA_0 (RteBswExclusiveAreaImpl): RteExclusiveAreaImplMechanism=ALL_INTERRUPT_BLOCKING, RteBswExclusiveAreaRef=CANTP_EXCLUSIVE_AREA_0
      Com: RteBswImplementationRef=Com_Impl, RteBswModuleConfigurationRef=Com
        Com_MainFunctionTxTimingEvent0 (RteBswEventToTaskMapping):
          RteBswImmediateRestart = false
          RteBswPositionInTask = 10
          RteBswEventRef = Com_MainFunctionTxTimingEvent0
          RteBswMappedToTaskRef = Default_BSW_Async_Task
          RteBswUsedOsEventRef = Rte_Ev_Cyclic2_Default_BSW_Async_Task_0_10ms
          RteBswUsedOsAlarmRef = Os/Rte_Al_TE2_Default_BSW_Async_Task_0_10ms
        Com_MainFunctionRxTimingEvent0 (RteBswEventToTaskMapping):
          RteBswImmediateRestart = false
          RteBswPositionInTask = 9
          RteBswEventRef = Com_MainFunctionRxTimingEvent0
          RteBswMappedToTaskRef = Default_BSW_Async_Task
          RteBswUsedOsEventRef = Rte_Ev_Cyclic2_Default_BSW_Async_Task_0_10ms
          RteBswUsedOsAlarmRef = Os/Rte_Al_TE2_Default_BSW_Async_Task_0_10ms
        3 x RteBswExclusiveAreaImpl, all with RteExclusiveAreaImplMechanism=ALL_INTERRUPT_BLOCKING:
          COM_EXCLUSIVE_AREA_TX: RteBswExclusiveAreaRef=COM_EXCLUSIVE_AREA_TX
          COM_EXCLUSIVE_AREA_RX: RteBswExclusiveAreaRef=COM_EXCLUSIVE_AREA_RX
          COM_EXCLUSIVE_AREA_BOTH: RteBswExclusiveAreaRef=COM_EXCLUSIVE_AREA_BOTH
      ComM: RteBswImplementationRef=ComM_Impl, RteBswModuleConfigurationRef=ComM
        ComM_MainFunction_0TimingEvent0 (RteBswEventToTaskMapping):
          RteBswImmediateRestart = false
          RteBswPositionInTask = 8
          RteBswEventRef = ComM_MainFunction_0TimingEvent0
          RteBswMappedToTaskRef = Default_BSW_Async_Task
          RteBswUsedOsEventRef = Rte_Ev_Cyclic2_Default_BSW_Async_Task_0_20ms
          RteBswUsedOsAlarmRef = Os/Rte_Al_TE2_Default_BSW_Async_Task_0_20ms
        COMM_EXCLUSIVE_AREA_0 (RteBswExclusiveAreaImpl): RteExclusiveAreaImplMechanism=ALL_INTERRUPT_BLOCKING, RteBswExclusiveAreaRef=COMM_EXCLUSIVE_AREA_0
        COMM_EXCLUSIVE_AREA_1 (RteBswExclusiveAreaImpl): RteExclusiveAreaImplMechanism=ALL_INTERRUPT_BLOCKING, RteBswExclusiveAreaRef=COMM_EXCLUSIVE_AREA_1
      Dcm: RteBswImplementationRef=Dcm_Impl, RteBswModuleConfigurationRef=Dcm
        Dcm_MainFunctionTimingEvent0 (RteBswEventToTaskMapping):
          RteBswImmediateRestart = false
          RteBswPositionInTask = 11
          RteBswEventRef = Dcm_MainFunctionTimingEvent0
          RteBswMappedToTaskRef = Default_BSW_Async_Task
          RteBswUsedOsEventRef = Rte_Ev_Cyclic2_Default_BSW_Async_Task_0_10ms
          RteBswUsedOsAlarmRef = Os/Rte_Al_TE2_Default_BSW_Async_Task_0_10ms
        DCM_EXCLUSIVE_AREA_0 (RteBswExclusiveAreaImpl): RteExclusiveAreaImplMechanism=ALL_INTERRUPT_BLOCKING, RteBswExclusiveAreaRef=DCM_EXCLUSIVE_AREA_0
      Dem: RteBswImplementationRef=Dem_Impl, RteBswModuleConfigurationRef=Dem
        Dem_MasterMainFunctionTimingEvent0 (RteBswEventToTaskMapping):
          RteBswImmediateRestart = false
          RteBswPositionInTask = 12
          RteBswEventRef = Dem_MasterMainFunctionTimingEvent0
          RteBswMappedToTaskRef = Default_BSW_Async_Task
          RteBswUsedOsEventRef = Rte_Ev_Cyclic2_Default_BSW_Async_Task_0_10ms
          RteBswUsedOsAlarmRef = Os/Rte_Al_TE2_Default_BSW_Async_Task_0_10ms
        Dem_SatelliteMainFunctionTimingEvent0 (RteBswEventToTaskMapping):
          RteBswImmediateRestart = false
          RteBswPositionInTask = 13
          RteBswEventRef = Dem_SatelliteMainFunctionTimingEvent0
          RteBswMappedToTaskRef = Default_BSW_Async_Task
          RteBswUsedOsEventRef = Rte_Ev_Cyclic2_Default_BSW_Async_Task_0_10ms
          RteBswUsedOsAlarmRef = Os/Rte_Al_TE2_Default_BSW_Async_Task_0_10ms
        4 x RteBswExclusiveAreaImpl, all with RteExclusiveAreaImplMechanism=ALL_INTERRUPT_BLOCKING:
          DEM_EXCLUSIVE_AREA_{0..3}: RteBswExclusiveAreaRef=DEM_EXCLUSIVE_AREA_{0..3}
      Det: RteBswImplementationRef=Det_Impl, RteBswModuleConfigurationRef=Det
        DET_EXCLUSIVE_AREA_0 (RteBswExclusiveAreaImpl): RteExclusiveAreaImplMechanism=ALL_INTERRUPT_BLOCKING, RteBswExclusiveAreaRef=DET_EXCLUSIVE_AREA_0
      EcuM: RteBswImplementationRef=EcuM_Impl, RteBswModuleConfigurationRef=EcuM
        EcuM_MainFunctionTimingEvent0 (RteBswEventToTaskMapping):
          RteBswImmediateRestart = false
          RteBswPositionInTask = 14
          RteBswEventRef = EcuM_MainFunctionTimingEvent0
          RteBswMappedToTaskRef = Default_BSW_Async_Task
          RteBswUsedOsEventRef = Rte_Ev_Cyclic2_Default_BSW_Async_Task_0_10ms
          RteBswUsedOsAlarmRef = Os/Rte_Al_TE2_Default_BSW_Async_Task_0_10ms
        3 x RteBswExclusiveAreaImpl, all with RteExclusiveAreaImplMechanism=ALL_INTERRUPT_BLOCKING:
          ECUM_EXCLUSIVE_AREA_{0..2}: RteBswExclusiveAreaRef=ECUM_EXCLUSIVE_AREA_{0..2}
      Nm: RteBswImplementationRef=Nm_Impl, RteBswModuleConfigurationRef=Nm
        NM_EXCLUSIVE_AREA_0 (RteBswExclusiveAreaImpl): RteExclusiveAreaImplMechanism=ALL_INTERRUPT_BLOCKING, RteBswExclusiveAreaRef=NM_EXCLUSIVE_AREA_0
        NM_EXCLUSIVE_AREA_1 (RteBswExclusiveAreaImpl): RteExclusiveAreaImplMechanism=ALL_INTERRUPT_BLOCKING, RteBswExclusiveAreaRef=NM_EXCLUSIVE_AREA_1
      PduR: RteBswImplementationRef=PduR_Impl, RteBswModuleConfigurationRef=PduR
        PDUR_EXCLUSIVE_AREA_0 (RteBswExclusiveAreaImpl): RteExclusiveAreaImplMechanism=ALL_INTERRUPT_BLOCKING, RteBswExclusiveAreaRef=PDUR_EXCLUSIVE_AREA_0
      Rte: RteBswImplementationRef=Rte_Impl, RteBswModuleConfigurationRef=Rte
      Xcp: RteBswImplementationRef=Xcp_Impl, RteBswModuleConfigurationRef=Xcp
        Xcp_MainFunctionTimingEvent0 (RteBswEventToTaskMapping):
          RteBswImmediateRestart = false
          RteBswPositionInTask = 19
          RteBswEventRef = Xcp_MainFunctionTimingEvent0
          RteBswMappedToTaskRef = Default_BSW_Async_Task
          RteBswUsedOsEventRef = Rte_Ev_Cyclic2_Default_BSW_Async_Task_0_5ms
          RteBswUsedOsAlarmRef = Os/Rte_Al_TE2_Default_BSW_Async_Task_0_5ms
        8 x RteBswExclusiveAreaImpl, all with RteExclusiveAreaImplMechanism=ALL_INTERRUPT_BLOCKING:
          XCP_EXCLUSIVE_AREA_{0..2}: RteBswExclusiveAreaRef=XCP_EXCLUSIVE_AREA_{0..2}
          CANXCP_EXCLUSIVE_AREA_0: RteBswExclusiveAreaRef=CANXCP_EXCLUSIVE_AREA_0
          FRXCP_EXCLUSIVE_AREA_{0..2}: RteBswExclusiveAreaRef=FRXCP_EXCLUSIVE_AREA_{0..2}
          TCPIPXCP_EXCLUSIVE_AREA_0: RteBswExclusiveAreaRef=TCPIPXCP_EXCLUSIVE_AREA_0
        CanXcp_MainFunctionTimingEvent0 (RteBswEventToTaskMapping):
          RteBswImmediateRestart = false
          RteBswPositionInTask = 4
          RteBswEventRef = CanXcp_MainFunctionTimingEvent0
          RteBswMappedToTaskRef = Default_BSW_Async_Task
          RteBswUsedOsEventRef = Rte_Ev_Cyclic2_Default_BSW_Async_Task_0_5ms
          RteBswUsedOsAlarmRef = Os/Rte_Al_TE2_Default_BSW_Async_Task_0_5ms
    6 x RteSwComponentInstance:
      ComM_EcuSwComposition: RteSoftwareComponentInstanceRef=ComM
        13 x RteEventToTaskMapping, all with RteImmediateRestart=false:
          Timer_ComM_MainFunction_0: RtePositionInTask=8, RteEventRef=Timer_ComM_MainFunction_0, RteMappedToTaskRef=Default_BSW_Async_Task, RteUsedOsEventRef=Rte_Ev_Cyclic2_Default_BSW_Async_Task_0_20ms, RteUsedOsAlarmRef=Os/Rte_Al_TE2_Default_BSW_Async_Task_0_20ms
          OpEventGetInhibitionStatus_GetInhibitionStatus_CL_CAN_f26020e5: RteEventRef=OpEventGetInhibitionStatus_GetInhibitionStatus_CL_CAN_f26020e5
          OpEventGetInhibitionStatus_GetInhibitionStatus_CW_CAN_f26020e5: RteEventRef=OpEventGetInhibitionStatus_GetInhibitionStatus_CW_CAN_f26020e5
          OpEventLimitECUToNoComMode_LimitECUToNoComMode_modeLimitation: RteEventRef=OpEventLimitECUToNoComMode_LimitECUToNoComMode_modeLimitation
          OpEventReadInhibitCounter_ReadInhibitCounter_modeLimitation: RteEventRef=OpEventReadInhibitCounter_ReadInhibitCounter_modeLimitation
          OpEventResetInhibitCounter_ResetInhibitCounter_modeLimitation: RteEventRef=OpEventResetInhibitCounter_ResetInhibitCounter_modeLimitation
          OpEventSetECUGroupClassification_SetECUGroupClassification_modeLimitation: RteEventRef=OpEventSetECUGroupClassification_SetECUGroupClassification_modeLimitation
          OpEventLimitChannelToNoComMode_LimitChannelToNoComMode_CL_CAN_f26020e5: RteEventRef=OpEventLimitChannelToNoComMode_LimitChannelToNoComMode_CL_CAN_f26020e5
          OpEventPreventWakeUp_PreventWakeUp_CW_CAN_f26020e5: RteEventRef=OpEventPreventWakeUp_PreventWakeUp_CW_CAN_f26020e5
          OpEventRequestComMode_RequestComMode_UR_USR_CHNL_3c6d4e43: RteEventRef=OpEventRequestComMode_RequestComMode_UR_USR_CHNL_3c6d4e43
          OpEventGetCurrentComMode_GetCurrentComMode_UR_USR_CHNL_3c6d4e43: RteEventRef=OpEventGetCurrentComMode_GetCurrentComMode_UR_USR_CHNL_3c6d4e43
          OpEventGetMaxComMode_GetMaxComMode_UR_USR_CHNL_3c6d4e43: RteEventRef=OpEventGetMaxComMode_GetMaxComMode_UR_USR_CHNL_3c6d4e43
          OpEventGetRequestedComMode_GetRequestedComMode_UR_USR_CHNL_3c6d4e43: RteEventRef=OpEventGetRequestedComMode_GetRequestedComMode_UR_USR_CHNL_3c6d4e43
      DemSatellite_0_EcuSwComposition: RteSoftwareComponentInstanceRef=DemSatellite_0
        78 x RteEventToTaskMapping, all with RteImmediateRestart=false:
          Timer_Dem_SatelliteMainFunction: RtePositionInTask=13, RteEventRef=Timer_Dem_SatelliteMainFunction, RteMappedToTaskRef=Default_BSW_Async_Task, RteUsedOsEventRef=Rte_Ev_Cyclic2_Default_BSW_Async_Task_0_10ms, RteUsedOsAlarmRef=Os/Rte_Al_TE2_Default_BSW_Async_Task_0_10ms
          OpEventGetEventUdsStatus_GetEventUdsStatus_EvtInfo_DTC_0x000002: RteEventRef=OpEventGetEventUdsStatus_GetEventUdsStatus_EvtInfo_DTC_0x000002
          OpEventGetEventUdsStatus_GetEventUdsStatus_Event_DTC_0x000002: RteEventRef=OpEventGetEventUdsStatus_GetEventUdsStatus_Event_DTC_0x000002
          OpEventGetEventUdsStatus_GetEventUdsStatus_EvtInfo_DTC_0x000003: RteEventRef=OpEventGetEventUdsStatus_GetEventUdsStatus_EvtInfo_DTC_0x000003
          OpEventGetEventUdsStatus_GetEventUdsStatus_Event_DTC_0x000003: RteEventRef=OpEventGetEventUdsStatus_GetEventUdsStatus_Event_DTC_0x000003
          OpEventGetEventUdsStatus_GetEventUdsStatus_GeneralEventInfo: RteEventRef=OpEventGetEventUdsStatus_GetEventUdsStatus_GeneralEventInfo
          OpEventGetEventStatus_GetEventStatus_EvtInfo_DTC_0x000002: RteEventRef=OpEventGetEventStatus_GetEventStatus_EvtInfo_DTC_0x000002
          OpEventGetEventStatus_GetEventStatus_Event_DTC_0x000002: RteEventRef=OpEventGetEventStatus_GetEventStatus_Event_DTC_0x000002
          OpEventGetEventStatus_GetEventStatus_EvtInfo_DTC_0x000003: RteEventRef=OpEventGetEventStatus_GetEventStatus_EvtInfo_DTC_0x000003
          OpEventGetEventStatus_GetEventStatus_Event_DTC_0x000003: RteEventRef=OpEventGetEventStatus_GetEventStatus_Event_DTC_0x000003
          OpEventGetEventStatus_GetEventStatus_GeneralEventInfo: RteEventRef=OpEventGetEventStatus_GetEventStatus_GeneralEventInfo
          OpEventGetEventFailed_GetEventFailed_EvtInfo_DTC_0x000002: RteEventRef=OpEventGetEventFailed_GetEventFailed_EvtInfo_DTC_0x000002
          OpEventGetEventFailed_GetEventFailed_Event_DTC_0x000002: RteEventRef=OpEventGetEventFailed_GetEventFailed_Event_DTC_0x000002
          OpEventGetEventFailed_GetEventFailed_EvtInfo_DTC_0x000003: RteEventRef=OpEventGetEventFailed_GetEventFailed_EvtInfo_DTC_0x000003
          OpEventGetEventFailed_GetEventFailed_Event_DTC_0x000003: RteEventRef=OpEventGetEventFailed_GetEventFailed_Event_DTC_0x000003
          OpEventGetEventFailed_GetEventFailed_GeneralEventInfo: RteEventRef=OpEventGetEventFailed_GetEventFailed_GeneralEventInfo
          OpEventGetEventTested_GetEventTested_EvtInfo_DTC_0x000002: RteEventRef=OpEventGetEventTested_GetEventTested_EvtInfo_DTC_0x000002
          OpEventGetEventTested_GetEventTested_Event_DTC_0x000002: RteEventRef=OpEventGetEventTested_GetEventTested_Event_DTC_0x000002
          OpEventGetEventTested_GetEventTested_EvtInfo_DTC_0x000003: RteEventRef=OpEventGetEventTested_GetEventTested_EvtInfo_DTC_0x000003
          OpEventGetEventTested_GetEventTested_Event_DTC_0x000003: RteEventRef=OpEventGetEventTested_GetEventTested_Event_DTC_0x000003
          OpEventGetEventTested_GetEventTested_GeneralEventInfo: RteEventRef=OpEventGetEventTested_GetEventTested_GeneralEventInfo
          OpEventGetDTCOfEvent_GetDTCOfEvent_EvtInfo_DTC_0x000002: RteEventRef=OpEventGetDTCOfEvent_GetDTCOfEvent_EvtInfo_DTC_0x000002
          OpEventGetDTCOfEvent_GetDTCOfEvent_Event_DTC_0x000002: RteEventRef=OpEventGetDTCOfEvent_GetDTCOfEvent_Event_DTC_0x000002
          OpEventGetDTCOfEvent_GetDTCOfEvent_EvtInfo_DTC_0x000003: RteEventRef=OpEventGetDTCOfEvent_GetDTCOfEvent_EvtInfo_DTC_0x000003
          OpEventGetDTCOfEvent_GetDTCOfEvent_Event_DTC_0x000003: RteEventRef=OpEventGetDTCOfEvent_GetDTCOfEvent_Event_DTC_0x000003
          OpEventGetDTCOfEvent_GetDTCOfEvent_GeneralEventInfo: RteEventRef=OpEventGetDTCOfEvent_GetDTCOfEvent_GeneralEventInfo
          OpEventGetFaultDetectionCounter_GetFaultDetectionCounter_EvtInfo_DTC_0x000002: RteEventRef=OpEventGetFaultDetectionCounter_GetFaultDetectionCounter_EvtInfo_DTC_0x000002
          OpEventGetFaultDetectionCounter_GetFaultDetectionCounter_Event_DTC_0x000002: RteEventRef=OpEventGetFaultDetectionCounter_GetFaultDetectionCounter_Event_DTC_0x000002
          OpEventGetFaultDetectionCounter_GetFaultDetectionCounter_EvtInfo_DTC_0x000003: RteEventRef=OpEventGetFaultDetectionCounter_GetFaultDetectionCounter_EvtInfo_DTC_0x000003
          OpEventGetFaultDetectionCounter_GetFaultDetectionCounter_Event_DTC_0x000003: RteEventRef=OpEventGetFaultDetectionCounter_GetFaultDetectionCounter_Event_DTC_0x000003
          OpEventGetFaultDetectionCounter_GetFaultDetectionCounter_GeneralEventInfo: RteEventRef=OpEventGetFaultDetectionCounter_GetFaultDetectionCounter_GeneralEventInfo
          OpEventGetEventFreezeFrameDataEx_GetEventFreezeFrameDataEx_EvtInfo_DTC_0x000002: RteEventRef=OpEventGetEventFreezeFrameDataEx_GetEventFreezeFrameDataEx_EvtInfo_DTC_0x000002
          OpEventGetEventFreezeFrameDataEx_GetEventFreezeFrameDataEx_Event_DTC_0x000002: RteEventRef=OpEventGetEventFreezeFrameDataEx_GetEventFreezeFrameDataEx_Event_DTC_0x000002
          OpEventGetEventFreezeFrameDataEx_GetEventFreezeFrameDataEx_EvtInfo_DTC_0x000003: RteEventRef=OpEventGetEventFreezeFrameDataEx_GetEventFreezeFrameDataEx_EvtInfo_DTC_0x000003
          OpEventGetEventFreezeFrameDataEx_GetEventFreezeFrameDataEx_Event_DTC_0x000003: RteEventRef=OpEventGetEventFreezeFrameDataEx_GetEventFreezeFrameDataEx_Event_DTC_0x000003
          OpEventGetEventFreezeFrameDataEx_GetEventFreezeFrameDataEx_GeneralEventInfo: RteEventRef=OpEventGetEventFreezeFrameDataEx_GetEventFreezeFrameDataEx_GeneralEventInfo
          OpEventGetEventExtendedDataRecordEx_GetEventExtendedDataRecordEx_EvtInfo_DTC_0x000002: RteEventRef=OpEventGetEventExtendedDataRecordEx_GetEventExtendedDataRecordEx_EvtInfo_DTC_0x000002
          OpEventGetEventExtendedDataRecordEx_GetEventExtendedDataRecordEx_Event_DTC_0x000002: RteEventRef=OpEventGetEventExtendedDataRecordEx_GetEventExtendedDataRecordEx_Event_DTC_0x000002
          OpEventGetEventExtendedDataRecordEx_GetEventExtendedDataRecordEx_EvtInfo_DTC_0x000003: RteEventRef=OpEventGetEventExtendedDataRecordEx_GetEventExtendedDataRecordEx_EvtInfo_DTC_0x000003
          OpEventGetEventExtendedDataRecordEx_GetEventExtendedDataRecordEx_Event_DTC_0x000003: RteEventRef=OpEventGetEventExtendedDataRecordEx_GetEventExtendedDataRecordEx_Event_DTC_0x000003
          OpEventGetEventExtendedDataRecordEx_GetEventExtendedDataRecordEx_GeneralEventInfo: RteEventRef=OpEventGetEventExtendedDataRecordEx_GetEventExtendedDataRecordEx_GeneralEventInfo
          OpEventGetEventEnableCondition_GetEventEnableCondition_EvtInfo_DTC_0x000002: RteEventRef=OpEventGetEventEnableCondition_GetEventEnableCondition_EvtInfo_DTC_0x000002
          OpEventGetEventEnableCondition_GetEventEnableCondition_EvtInfo_DTC_0x000003: RteEventRef=OpEventGetEventEnableCondition_GetEventEnableCondition_EvtInfo_DTC_0x000003
          OpEventGetEventEnableCondition_GetEventEnableCondition_GeneralEventInfo: RteEventRef=OpEventGetEventEnableCondition_GetEventEnableCondition_GeneralEventInfo
          OpEventGetDebouncingOfEvent_GetDebouncingOfEvent_EvtInfo_DTC_0x000002: RteEventRef=OpEventGetDebouncingOfEvent_GetDebouncingOfEvent_EvtInfo_DTC_0x000002
          OpEventGetDebouncingOfEvent_GetDebouncingOfEvent_EvtInfo_DTC_0x000003: RteEventRef=OpEventGetDebouncingOfEvent_GetDebouncingOfEvent_EvtInfo_DTC_0x000003
          OpEventGetDebouncingOfEvent_GetDebouncingOfEvent_GeneralEventInfo: RteEventRef=OpEventGetDebouncingOfEvent_GetDebouncingOfEvent_GeneralEventInfo
          OpEventGetMonitorStatus_GetMonitorStatus_EvtInfo_DTC_0x000002: RteEventRef=OpEventGetMonitorStatus_GetMonitorStatus_EvtInfo_DTC_0x000002
          OpEventGetMonitorStatus_GetMonitorStatus_EvtInfo_DTC_0x000003: RteEventRef=OpEventGetMonitorStatus_GetMonitorStatus_EvtInfo_DTC_0x000003
          OpEventGetMonitorStatus_GetMonitorStatus_GeneralEventInfo: RteEventRef=OpEventGetMonitorStatus_GetMonitorStatus_GeneralEventInfo
          OpEventSetEventStatus_SetEventStatus_Event_DTC_0x000002: RteEventRef=OpEventSetEventStatus_SetEventStatus_Event_DTC_0x000002
          OpEventSetEventStatus_SetEventStatus_Event_DTC_0x000003: RteEventRef=OpEventSetEventStatus_SetEventStatus_Event_DTC_0x000003
          OpEventResetEventStatus_ResetEventStatus_Event_DTC_0x000002: RteEventRef=OpEventResetEventStatus_ResetEventStatus_Event_DTC_0x000002
          OpEventResetEventStatus_ResetEventStatus_Event_DTC_0x000003: RteEventRef=OpEventResetEventStatus_ResetEventStatus_Event_DTC_0x000003
          OpEventResetEventDebounceStatus_ResetEventDebounceStatus_Event_DTC_0x000002: RteEventRef=OpEventResetEventDebounceStatus_ResetEventDebounceStatus_Event_DTC_0x000002
          OpEventResetEventDebounceStatus_ResetEventDebounceStatus_Event_DTC_0x000003: RteEventRef=OpEventResetEventDebounceStatus_ResetEventDebounceStatus_Event_DTC_0x000003
          OpEventGetEventExtendedDataRecordEx_GetEventExtendedDataRecordEx_EvtInfo_DEM_EVENT_StartApplication: RteEventRef=OpEventGetEventExtendedDataRecordEx_GetEventExtendedDataRecordEx_EvtInfo_DEM_EVENT_StartApplication
          OpEventGetEventFailed_GetEventFailed_EvtInfo_DEM_EVENT_StartApplication: RteEventRef=OpEventGetEventFailed_GetEventFailed_EvtInfo_DEM_EVENT_StartApplication
          OpEventGetEventFreezeFrameDataEx_GetEventFreezeFrameDataEx_Event_DEM_EVENT_StartApplication: RteEventRef=OpEventGetEventFreezeFrameDataEx_GetEventFreezeFrameDataEx_Event_DEM_EVENT_StartApplication
          OpEventResetEventDebounceStatus_ResetEventDebounceStatus_Event_DEM_EVENT_StartApplication: RteEventRef=OpEventResetEventDebounceStatus_ResetEventDebounceStatus_Event_DEM_EVENT_StartApplication
          OpEventGetEventStatus_GetEventStatus_Event_DEM_EVENT_StartApplication: RteEventRef=OpEventGetEventStatus_GetEventStatus_Event_DEM_EVENT_StartApplication
          OpEventGetEventFreezeFrameDataEx_GetEventFreezeFrameDataEx_EvtInfo_DEM_EVENT_StartApplication: RteEventRef=OpEventGetEventFreezeFrameDataEx_GetEventFreezeFrameDataEx_EvtInfo_DEM_EVENT_StartApplication
          OpEventGetEventTested_GetEventTested_EvtInfo_DEM_EVENT_StartApplication: RteEventRef=OpEventGetEventTested_GetEventTested_EvtInfo_DEM_EVENT_StartApplication
          OpEventGetDTCOfEvent_GetDTCOfEvent_EvtInfo_DEM_EVENT_StartApplication: RteEventRef=OpEventGetDTCOfEvent_GetDTCOfEvent_EvtInfo_DEM_EVENT_StartApplication
          OpEventGetEventTested_GetEventTested_Event_DEM_EVENT_StartApplication: RteEventRef=OpEventGetEventTested_GetEventTested_Event_DEM_EVENT_StartApplication
          OpEventGetEventFailed_GetEventFailed_Event_DEM_EVENT_StartApplication: RteEventRef=OpEventGetEventFailed_GetEventFailed_Event_DEM_EVENT_StartApplication
          OpEventSetEventStatus_SetEventStatus_Event_DEM_EVENT_StartApplication: RteEventRef=OpEventSetEventStatus_SetEventStatus_Event_DEM_EVENT_StartApplication
          OpEventGetMonitorStatus_GetMonitorStatus_EvtInfo_DEM_EVENT_StartApplication: RteEventRef=OpEventGetMonitorStatus_GetMonitorStatus_EvtInfo_DEM_EVENT_StartApplication
          OpEventGetFaultDetectionCounter_GetFaultDetectionCounter_Event_DEM_EVENT_StartApplication: RteEventRef=OpEventGetFaultDetectionCounter_GetFaultDetectionCounter_Event_DEM_EVENT_StartApplication
          OpEventGetEventExtendedDataRecordEx_GetEventExtendedDataRecordEx_Event_DEM_EVENT_StartApplication: RteEventRef=OpEventGetEventExtendedDataRecordEx_GetEventExtendedDataRecordEx_Event_DEM_EVENT_StartApplication
          OpEventResetEventStatus_ResetEventStatus_Event_DEM_EVENT_StartApplication: RteEventRef=OpEventResetEventStatus_ResetEventStatus_Event_DEM_EVENT_StartApplication
          OpEventGetEventEnableCondition_GetEventEnableCondition_EvtInfo_DEM_EVENT_StartApplication: RteEventRef=OpEventGetEventEnableCondition_GetEventEnableCondition_EvtInfo_DEM_EVENT_StartApplication
          OpEventGetEventStatus_GetEventStatus_EvtInfo_DEM_EVENT_StartApplication: RteEventRef=OpEventGetEventStatus_GetEventStatus_EvtInfo_DEM_EVENT_StartApplication
          OpEventGetDebouncingOfEvent_GetDebouncingOfEvent_EvtInfo_DEM_EVENT_StartApplication: RteEventRef=OpEventGetDebouncingOfEvent_GetDebouncingOfEvent_EvtInfo_DEM_EVENT_StartApplication
          OpEventGetEventUdsStatus_GetEventUdsStatus_Event_DEM_EVENT_StartApplication: RteEventRef=OpEventGetEventUdsStatus_GetEventUdsStatus_Event_DEM_EVENT_StartApplication
          OpEventGetDTCOfEvent_GetDTCOfEvent_Event_DEM_EVENT_StartApplication: RteEventRef=OpEventGetDTCOfEvent_GetDTCOfEvent_Event_DEM_EVENT_StartApplication
          OpEventGetFaultDetectionCounter_GetFaultDetectionCounter_EvtInfo_DEM_EVENT_StartApplication: RteEventRef=OpEventGetFaultDetectionCounter_GetFaultDetectionCounter_EvtInfo_DEM_EVENT_StartApplication
          OpEventGetEventUdsStatus_GetEventUdsStatus_EvtInfo_DEM_EVENT_StartApplication: RteEventRef=OpEventGetEventUdsStatus_GetEventUdsStatus_EvtInfo_DEM_EVENT_StartApplication
      BswM_EcuSwComposition: RteSoftwareComponentInstanceRef=BswM
        Timer_BswM_MainFunction (RteEventToTaskMapping):
          RteImmediateRestart = false
          RtePositionInTask = 0
          RteEventRef = Timer_BswM_MainFunction
          RteMappedToTaskRef = Default_BSW_Async_Task
          RteUsedOsEventRef = Rte_Ev_Cyclic2_Default_BSW_Async_Task_0_10ms
          RteUsedOsAlarmRef = Os/Rte_Al_TE2_Default_BSW_Async_Task_0_10ms
      Det_EcuSwComposition: RteSoftwareComponentInstanceRef=Det
      EcuM_EcuSwComposition: RteSoftwareComponentInstanceRef=EcuM
        8 x RteEventToTaskMapping, all with RteImmediateRestart=false:
          Timer_EcuM_MainFunction: RtePositionInTask=14, RteEventRef=Timer_EcuM_MainFunction, RteMappedToTaskRef=Default_BSW_Async_Task, RteUsedOsEventRef=Rte_Ev_Cyclic2_Default_BSW_Async_Task_0_10ms, RteUsedOsAlarmRef=Os/Rte_Al_TE2_Default_BSW_Async_Task_0_10ms
          OpEventSelectShutdownTarget_SelectShutdownTarget_EcuM_ShutdownTarget: RteEventRef=OpEventSelectShutdownTarget_SelectShutdownTarget_EcuM_ShutdownTarget
          OpEventGetShutdownTarget_GetShutdownTarget_EcuM_ShutdownTarget: RteEventRef=OpEventGetShutdownTarget_GetShutdownTarget_EcuM_ShutdownTarget
          OpEventGetLastShutdownTarget_GetLastShutdownTarget_EcuM_ShutdownTarget: RteEventRef=OpEventGetLastShutdownTarget_GetLastShutdownTarget_EcuM_ShutdownTarget
          OpEventSelectShutdownCause_SelectShutdownCause_EcuM_ShutdownTarget: RteEventRef=OpEventSelectShutdownCause_SelectShutdownCause_EcuM_ShutdownTarget
          OpEventGetShutdownCause_GetShutdownCause_EcuM_ShutdownTarget: RteEventRef=OpEventGetShutdownCause_GetShutdownCause_EcuM_ShutdownTarget
          OpEventSelectBootTarget_SelectBootTarget_EcuM_BootTarget: RteEventRef=OpEventSelectBootTarget_SelectBootTarget_EcuM_BootTarget
          OpEventGetBootTarget_GetBootTarget_EcuM_BootTarget: RteEventRef=OpEventGetBootTarget_GetBootTarget_EcuM_BootTarget
      DemMaster_0_EcuSwComposition: RteSoftwareComponentInstanceRef=DemMaster_0
        27 x RteEventToTaskMapping, all with RteImmediateRestart=false:
          Timer_Dem_MasterMainFunction: RtePositionInTask=12, RteEventRef=Timer_Dem_MasterMainFunction, RteMappedToTaskRef=Default_BSW_Async_Task, RteUsedOsEventRef=Rte_Ev_Cyclic2_Default_BSW_Async_Task_0_10ms, RteUsedOsAlarmRef=Os/Rte_Al_TE2_Default_BSW_Async_Task_0_10ms
          OpEventPostRunRequested_GetPostRunRequested_DemServices: RteEventRef=OpEventPostRunRequested_GetPostRunRequested_DemServices
          OpEventGetDTCStatusAvailabilityMask_GetDTCStatusAvailabilityMask_DemServices: RteEventRef=OpEventGetDTCStatusAvailabilityMask_GetDTCStatusAvailabilityMask_DemServices
          OpEventGetIndicatorStatus_GetIndicatorStatus_IndStatus_WarningIndicator: RteEventRef=OpEventGetIndicatorStatus_GetIndicatorStatus_IndStatus_WarningIndicator
          OpEventGetEventUdsStatus_GetEventUdsStatus_GeneralEventInfo: RteEventRef=OpEventGetEventUdsStatus_GetEventUdsStatus_GeneralEventInfo
          OpEventGetEventStatus_GetEventStatus_GeneralEventInfo: RteEventRef=OpEventGetEventStatus_GetEventStatus_GeneralEventInfo
          OpEventGetEventFailed_GetEventFailed_GeneralEventInfo: RteEventRef=OpEventGetEventFailed_GetEventFailed_GeneralEventInfo
          OpEventGetEventTested_GetEventTested_GeneralEventInfo: RteEventRef=OpEventGetEventTested_GetEventTested_GeneralEventInfo
          OpEventGetDTCOfEvent_GetDTCOfEvent_GeneralEventInfo: RteEventRef=OpEventGetDTCOfEvent_GetDTCOfEvent_GeneralEventInfo
          OpEventGetFaultDetectionCounter_GetFaultDetectionCounter_GeneralEventInfo: RteEventRef=OpEventGetFaultDetectionCounter_GetFaultDetectionCounter_GeneralEventInfo
          OpEventGetEventFreezeFrameDataEx_GetEventFreezeFrameDataEx_GeneralEventInfo: RteEventRef=OpEventGetEventFreezeFrameDataEx_GetEventFreezeFrameDataEx_GeneralEventInfo
          OpEventGetEventExtendedDataRecordEx_GetEventExtendedDataRecordEx_GeneralEventInfo: RteEventRef=OpEventGetEventExtendedDataRecordEx_GetEventExtendedDataRecordEx_GeneralEventInfo
          OpEventGetEventEnableCondition_GetEventEnableCondition_GeneralEventInfo: RteEventRef=OpEventGetEventEnableCondition_GetEventEnableCondition_GeneralEventInfo
          OpEventGetDebouncingOfEvent_GetDebouncingOfEvent_GeneralEventInfo: RteEventRef=OpEventGetDebouncingOfEvent_GetDebouncingOfEvent_GeneralEventInfo
          OpEventGetMonitorStatus_GetMonitorStatus_GeneralEventInfo: RteEventRef=OpEventGetMonitorStatus_GetMonitorStatus_GeneralEventInfo
          OpEventGetOperationCycleState_GetOperationCycleState_OpCycle_IgnitionCycle: RteEventRef=OpEventGetOperationCycleState_GetOperationCycleState_OpCycle_IgnitionCycle
          OpEventGetOperationCycleState_GetOperationCycleState_OpCycle_OBDDrivingCycle: RteEventRef=OpEventGetOperationCycleState_GetOperationCycleState_OpCycle_OBDDrivingCycle
          OpEventGetOperationCycleState_GetOperationCycleState_OpCycle_PowerCycle: RteEventRef=OpEventGetOperationCycleState_GetOperationCycleState_OpCycle_PowerCycle
          OpEventGetOperationCycleState_GetOperationCycleState_OpCycle_WarmUpCycle: RteEventRef=OpEventGetOperationCycleState_GetOperationCycleState_OpCycle_WarmUpCycle
          OpEventSetOperationCycleState_SetOperationCycleState_OpCycle_IgnitionCycle: RteEventRef=OpEventSetOperationCycleState_SetOperationCycleState_OpCycle_IgnitionCycle
          OpEventSetOperationCycleState_SetOperationCycleState_OpCycle_OBDDrivingCycle: RteEventRef=OpEventSetOperationCycleState_SetOperationCycleState_OpCycle_OBDDrivingCycle
          OpEventSetOperationCycleState_SetOperationCycleState_OpCycle_PowerCycle: RteEventRef=OpEventSetOperationCycleState_SetOperationCycleState_OpCycle_PowerCycle
          OpEventSetOperationCycleState_SetOperationCycleState_OpCycle_WarmUpCycle: RteEventRef=OpEventSetOperationCycleState_SetOperationCycleState_OpCycle_WarmUpCycle
          OpEventGetEventMemoryOverflow_GetEventMemoryOverflow_OverflowIndPrimaryMemory_DemClient: RteEventRef=OpEventGetEventMemoryOverflow_GetEventMemoryOverflow_OverflowIndPrimaryMemory_DemClient
          OpEventSelectDTC_SelectDTC_ClearDTC_DemClient: RteEventRef=OpEventSelectDTC_SelectDTC_ClearDTC_DemClient
          OpEventClearDTC_ClearDTC_ClearDTC_DemClient: RteEventRef=OpEventClearDTC_ClearDTC_ClearDTC_DemClient
          OpEventGetNumberOfEventMemoryEntries_GetNumberOfEventMemoryEntries_OverflowIndPrimaryMemory_DemClient: RteEventRef=OpEventGetNumberOfEventMemoryEntries_GetNumberOfEventMemoryEntries_OverflowIndPrimaryMemory_DemClient
    Adc (RteBswModuleInstance): RteBswImplementationRef=Adc_Impl, RteBswModuleConfigurationRef=Adc
      12 x RteBswExclusiveAreaImpl, all with RteExclusiveAreaImplMechanism=ALL_INTERRUPT_BLOCKING:
        StartGroup: RteBswExclusiveAreaRef=StartGroup
        StopGroup: RteBswExclusiveAreaRef=StopGroup
        ReadGroup: RteBswExclusiveAreaRef=ReadGroup
        EnableHwTrig: RteBswExclusiveAreaRef=EnableHwTrig
        DisableHwTrig: RteBswExclusiveAreaRef=DisableHwTrig
        GetGrpStatus: RteBswExclusiveAreaRef=GetGrpStatus
        GetStreamLastPtr: RteBswExclusiveAreaRef=GetStreamLastPtr
        PopQueue: RteBswExclusiveAreaRef=PopQueue
        PushQueue: RteBswExclusiveAreaRef=PushQueue
        ScheduleNext: RteBswExclusiveAreaRef=ScheduleNext
        ScheduleStart: RteBswExclusiveAreaRef=ScheduleStart
        ScheduleStop: RteBswExclusiveAreaRef=ScheduleStop
    Mcu (RteBswModuleInstance): RteBswImplementationRef=Mcu_Impl, RteBswModuleConfigurationRef=Mcu
    Dcm_EcuSwComposition (RteSwComponentInstance): RteSoftwareComponentInstanceRef=Dcm
      7 x RteEventToTaskMapping, all with RteImmediateRestart=false:
        Timer_Dcm_MainFunction: RtePositionInTask=11, RteEventRef=Timer_Dcm_MainFunction, RteMappedToTaskRef=Default_BSW_Async_Task, RteUsedOsEventRef=Rte_Ev_Cyclic2_Default_BSW_Async_Task_0_10ms, RteUsedOsAlarmRef=Os/Rte_Al_TE2_Default_BSW_Async_Task_0_10ms
        OpEventGetActiveProtocol_GetActiveProtocol_DCMServices: RteEventRef=OpEventGetActiveProtocol_GetActiveProtocol_DCMServices
        OpEventGetSesCtrlType_GetSesCtrlType_DCMServices: RteEventRef=OpEventGetSesCtrlType_GetSesCtrlType_DCMServices
        OpEventResetToDefaultSession_ResetToDefaultSession_DCMServices: RteEventRef=OpEventResetToDefaultSession_ResetToDefaultSession_DCMServices
        OpEventGetSecurityLevel_GetSecurityLevel_DCMServices: RteEventRef=OpEventGetSecurityLevel_GetSecurityLevel_DCMServices
        OpEventSetActiveDiagnostic_SetActiveDiagnostic_DCMServices: RteEventRef=OpEventSetActiveDiagnostic_SetActiveDiagnostic_DCMServices
        OpEventGetRequestKind_GetRequestKind_DCMServices: RteEventRef=OpEventGetRequestKind_GetRequestKind_DCMServices
    4 x RteBswModuleInstance:
      Fee: RteBswImplementationRef=Fee_Impl, RteBswModuleConfigurationRef=Fee
        Fee_MainFunctionTimingEvent0 (RteBswEventToTaskMapping):
          RteBswImmediateRestart = false
          RteBswPositionInTask = 15
          RteBswEventRef = Fee_MainFunctionTimingEvent0
          RteBswMappedToTaskRef = Default_BSW_Async_Task
          RteBswUsedOsEventRef = Rte_Ev_Cyclic2_Default_BSW_Async_Task_0_10ms
          RteBswUsedOsAlarmRef = Os/Rte_Al_TE2_Default_BSW_Async_Task_0_10ms
      IoHwAb: RteBswImplementationRef=IoHwAb_Impl, RteBswModuleConfigurationRef=IoHwAb
        IOHWAB_EXCLUSIVE_AREA_0 (RteBswExclusiveAreaImpl): RteExclusiveAreaImplMechanism=ALL_INTERRUPT_BLOCKING, RteBswExclusiveAreaRef=IOHWAB_EXCLUSIVE_AREA_0
      NvM: RteBswImplementationRef=NvM_Impl, RteBswModuleConfigurationRef=NvM
        NvM_MainFunctionTimingEvent0 (RteBswEventToTaskMapping):
          RteBswImmediateRestart = false
          RteBswPositionInTask = 17
          RteBswEventRef = NvM_MainFunctionTimingEvent0
          RteBswMappedToTaskRef = Default_BSW_Async_Task
          RteBswUsedOsEventRef = Rte_Ev_Cyclic2_Default_BSW_Async_Task_0_10ms
          RteBswUsedOsAlarmRef = Os/Rte_Al_TE2_Default_BSW_Async_Task_0_10ms
        NVM_EXCLUSIVE_AREA_0 (RteBswExclusiveAreaImpl): RteExclusiveAreaImplMechanism=ALL_INTERRUPT_BLOCKING, RteBswExclusiveAreaRef=NVM_EXCLUSIVE_AREA_0
      WdgM: RteBswImplementationRef=WdgM_Impl, RteBswModuleConfigurationRef=WdgM
        WDGM_EXCLUSIVE_AREA_0 (RteBswExclusiveAreaImpl): RteExclusiveAreaImplMechanism=ALL_INTERRUPT_BLOCKING, RteBswExclusiveAreaRef=WDGM_EXCLUSIVE_AREA_0
        WdgM_MainFunctionTimingEvent0 (RteBswEventToTaskMapping):
          RteBswImmediateRestart = false
          RteBswPositionInTask = 18
          RteBswEventRef = WdgM_MainFunctionTimingEvent0
          RteBswMappedToTaskRef = Default_BSW_Async_Task
          RteBswUsedOsEventRef = Rte_Ev_Cyclic2_Default_BSW_Async_Task_0_10ms
          RteBswUsedOsAlarmRef = Os/Rte_Al_TE2_Default_BSW_Async_Task_0_10ms
    3 x RteSwComponentInstance:
      NvM_EcuSwComposition: RteSoftwareComponentInstanceRef=NvM
        8 x RteEventToTaskMapping, all with RteImmediateRestart=false:
          Timer_NvM_MainFunction: RtePositionInTask=17, RteEventRef=Timer_NvM_MainFunction, RteMappedToTaskRef=Default_BSW_Async_Task, RteUsedOsEventRef=Rte_Ev_Cyclic2_Default_BSW_Async_Task_0_10ms, RteUsedOsAlarmRef=Os/Rte_Al_TE2_Default_BSW_Async_Task_0_10ms
          OpEventSetRamBlockStatus_SetRamBlockStatus_PS_NvMBlockDescriptor_StartApplication: RteEventRef=OpEventSetRamBlockStatus_SetRamBlockStatus_PS_NvMBlockDescriptor_StartApplication
          OpEventWriteBlock_WriteBlock_PS_NvMBlockDescriptor_StartApplication: RteEventRef=OpEventWriteBlock_WriteBlock_PS_NvMBlockDescriptor_StartApplication
          OpEventGetErrorStatus_GetErrorStatus_PS_NvMBlockDescriptor_StartApplication: RteEventRef=OpEventGetErrorStatus_GetErrorStatus_PS_NvMBlockDescriptor_StartApplication
          OpEventReadBlock_ReadBlock_PS_NvMBlockDescriptor_StartApplication: RteEventRef=OpEventReadBlock_ReadBlock_PS_NvMBlockDescriptor_StartApplication
          OpEventInvalidateNvBlock_InvalidateNvBlock_PS_NvMBlockDescriptor_StartApplication: RteEventRef=OpEventInvalidateNvBlock_InvalidateNvBlock_PS_NvMBlockDescriptor_StartApplication
          OpEventEraseBlock_EraseBlock_PS_NvMBlockDescriptor_StartApplication: RteEventRef=OpEventEraseBlock_EraseBlock_PS_NvMBlockDescriptor_StartApplication
          OpEventSetBlockProtection_SetBlockProtection_PAdmin_NvMBlockDescriptor_StartApplication: RteEventRef=OpEventSetBlockProtection_SetBlockProtection_PAdmin_NvMBlockDescriptor_StartApplication
      Os_OsCore_Core0_swc_EcuSwComposition: RteSoftwareComponentInstanceRef=Os_OsCore_Core0_swc
        OpEventGetCounterValue_GetCounterValue_OsService_SystemTimer (RteEventToTaskMapping): RteImmediateRestart=false, RteEventRef=OpEventGetCounterValue_GetCounterValue_OsService_SystemTimer
        OpEventGetElapsedValue_GetElapsedValue_OsService_SystemTimer (RteEventToTaskMapping): RteImmediateRestart=false, RteEventRef=OpEventGetElapsedValue_GetElapsedValue_OsService_SystemTimer
      WdgM_EcuSwComposition: RteSoftwareComponentInstanceRef=WdgM
        9 x RteEventToTaskMapping, all with RteImmediateRestart=false:
          Timer_WdgM_MainFunction: RtePositionInTask=18, RteEventRef=Timer_WdgM_MainFunction, RteMappedToTaskRef=Default_BSW_Async_Task, RteUsedOsEventRef=Rte_Ev_Cyclic2_Default_BSW_Async_Task_0_10ms, RteUsedOsAlarmRef=Os/Rte_Al_TE2_Default_BSW_Async_Task_0_10ms
          OpEventCheckpointReached_CheckpointReached_alive_WdgMSupervisedEntity_StartApplication: RteEventRef=OpEventCheckpointReached_CheckpointReached_alive_WdgMSupervisedEntity_StartApplication
          OpEventGetLocalStatus_GetLocalStatus_localStatus_WdgMSupervisedEntity_StartApplication: RteEventRef=OpEventGetLocalStatus_GetLocalStatus_localStatus_WdgMSupervisedEntity_StartApplication
          OpEventGetLocalStatus_GetLocalStatus_general: RteEventRef=OpEventGetLocalStatus_GetLocalStatus_general
          OpEventGetMode_GetMode_general: RteEventRef=OpEventGetMode_GetMode_general
          OpEventGetGlobalStatus_GetGlobalStatus_general: RteEventRef=OpEventGetGlobalStatus_GetGlobalStatus_general
          OpEventPerformReset_PerformReset_general: RteEventRef=OpEventPerformReset_PerformReset_general
          OpEventSetMode_SetMode_general: RteEventRef=OpEventSetMode_SetMode_general
          OpEventGetFirstExpiredSEID_GetFirstExpiredSEID_general: RteEventRef=OpEventGetFirstExpiredSEID_GetFirstExpiredSEID_general
    9 x RteBswModuleInstance:
      Dio: RteBswImplementationRef=Dio_Impl, RteBswModuleConfigurationRef=Dio
      Fls: RteBswImplementationRef=Fls_Impl, RteBswModuleConfigurationRef=Fls
        Fls_17_Pmu_MainFunctionTimingEvent0 (RteBswEventToTaskMapping):
          RteBswImmediateRestart = false
          RteBswPositionInTask = 16
          RteBswEventRef = Fls_17_Pmu_MainFunctionTimingEvent0
          RteBswMappedToTaskRef = Default_BSW_Async_Task
          RteBswUsedOsEventRef = Rte_Ev_Cyclic2_Default_BSW_Async_Task_0_10ms
          RteBswUsedOsAlarmRef = Os/Rte_Al_TE2_Default_BSW_Async_Task_0_10ms
        5 x RteBswExclusiveAreaImpl, all with RteExclusiveAreaImplMechanism=ALL_INTERRUPT_BLOCKING:
          Init: RteBswExclusiveAreaRef=Init
          Erase: RteBswExclusiveAreaRef=Erase
          Write: RteBswExclusiveAreaRef=Write
          Main: RteBswExclusiveAreaRef=Main
          ResumeErase: RteBswExclusiveAreaRef=ResumeErase
      Gpt: RteBswImplementationRef=Gpt_Impl, RteBswModuleConfigurationRef=Gpt
      Icu: RteBswImplementationRef=Icu_Impl, RteBswModuleConfigurationRef=Icu
        6 x RteBswExclusiveAreaImpl, all with RteExclusiveAreaImplMechanism=ALL_INTERRUPT_BLOCKING:
          EnableWakeup: RteBswExclusiveAreaRef=EnableWakeup
          Ccu6IenUpdate: RteBswExclusiveAreaRef=Ccu6IenUpdate
          EnableNotification: RteBswExclusiveAreaRef=EnableNotification
          ResetEdgeCount: RteBswExclusiveAreaRef=ResetEdgeCount
          CcuInterruptHandle: RteBswExclusiveAreaRef=CcuInterruptHandle
          CcuVariableupdate: RteBswExclusiveAreaRef=CcuVariableupdate
      Irq: RteBswImplementationRef=Irq_Impl, RteBswModuleConfigurationRef=Irq
      Port: RteBswImplementationRef=Port_Impl, RteBswModuleConfigurationRef=Port
      Pwm: RteBswImplementationRef=Pwm_Impl, RteBswModuleConfigurationRef=Pwm
      Spi: RteBswImplementationRef=Spi_Impl, RteBswModuleConfigurationRef=Spi
        Spi_MainFunction_HandlingTimingEvent0 (RteBswEventToTaskMapping):
          RteBswImmediateRestart = false
          RteBswPositionInTask = 20
          RteBswEventRef = Spi_MainFunction_HandlingTimingEvent0
          RteBswMappedToTaskRef = Default_BSW_Async_Task
          RteBswUsedOsEventRef = Rte_Ev_Cyclic2_Default_BSW_Async_Task_0_5ms
          RteBswUsedOsAlarmRef = Os/Rte_Al_TE2_Default_BSW_Async_Task_0_5ms
        7 x RteBswExclusiveAreaImpl, all with RteExclusiveAreaImplMechanism=ALL_INTERRUPT_BLOCKING:
          WriteIB: RteBswExclusiveAreaRef=WriteIB
          AsyncTransmit: RteBswExclusiveAreaRef=AsyncTransmit
          SyncTransmit: RteBswExclusiveAreaRef=SyncTransmit
          GetSequenceResult: RteBswExclusiveAreaRef=GetSequenceResult
          Cancel: RteBswExclusiveAreaRef=Cancel
          Init: RteBswExclusiveAreaRef=Init
          DeInit: RteBswExclusiveAreaRef=DeInit
      Wdg: RteBswImplementationRef=Wdg_Impl, RteBswModuleConfigurationRef=Wdg
        6 x RteBswExclusiveAreaImpl, all with RteExclusiveAreaImplMechanism=ALL_INTERRUPT_BLOCKING:
          SafetyInit: RteBswExclusiveAreaRef=SafetyInit
          SafetyTrigger: RteBswExclusiveAreaRef=SafetyTrigger
          SafetyOffMode: RteBswExclusiveAreaRef=SafetyOffMode
          Trigger: RteBswExclusiveAreaRef=Trigger
          TimerHandling: RteBswExclusiveAreaRef=TimerHandling
          ChangeMode: RteBswExclusiveAreaRef=ChangeMode
    IoHwAb_001 (RteSwComponentType): RteComponentTypeRef=IoHwAb, RteImplementationRef=IoHwAbImplementation
      ComponentTypeCalibration (RteComponentTypeCalibration): RteCalibrationSupportEnabled=false
    StartApplication (RteSwComponentType): RteComponentTypeRef=StartApplication, RteImplementationRef=StartApplicationImplementation
      ComponentTypeCalibration (RteComponentTypeCalibration): RteCalibrationSupportEnabled=true
    IoHwAb_EcuSwComposition (RteSwComponentInstance): RteSoftwareComponentInstanceRef=IoHwAb
    StartApplication_EcuSwComposition (RteSwComponentInstance): RteSoftwareComponentInstanceRef=StartApplication
      12 x RteEventToTaskMapping, all with RteImmediateRestart=false:
        Timer_StartApplication_Cyclic1ms: RtePositionInTask=2, RteEventRef=Timer_StartApplication_Cyclic1ms, RteMappedToTaskRef=Default_Appl_Task, RteUsedOsEventRef=Rte_Ev_Run_StartApplication_StartApplication_Cyclic1ms, RteUsedOsAlarmRef=Os/Rte_Al_TE_StartApplication_StartApplication_Cyclic1ms
        Timer_StartApplication_Cyclic10ms: RtePositionInTask=1, RteEventRef=Timer_StartApplication_Cyclic10ms, RteMappedToTaskRef=Default_Appl_Task, RteUsedOsEventRef=Rte_Ev_Run_StartApplication_StartApplication_Cyclic10ms, RteUsedOsAlarmRef=Os/Rte_Al_TE_StartApplication_StartApplication_Cyclic10ms
        Timer_StartApplication_Cyclic250ms: RtePositionInTask=3, RteEventRef=Timer_StartApplication_Cyclic250ms, RteMappedToTaskRef=Default_Appl_Task, RteUsedOsEventRef=Rte_Ev_Run_StartApplication_StartApplication_Cyclic250ms, RteUsedOsAlarmRef=Os/Rte_Al_TE_StartApplication_StartApplication_Cyclic250ms
        Timer_StartApplication_Cyclic1000ms: RtePositionInTask=0, RteEventRef=Timer_StartApplication_Cyclic1000ms, RteMappedToTaskRef=Default_Appl_Task, RteUsedOsEventRef=Rte_Ev_Run_StartApplication_StartApplication_Cyclic1000ms, RteUsedOsAlarmRef=Os/Rte_Al_TE_StartApplication_StartApplication_Cyclic1000ms
        Timer_StartApplication_Init: RtePositionInTask=0, RteEventRef=Timer_StartApplication_Init, RteMappedToTaskRef=Default_Appl_Init_Task
        OpEventStartApplication_MEM_JobFinished_JobFinished_PpNvmJobFinishedPort: RteEventRef=OpEventStartApplication_MEM_JobFinished_JobFinished_PpNvmJobFinishedPort
        DataReceivedEvent_StartApplication_OnDataRec_RxCtrl_PpRxCtrl_DeSignal_Rx16bit_Cyclic_a691adb3: RtePositionInTask=4, RteEventRef=DataReceivedEvent_StartApplication_OnDataRec_RxCtrl_PpRxCtrl_DeSignal_Rx16bit_Cyclic_a691adb3, RteMappedToTaskRef=Default_Appl_Task, RteUsedOsEventRef=Rte_Ev_Run_StartApplication_StartApplication_OnDataRec_RxCtrl
        DataReceivedEvent_StartApplication_OnDataRec_RxData_PpRxData_DeSignal_Rx15bit_OnWrite_a1df81ad: RtePositionInTask=5, RteEventRef=DataReceivedEvent_StartApplication_OnDataRec_RxData_PpRxData_DeSignal_Rx15bit_OnWrite_a1df81ad, RteMappedToTaskRef=Default_Appl_Task, RteUsedOsEventRef=Rte_Ev_Run_StartApplication_StartApplication_OnDataRec_RxData
        OpEventStartApplication_DIAG_DcmReadData_ReadData_PpDcmDataService_DID_StartApplication: RteEventRef=OpEventStartApplication_DIAG_DcmReadData_ReadData_PpDcmDataService_DID_StartApplication
        OpEventStartApplication_DIAG_DcmWriteData_WriteData_PpDcmDataService_DID_StartApplication: RteEventRef=OpEventStartApplication_DIAG_DcmWriteData_WriteData_PpDcmDataService_DID_StartApplication
        OpEventStartApplication_DIAG_ConditionCheckRead_ConditionCheckRead_PpDcmDataService_DID_StartApplication: RteEventRef=OpEventStartApplication_DIAG_ConditionCheckRead_ConditionCheckRead_PpDcmDataService_DID_StartApplication
        OpEventStartApplication_DIAG_DemReadData_ReadData_PpDemDataService_DemDataElementClass_StartApplication: RteEventRef=OpEventStartApplication_DIAG_DemReadData_ReadData_PpDemDataService_DemDataElementClass_StartApplication
  module config Xcp: implementation-config-variant=VARIANT-PRE-COMPILE, module-description=Xcp_Impl
    XcpCmdConfig: XcpOpenCommandInterface=false
      XcpStandard:
        XcpBlockUpload = false
        XcpCommunicationModeInfo = false
        XcpGetIdGeneric = false
        XcpMemoryReadProtection = false
        XcpSeedKey = false
        XcpUserDefinedCommand = false
      XcpAsynchMessage: XcpEventCodes=false, XcpServiceRequestMessage=false
      XcpDaqAndStim:
        XcpDAQODTMessageHeader = false
        XcpFixedTimestamp = false
        XcpGetDAQEventInfo = false
        XcpMaxNumberOfOdtDaq = 1
        XcpMaxNumberOfOdtEntries = 2
        XcpMaxNumberOfOdtStim = 1
        XcpOverrunIndication = true
        XcpResolutionInfo = false
        XcpResumeMode = false
        XcpSynchronousDataStimulation = true
        XcpWriteDAQMultiple = false
      XcpCalibration: XcpBlockDownload=false, XcpMIN_STForBlockDownload=0, XcpModifyBits=false, XcpShortDownload=false
    XcpGeneral:
      XcpDevErrorDetect = true
      XcpMainFunctionPeriod = 0.005
      XcpMaxEventChannel = 255
      XcpOnCanEnabled = true
      XcpOnCddEnabled = false
      XcpOnEthernetEnabled = false
      XcpOnFlexRayEnabled = false
      XcpPrescalerSupported = false
      XcpVersionInfoApi = false
      XcpBootloaderDownload = false
      XcpControl = false
      XcpMultiClientSupport = false
      XcpRuntimeMeasurementSupport = false
      XcpSafeBswChecks = false
      XcpSessionStatusAPI = false
      XcpTypeSafeCopy = false
      XcpDAQMemAccessByApplication = false
      XcpA2L: XcpTimeoutT1=2000, XcpTimeoutT2=10000, XcpTimeoutT3=2000, XcpTimeoutT4=2000, XcpTimeoutT5=2000, XcpTimeoutT6=2000, XcpTimeoutT7=0
    XcpConfig
      msg_XCP_Response_MyECU_oCAN_3abd61be (XcpPdu)
        msg_XCP_Response_MyECU_oCAN_3abd61be (XcpTxPdu): XcpTxPduId=0, XcpTxPduRef=PT_msg_XCP_Response_MyECU_PP_msg_XCP_Response_MyECU_Tx_346f2748_fe6ecc87
      msg_XCP_Request_MyECU_oCAN_3abd61be (XcpPdu)
        msg_XCP_Request_MyECU_oCAN_3abd61be (XcpRxPdu):
          XcpRxPduId = 0
          XcpRxPduRef = PT_msg_XCP_Request_MyECU_PP_msg_XCP_Request_MyECU_Rx_346f2748_fe6ecc87
          XcpTxPduContRef = msg_XCP_Response_MyECU_oCAN_3abd61be/msg_XCP_Response_MyECU_oCAN_3abd61be
      XcpTransportLayer
        XcpOnCan: XcpOnCanMaxCto=8, XcpOnCanMaxDto=8, XcpOnCanConfirmationTimeout=10, XcpOnCanMultiConnectionProtection=false, XcpOnCanVariableDlc=false
      XcpEventChannel_StartApplication (XcpEventChannel):
        XcpEventChannelMaxDaqList = 1
        XcpEventChannelNumber = 0
        XcpEventChannelTimeCycle = 250
        XcpEventChannelTimeUnit = TIMESTAMP_UNIT_1MS
        XcpEventChannelType = DAQ_STIM
        XcpEventChannelCoreRef = XcpCoreDefinition
      XcpCoreDefinition: XcpSendQueueSize=256
      3 x XcpEventChannel, all with XcpEventChannelMaxDaqList=1, XcpEventChannelTimeCycle=0, XcpEventChannelTimeUnit=TIMESTAMP_UNIT_1US, XcpEventChannelType=DAQ, XcpEventChannelCoreRef=XcpCoreDefinition:
        Rte_Default_Appl_Init_Task: XcpEventChannelNumber=2
        Rte_Default_Appl_Task: XcpEventChannelNumber=3
        Rte_Default_BSW_Async_Task: XcpEventChannelNumber=1
  module config ComM: implementation-config-variant=VARIANT-PRE-COMPILE, module-description=ComM_Impl
    ComMGeneral:
      ComMPncIdCounting = COMM_PNC_ID_COUNT_FROM_NM_MESSAGE
      ComMPncSupport = false
      ComMDevErrorDetect = true
      ComMEcuGroupClassification = 3
      ComMModeLimitationEnabled = false
      ComMSynchronousWakeUp = true
      ComMTMinFullComModeDuration = 5
      ComMVersionInfoApi = false
      ComMWakeupInhibitionEnabled = false
      ComMSafeBswChecks = false
      ComMGeneration: ComMOutOfBoundsWriteSanitizer=false, ComMOutOfBoundsReadSanitizer=false
    ComMConfigSet: ComMPncEnabled=false
      CAN_f26020e5 (ComMChannel):  # CN_CAN
        ComMBusType = COMM_BUS_TYPE_CAN
        ComMChannelId = 0
        ComMFullCommRequestNotificationEnabled = false
        ComMMainFunctionPeriod = 0.02
        ComMNoCom = false
        ComMNoWakeup = false
        ComMNetworkManagement: ComMNmVariant=FULL, ComMPncNmRequest=false
        CHNL_3c6d4e43 (ComMUserPerChannel): ComMUserChannel=USR_CHNL_3c6d4e43  # CN_CAN
      USR_CHNL_3c6d4e43 (ComMUser): ComMUserIdentifier=0, ComMUserModeNotification=false  # CN_CAN
  module config Dem: implementation-config-variant=VARIANT-PRE-COMPILE, module-description=Dem_Impl
    DemConfigSet
      DTCClass_DTC_0x000003 (DemDTCClass): DemDTCSeverity=DEM_DTC_SEV_NO_SEVERITY, DemUdsDTC=3, DemImmediateNvStorage=false
      DTC_0x000002 (DemEventParameter):
        DemEventKind = DEM_EVENT_KIND_SWC
        DemMaxNumberFreezeFrameRecords = 1
        DemEventTimeSeries = DEM_TIMESERIES_SNAPSHOT_NONE
        DemEventAvailable = true
        DemEventId = 1
        DemEventAvailableInVariant = true
        DemEventLatchTestFailed = false
        DemDTCClassRef = DTCClass_DTC_0x000002
        DemExtendedDataClassRef = ExtendedDataClass_83dcefb7
        DemFreezeFrameClassRef = FreezeFrameClass_d65a1577
        DemEventClass:
          DemAgingAllowed = false
          DemAgingCycleCounterThreshold = 100
          DemEventDestination = DEM_DTC_ORIGIN_PRIMARY_MEMORY
          DemEventPriority = 2
          DemEventFailureCycleCounterThreshold = 0
          DemConsiderPtoStatus = false
          DemFFPrestorageSupported = false
          DemAgingCycleRef = IgnitionCycle
          DemOperationCycleRef = PowerCycle
          DemDebounceAlgorithmClass
            DemDebounceCounterBased:
              DemDebounceCounterDecrementStepSize = 1
              DemDebounceCounterIncrementStepSize = 1
              DemDebounceCounterJumpDown = false
              DemDebounceCounterJumpUp = true
              DemDebounceBehavior = DEM_DEBOUNCE_FREEZE
              DemDebounceCounterFailedThreshold = 127
              DemDebounceCounterJumpDownValue = 0
              DemDebounceCounterJumpUpValue = 0
              DemDebounceCounterPassedThreshold = -128
              DemDebounceCounterStorage = false
              DemDebounceContinuous = false
          IndicatorAttribute_WarningIndicator (DemIndicatorAttribute):
            DemIndicatorFailureCycleSource = DEM_FAILURE_CYCLE_EVENT
            DemIndicatorBehaviour = DEM_INDICATOR_CONTINUOUS
            DemIndicatorHealingCycleCounterThreshold = 3
            DemIndicatorHealingCycleRef = PowerCycle
            DemIndicatorRef = WarningIndicator
        DemCallbackInitMForE
      DTC_0x000003 (DemEventParameter):
        DemEventKind = DEM_EVENT_KIND_SWC
        DemMaxNumberFreezeFrameRecords = 1
        DemEventTimeSeries = DEM_TIMESERIES_SNAPSHOT_NONE
        DemEventAvailable = true
        DemEventId = 2
        DemEventAvailableInVariant = true
        DemEventLatchTestFailed = false
        DemDTCClassRef = DTCClass_DTC_0x000003
        DemExtendedDataClassRef = ExtendedDataClass_83dcefb7
        DemFreezeFrameClassRef = FreezeFrameClass_5440cf4a
        DemEventClass:
          DemAgingAllowed = true
          DemAgingCycleCounterThreshold = 40
          DemEventDestination = DEM_DTC_ORIGIN_PRIMARY_MEMORY
          DemEventPriority = 1
          DemEventFailureCycleCounterThreshold = 2
          DemConsiderPtoStatus = false
          DemFFPrestorageSupported = false
          DemAgingCycleRef = WarmUpCycle
          DemOperationCycleRef = OBDDrivingCycle
          DemDebounceAlgorithmClass
            DemDebounceCounterBased:
              DemDebounceCounterDecrementStepSize = 1
              DemDebounceCounterIncrementStepSize = 1
              DemDebounceCounterJumpDown = false
              DemDebounceCounterJumpUp = true
              DemDebounceBehavior = DEM_DEBOUNCE_FREEZE
              DemDebounceCounterFailedThreshold = 127
              DemDebounceCounterJumpDownValue = 0
              DemDebounceCounterJumpUpValue = 0
              DemDebounceCounterPassedThreshold = -128
              DemDebounceCounterStorage = false
              DemDebounceContinuous = false
          IndicatorAttribute_WarningIndicator (DemIndicatorAttribute):
            DemIndicatorFailureCycleSource = DEM_FAILURE_CYCLE_EVENT
            DemIndicatorBehaviour = DEM_INDICATOR_CONTINUOUS
            DemIndicatorHealingCycleCounterThreshold = 3
            DemIndicatorHealingCycleRef = OBDDrivingCycle
            DemIndicatorRef = WarningIndicator
      DTCClass_DTC_0x000002 (DemDTCClass): DemDTCSeverity=DEM_DTC_SEV_NO_SEVERITY, DemUdsDTC=2, DemImmediateNvStorage=false
      DemDTCClass_StartApplication (DemDTCClass): DemImmediateNvStorage=false, DemUdsDTC=4729855
      DEM_EVENT_StartApplication (DemEventParameter):
        DemEventTimeSeries = DEM_TIMESERIES_SNAPSHOT_NONE
        DemEventAvailable = true
        DemEventId = 3
        DemEventKind = DEM_EVENT_KIND_SWC
        DemEventAvailableInVariant = true
        DemEventLatchTestFailed = false
        DemMaxNumberFreezeFrameRecords = 1
        DemDTCClassRef = DemDTCClass_StartApplication
        DemFreezeFrameClassRef = DemFreezeFrameClass_StartApplication
        DemEventClass:
          DemAgingAllowed = false
          DemConsiderPtoStatus = false
          DemEventDestination = DEM_DTC_ORIGIN_PRIMARY_MEMORY
          DemEventPriority = 2
          DemFFPrestorageSupported = false
          DemOperationCycleRef = PowerCycle
          DemAgingCycleRef = PowerCycle
          DemDebounceAlgorithmClass
            DemDebounceCounterBased:
              DemDebounceBehavior = DEM_DEBOUNCE_FREEZE
              DemDebounceCounterDecrementStepSize = 1
              DemDebounceCounterFailedThreshold = 127
              DemDebounceCounterIncrementStepSize = 1
              DemDebounceCounterJumpDown = true
              DemDebounceCounterJumpDownValue = 0
              DemDebounceCounterJumpUp = true
              DemDebounceCounterJumpUpValue = 0
              DemDebounceCounterPassedThreshold = -128
              DemDebounceCounterStorage = false
              DemDebounceContinuous = false
    DemGeneral:
      DemAgingCycleCounterProcessing = DEM_PROCESS_AGINGCTR_INTERN
      DemDebounceCounterBasedSupport = true
      DemDtcStatusAvailabilityMask = 255
      DemMaxNumberEventEntryMirror = 0
      DemPTOSupport = false
      DemTypeOfFreezeFrameRecordNumeration = DEM_FF_RECNUM_CALCULATED
      DemGeneralInterfaceSupport = false
      DemDataElementDefaultEndianness = LITTLE_ENDIAN
      DemAgingRequieresTestedCycle = false
      DemTriggerMonitorInitBeforeClearOk = true
      DemExtendedDataCapture = DEM_TRIGGER_EVENT_MEMORY_STORAGE
      DemFreezeFrameCapture = DEM_TRIGGER_EVENT_MEMORY_STORAGE
      DemOperationCycleProcessing = DEM_PROCESS_OPCYC_STATE
      DemMaxNumberTimeSeriesSnapshots = 0
      DemAvailabilitySupport = DEM_NO_AVAILABILITY
      DemAvailabilityStorage = false
      DemBswErrorBufferSize = 0
      DemClearDTCBehavior = DEM_CLRRESP_VOLATILE
      DemClearDTCLimitation = DEM_ALL_SUPPORTED_DTCS
      DemDebounceTimeBasedSupport = false
      DemDevErrorDetect = true
      DemEnableConditionSupport = false
      DemEventCombinationSupport = DEM_EVCOMB_DISABLED
      DemEventDisplacementStrategy = DEM_DISPLACEMENT_LEGACY_403
      DemEventMemoryEntryStorageTrigger = DEM_STORAGE_ON_TEST_FAILED
      DemMaxNumberEventEntryOBDFreezeFrame = 0
      DemMaxNumberEventEntryPermanent = 0
      DemMaxNumberEventEntryPrimary = 8
      DemMaxNumberEventEntrySecondary = 0
      DemMaxNumberPrestoredFF = 0
      DemOBDSupport = DEM_OBD_NO_OBD_SUPPORT
      DemOccurrenceCounterProcessing = DEM_PROCESS_OCCCTR_TF
      DemOperationCycleStatusStorage = false
      DemResetConfirmedBitOnOverflow = true
      DemStatusBitHandlingTestFailedSinceLastClear = DEM_STATUS_BIT_NORMAL
      DemStatusBitStorageTestFailed = true
      DemStorageConditionSupport = false
      DemSuppressionSupport = DEM_NO_SUPPRESSION
      DemTaskTime = 0.01
      DemTriggerDcmReports = false
      DemTriggerDltReports = false
      DemTriggerFiMReports = false
      DemTriggerMonitorInitForEnableConditions = false
      DemTypeOfDTCSupported = DEM_DTC_TRANSLATION_ISO14229_1
      DemVersionInfoApi = false
      DemBswApiVersion = DEM_BSW_API_4_XX_XX
      DemBswApiVersionNvM = DEM_BSW_API_4_XX_XX
      DemBswApiVersionFiM = DEM_BSW_API_4_XX_XX
      DemAgingAfterHealing = DEM_AGING_WHILE_HEALING
      DemAgingBehavior = DEM_AGING_TYPE_1
      DemAgingCounterBehavior = DEM_AGING_COUNT_ALWAYS
      DemAgingCounterReporting = DEM_AGING_NORMAL_REPORTING
      DemAgingRetainEnvironmentalData = false
      DemCompiledPostbuildCrc = 366860311
      DemCompiledPostbuildCrcMode = DEM_POSTBUILD_CRC_AUTOMATIC
      DemEventDisplacementFallbackStrategy = DEM_FALLBACK_DISCARD_NEW_EVENT
      DemGeneralDiagnosticInfoSupport = true
      DemJ1939Support = false
      DemNvSynchronizeSupport = false
      DemPendingDtcProcessing = DEM_PROCESS_PDTC_STOREDONLY
      DemResetDebounceBehavior = DEM_RESET_DEBOUNCE_ON_DISABLE_ENABLE_CONDITIONS
      DemResetTestFailedOnOperationCycleStart = false
      DemRetryStorageSupport = false
      DemSafeBswChecks = false
      DemUseMemcopyMacros = false
      DemUseRte = true
      DemUserControlledWirBehavior = DEM_DISABLED_DURING_CONTROLDTCSETTING
      DemUserDefinedCompareAndSwap = false
      DemWarningIndicatorRequestedProcessing = DEM_PROCESS_WIR_STOREDONLY
      OccurrenceCounter (DemExtendedDataRecordClass): DemExtendedDataRecordNumber=1, DemDataClassRef=OccurrenceCounter_Occurrence_Counter
      DemPostbuild: DemEventAvailableDefaultSupport=true, DemMaxSizeFreezeFrame=10, DemMaxNumberDtr=0
      WarmUpCycle (DemOperationCycle): DemOperationCycleType=DEM_OPCYC_WARMUP, DemOperationCycleAutomaticEnd=false, DemOperationCycleAutostart=false
      IgnitionCycle (DemOperationCycle): DemOperationCycleType=DEM_OPCYC_IGNITION, DemOperationCycleAutomaticEnd=false, DemOperationCycleAutostart=false
      OccurrenceCounter_Occurrence_Counter (DemDataClass): DemDataElementDataSize=1, DemDataElementInternalData=DEM_OCCCTR, DemDataElementUsePort=USE_DATA_INTERNAL, DemDataElementStoreNonVolatile=true
      ExtendedDataClass_83dcefb7 (DemExtendedDataClass): DemExtendedDataRecordClassRef=OccurrenceCounter
      DID_0xF412 (DemDidClass): DemDidIdentifier=62482, DemDidDataClassRef=PID_0x12_DID_Data
      PID_0x12_DID_Data (DemDataClass):
        DemDataElementDataSize = 2
        DemDataElementDataType = UINT16
        DemDataElementEndianness = BIG_ENDIAN
        DemDataElementUsePort = USE_DATA_CLIENT_SERVER_PORT
        DemDataElementStoreNonVolatile = true
      DID_0xF413 (DemDidClass): DemDidIdentifier=62483, DemDidDataClassRef=PID_0x13_DID_Data
      DemEventMemorySet
      DID_0x1_DID_Data_GlobalTime (DemDataClass):
        DemDataElementDataSize = 6
        DemDataElementDataType = UINT8_N
        DemDataElementEndianness = opaque
        DemDataElementUsePort = USE_DATA_CLIENT_SERVER_PORT
        DemDataElementStoreNonVolatile = true
      FreezeFrameClass_d65a1577 (DemFreezeFrameClass): DemDidClassRef=DemGeneral/Example_ReadOnlyDID
      OBDDrivingCycle (DemOperationCycle): DemOperationCycleType=DEM_OPCYC_OBD_DCY, DemOperationCycleAutomaticEnd=false, DemOperationCycleAutostart=false
      Example_ReadOnlyDID (DemDidClass): DemDidIdentifier=1, DemDidDataClassRef=DID_0x1_DID_Data_GlobalTime
      WarningIndicator (DemIndicator): DemIndicatorID=0
      FreezeFrameClass_5440cf4a (DemFreezeFrameClass): DemDidClassRef=DemGeneral/Example_ReadOnlyDID, DemDidClassRef=DemGeneral/DID_0xF412, DemDidClassRef=DemGeneral/DID_0xF413
      PowerCycle (DemOperationCycle): DemOperationCycleType=DEM_OPCYC_POWER, DemOperationCycleAutomaticEnd=false, DemOperationCycleAutostart=false
      PID_0x13_DID_Data (DemDataClass):
        DemDataElementDataSize = 2
        DemDataElementDataType = UINT16
        DemDataElementEndianness = BIG_ENDIAN
        DemDataElementUsePort = USE_DATA_CLIENT_SERVER_PORT
        DemDataElementStoreNonVolatile = true
      DemClient: DemClientId=0
      DemDataElementClass_StartApplication (DemDataClass): DemDataElementDataSize=2, DemDataElementStoreNonVolatile=true, DemDataElementUsePort=USE_DATA_CLIENT_SERVER_PORT
      DemDidClass_StartApplication (DemDidClass): DemDidIdentifier=85, DemDidDataClassRef=DemDataElementClass_StartApplication
      DemFreezeFrameClass_StartApplication (DemFreezeFrameClass): DemDidClassRef=DemDidClass_StartApplication
      10 x DemNvRamBlockId:
        Dem_AdminData: DemNvRamBlockIdType=DEM_NVBLOCK_ADMIN, DemNvRamBlockIdRef=DemAdminDataBlock
        Dem_StatusData: DemNvRamBlockIdType=DEM_NVBLOCK_STATUS, DemNvRamBlockIdRef=DemStatusDataBlock
        Dem_PrimaryEntry{0..7}: DemNvRamBlockIdType=DEM_NVBLOCK_PRIMARY, DemNvRamBlockIdIndex={0..7}, DemNvRamBlockIdRef=DemPrimaryDataBlock{0..7}
  module config Dcm: implementation-config-variant=VARIANT-PRE-COMPILE, module-description=Dcm_Impl
    DcmConfigSet
      DcmDsl
        DcmDslProtocol
          DcmDslProtocolRow:
            DcmDslProtocolEndiannessConvEnabled = false
            DcmDslProtocolID = DCM_UDS_ON_CAN
            DcmDslProtocolIsParallelExecutab = false
            DcmDslProtocolPreemptTimeout = 0
            DcmDslProtocolPriority = 0
            DcmSendRespPendOnTransToBoot = true
            DcmTimStrP2ServerAdjust = 0
            DcmTimStrP2StarServerAdjust = 0
            DcmDslProtocolMaximumResponseSize = 4095
            DcmDslProtocolRxBufferID = DcmDslBuffer
            DcmDslProtocolSIDTable = DcmDsdServiceTable
            DcmDslProtocolTxBufferID = DcmDslBuffer
            DcmDemClientRef = DemClient
            DC_0xE001_oMyECU_oCAN (DcmDslConnection)
              DcmDslMainConnection: DcmDslProtocolRxTesterSourceAddr=224, DcmDslPeriodicTranmissionConRef=DcmDslPeriodicTransmission
                PT_msg_diag_Request_MyECU_PP_msg_diag_Request_MyECU_Rx_346f2748_fe6ecc87 (DcmDslProtocolRx):
                  DcmDslProtocolRxAddrType = DCM_PHYSICAL_TYPE
                  DcmDslProtocolRxPduId = 1
                  DcmDslProtocolRxChannelId = 0
                  DcmDslProtocolRxComMChannelRef = ComMConfigSet/CAN_f26020e5
                  DcmDslProtocolRxPduRef = EcucPduCollection/PT_msg_diag_Request_MyECU_PP_msg_diag_Request_MyECU_Rx_346f2748_fe6ecc87
                PT_msg_diag_Response_MyECU_PP_msg_diag_Response_MyECU_Tx_346f2748_fe6ecc87 (DcmDslProtocolTx):
                  DcmDslTxConfirmationPduId = 1
                  DcmDslProtocolTxPduRef = EcucPduCollection/PT_msg_diag_Response_MyECU_PP_msg_diag_Response_MyECU_Tx_346f2748_fe6ecc87
                PT_msg_diag_RequestGlobal_PP_msg_diag_RequestGlobal_Rx_346f2748_fe6ecc87 (DcmDslProtocolRx):
                  DcmDslProtocolRxAddrType = DCM_FUNCTIONAL_TYPE
                  DcmDslProtocolRxPduId = 0
                  DcmDslProtocolRxChannelId = 0
                  DcmDslProtocolRxComMChannelRef = ComMConfigSet/CAN_f26020e5
                  DcmDslProtocolRxPduRef = EcucPduCollection/PT_msg_diag_RequestGlobal_PP_msg_diag_RequestGlobal_Rx_346f2748_fe6ecc87
            DcmDslConnection
              DcmDslPeriodicTransmission: DcmDslPeriodicTxConfirmationTimeout=0.1
                DcmDslPeriodicConnection:
                  DcmDslPeriodicTxConfirmationPduId = 0
                  DcmDslPeriodicTxPduRef = PT_msg_diag_Uudt_Response_MyECU_PP_msg_diag_Uudt_Response_MyECU_Tx_346f2748_fe6ecc87
        DcmDslDiagResp: DcmDslDiagRespMaxNumRespPend=0, DcmDslDiagRespOnSecondDeclinedRequest=false, DcmDslDiagRespMaxNumOfDeclinedRequests=3
        DcmDslBuffer: DcmDslBufferSize=50
      DcmGeneral:
        DcmDevErrorDetect = true
        DcmRequestManufacturerNotificationEnabled = false
        DcmRequestSupplierNotificationEnabled = false
        DcmRespondAllRequest = true
        DcmTaskTime = 0.01
        DcmVersionInfoApi = false
        DcmDspDataDefaultEndianness = LITTLE_ENDIAN
        DcmSafeBswChecks = false
        DcmSupportedIDCalculationSuppressionEnabled = false
        DcmDtrDataProvisionViaDemEnabled = true
        DcmForeignDiagnosticRequestDetectionEnabled = false
        DcmSuppressResponseOnCanTpFuncMixedAddrRequests = false
      DcmDsd
        DcmDsdServiceTable
          16 x DcmDsdService:
            ClearDiagInfo: DcmDsdSidTabServiceId=20, DcmDsdSidTabSubfuncAvail=false
            EcuReset: DcmDsdSidTabServiceId=17, DcmDsdSidTabSubfuncAvail=true
              Hard (DcmDsdSubService): DcmDsdSubServiceId=1
            ControlDtcSetting: DcmDsdSidTabServiceId=133, DcmDsdSidTabSubfuncAvail=true
              Disable (DcmDsdSubService): DcmDsdSubServiceId=2
              Enable (DcmDsdSubService): DcmDsdSubServiceId=1
            WriteDataById: DcmDsdSidTabServiceId=46, DcmDsdSidTabSubfuncAvail=false
            ReadDataById: DcmDsdSidTabServiceId=34, DcmDsdSidTabSubfuncAvail=false
            SecurityAccess: DcmDsdSidTabServiceId=39, DcmDsdSidTabSubfuncAvail=true, DcmDsdSidTabSessionLevelRef=DcmDspSession/Programming, DcmDsdSidTabSessionLevelRef=DcmDspSession/Extended
              4 x DcmDsdSubService, all with DcmDsdSubServiceSessionLevelRef=DcmDspSession/Programming, DcmDsdSubServiceSessionLevelRef=DcmDspSession/Extended:
                SeedLevel1_Request: DcmDsdSubServiceId=1
                sendKey_Send: DcmDsdSubServiceId=4
                requestSeed_Request: DcmDsdSubServiceId=3
                KeyLevel1_Send: DcmDsdSubServiceId=2
            ReadMemoryByAddress: DcmDsdSidTabServiceId=35, DcmDsdSidTabSubfuncAvail=false
            ReadDtcInfo: DcmDsdSidTabServiceId=25, DcmDsdSidTabSubfuncAvail=true
              12 x DcmDsdSubService:
                RNODTCBSMR: DcmDsdSubServiceId=7
                RDTCFDC: DcmDsdSubServiceId=20
                RFCDTC: DcmDsdSubServiceId=12
                RDTCEDRBDN: DcmDsdSubServiceId=6
                RDTCSSI: DcmDsdSubServiceId=3
                RSUPDTC: DcmDsdSubServiceId=10
                RDTCBSM: DcmDsdSubServiceId=2
                RDTCBSMR: DcmDsdSubServiceId=8
                RNODTCBSM: DcmDsdSubServiceId=1
                RDTCSSBDTC: DcmDsdSubServiceId=4
                RMRTFDTC: DcmDsdSubServiceId=13
                RSIODTC: DcmDsdSubServiceId=9
            TesterPresent: DcmDsdSidTabServiceId=62, DcmDsdSidTabSubfuncAvail=true
              TesterPresent (DcmDsdSubService): DcmDsdSubServiceId=0
            WriteMemoryByAddress: DcmDsdSidTabServiceId=61, DcmDsdSidTabSubfuncAvail=false
            DynamicallyDefineDataId: DcmDsdSidTabServiceId=44, DcmDsdSidTabSubfuncAvail=true
              3 x DcmDsdSubService:
                DynDefByAddr: DcmDsdSubServiceId=2
                DynDefById: DcmDsdSubServiceId=1
                DynDefClr: DcmDsdSubServiceId=3
            CommunicationControl: DcmDsdSidTabServiceId=40, DcmDsdSidTabSubfuncAvail=true, DcmDsdSidTabSessionLevelRef=DcmDspSession/Programming, DcmDsdSidTabSessionLevelRef=DcmDspSession/Extended
              4 x DcmDsdSubService, all with DcmDsdSubServiceSessionLevelRef=DcmDspSession/Programming, DcmDsdSubServiceSessionLevelRef=DcmDspSession/Extended:
                DisableRxAndEnableTx: DcmDsdSubServiceId=2
                EnableRxAndDisableTx: DcmDsdSubServiceId=1
                DisableRxAndTx: DcmDsdSubServiceId=3
                EnableRxAndTx: DcmDsdSubServiceId=0
            RoutineControl: DcmDsdSidTabServiceId=49, DcmDsdSidTabSubfuncAvail=true, DcmDsdSidTabSessionLevelRef=DcmDspSession/Programming, DcmDsdSidTabSessionLevelRef=DcmDspSession/Extended
            IoControlById: DcmDsdSidTabServiceId=47, DcmDsdSidTabSubfuncAvail=false, DcmDsdSidTabSessionLevelRef=DcmDspSession/Extended
            ReadDataByPeriodicId: DcmDsdSidTabServiceId=42, DcmDsdSidTabSubfuncAvail=false, DcmDsdSidTabSessionLevelRef=DcmDspSession/Programming, DcmDsdSidTabSessionLevelRef=DcmDspSession/Extended
            DiagSessionControl: DcmDsdSidTabServiceId=16, DcmDsdSidTabSubfuncAvail=true
              3 x DcmDsdSubService:
                Programming: DcmDsdSubServiceId=2
                Default: DcmDsdSubServiceId=1
                Extended: DcmDsdSubServiceId=3
      DcmDsp: DcmDspMaxDidToRead=5, DcmDspMaxPeriodicDidToRead=5, DcmDspReadDIDReportsNODIByte=false
        DidInfo_Hardware_Version (DcmDspDidInfo)
          DcmDspDidAccess
            DcmDspDidWrite
            DcmDspDidRead
        DataInfo_SerialNumber_SerialNumber (DcmDspDataInfo): DcmDspDataFixedLength=true
        DevelopmentData (DcmDspDid): DcmDspDidIdentifier=256, DcmDspDidUsed=true, DcmDspDidUsePort=USE_DATA_ELEMENT_SPECIFIC_INTERFACES, DcmDspDidInfoRef=DidInfo_DevelopmentData
          5 x DcmDspDidSignal:
            TransportLayerVersion: DcmDspDidDataPos=64, DcmDspDidDataRef=DevelopmentData_TransportLayerVersion
            CanDriverVersion: DcmDspDidDataPos=16, DcmDspDidDataRef=DevelopmentData_CanDriverVersion
            DiagnosticModuleVersion: DcmDspDidDataPos=48, DcmDspDidDataRef=DevelopmentData_DiagnosticModuleVersion
            NmVersion: DcmDspDidDataPos=32, DcmDspDidDataRef=DevelopmentData_NmVersion
            OperatingSystemVersion: DcmDspDidDataPos=0, DcmDspDidDataRef=DevelopmentData_OperatingSystemVersion
        RoutineInfo_CheckProgrammingPreconditions (DcmDspRoutineInfo)
          DcmDspRoutineAuthorization: DcmDspRoutineSessionRef=DcmDspSession/Programming, DcmDspRoutineSessionRef=DcmDspSession/Extended
        3 x DcmDspDid, all with DcmDspDidUsed=true, DcmDspDidUsePort=USE_DATA_ELEMENT_SPECIFIC_INTERFACES:
          PeriodicDataSample: DcmDspDidIdentifier=61953, DcmDspDidInfoRef=DidInfo_PeriodicDataSample
            DataRecord (DcmDspDidSignal): DcmDspDidDataPos=0, DcmDspDidDataRef=PeriodicDataSample_DataRecord
          Boot_Software: DcmDspDidIdentifier=61824, DcmDspDidInfoRef=DidInfo_Boot_Software
            NumberOfModules (DcmDspDidSignal): DcmDspDidDataPos=0, DcmDspDidDataRef=Boot_Software_NumberOfModules
            Boot_Software_Identification (DcmDspDidSignal): DcmDspDidDataPos=8, DcmDspDidDataRef=Boot_Software_Boot_Software_Identification
          SampleIoControl: DcmDspDidIdentifier=3, DcmDspDidInfoRef=DidInfo_SampleIoControl
            DID_Data (DcmDspDidSignal): DcmDspDidDataPos=0, DcmDspDidDataRef=SampleIoControl_DID_Data
        SampleRoutineControl (DcmDspRoutine):
          DcmDspRequestResultsRoutineSupported = true
          DcmDspStopRoutineSupported = true
          DcmDspRoutineIdentifier = 256
          DcmDspRoutineFixedLength = false
          DcmDspRoutineUsePort = true
          DcmDspRoutineUsed = true
          DcmDspRoutineInfoRef = RoutineInfo_SampleRoutineControl
        DidInfo_DataDiagnosticIdentifier_DID (DcmDspDidInfo)
          DcmDspDidAccess
            DcmDspDidWrite
            DcmDspDidRead
        3 x DcmDspDataInfo, all with DcmDspDataFixedLength=true:
          DataInfo_DID_0xF413_DID_Data
          DataInfo_DevelopmentData_OperatingSystemVersion
          DataInfo_DID_0xF410_DID_Data
        Spare_Part_Number (DcmDspDid): DcmDspDidIdentifier=61831, DcmDspDidUsed=true, DcmDspDidUsePort=USE_DATA_ELEMENT_SPECIFIC_INTERFACES, DcmDspDidInfoRef=DidInfo_Spare_Part_Number
          Spare_Part_Number (DcmDspDidSignal): DcmDspDidDataPos=0, DcmDspDidDataRef=Spare_Part_Number_Spare_Part_Number
        DidInfo_DID_0xF413 (DcmDspDidInfo)
          DcmDspDidAccess
            DcmDspDidRead
        DidInfo_DID_0xF412 (DcmDspDidInfo)
          DcmDspDidAccess
            DcmDspDidRead
        DataInfo_DevelopmentData_TransportLayerVersion (DcmDspDataInfo): DcmDspDataFixedLength=true
        SampleDynamicallyDefinedNonPeriodicDID (DcmDspDid):
          DcmDspDidIdentifier = 62208
          DcmDspDidUsed = true
          DcmDspDidUsePort = USE_DATA_ELEMENT_SPECIFIC_INTERFACES
          DcmDspDidInfoRef = DidInfo_SampleDynamicallyDefinedNonPeriodicDID
        RoutineInfo_ForceBootMode (DcmDspRoutineInfo)
          DcmDspRoutineAuthorization: DcmDspRoutineSessionRef=DcmDspSession/Programming, DcmDspRoutineSessionRef=DcmDspSession/Extended
        Vehicle_Identification (DcmDspDid):
          DcmDspDidIdentifier = 61840
          DcmDspDidUsed = true
          DcmDspDidUsePort = USE_DATA_ELEMENT_SPECIFIC_INTERFACES
          DcmDspDidInfoRef = DidInfo_Vehicle_Identification
          VIN (DcmDspDidSignal): DcmDspDidDataPos=0, DcmDspDidDataRef=Vehicle_Identification_VIN
        Vehicle_Identification_VIN (DcmDspData): DcmDspDataSize=136, DcmDspDataType=UINT8_N, DcmDspDataUsePort=USE_DATA_ASYNCH_CLIENT_SERVER, DcmDspDataInfoRef=DataInfo_Vehicle_Identification_VIN
        DidInfo_DID_0xF410 (DcmDspDidInfo)
          DcmDspDidAccess
            DcmDspDidRead
        DataInfo_PeriodicDataSample_DataRecord (DcmDspDataInfo): DcmDspDataFixedLength=true
        DidInfo_SampleDynamicallyDefinedNonPeriodicDID (DcmDspDidInfo): DcmDspDidDynamicallyDefined=true
          DcmDspDidAccess
            DcmDspDidDefine: DcmDspDDDidMaxElements=5
            DcmDspDidRead
        3 x DcmDspDataInfo, all with DcmDspDataFixedLength=true:
          DataInfo_DevelopmentData_DiagnosticModuleVersion
          DataInfo_Example_ReadWriteData_GlobalTime
          DataInfo_Hardware_Version_Hardware_Version_Number
        Hardware_Version (DcmDspDid): DcmDspDidIdentifier=61843, DcmDspDidUsed=true, DcmDspDidUsePort=USE_DATA_ELEMENT_SPECIFIC_INTERFACES, DcmDspDidInfoRef=DidInfo_Hardware_Version
          Hardware_Version_Number (DcmDspDidSignal): DcmDspDidDataPos=0, DcmDspDidDataRef=Hardware_Version_Hardware_Version_Number
        DataInfo_SampleIoControl_DID_Data (DcmDspDataInfo): DcmDspDataFixedLength=true
        DidInfo_Example_ReadOnlyDID (DcmDspDidInfo)
          DcmDspDidAccess
            DcmDspDidRead
        DataInfo_Spare_Part_Number_Spare_Part_Number (DcmDspDataInfo): DcmDspDataFixedLength=true
        SampleIoControl_DID_Data (DcmDspData):
          DcmDspDataConditionCheckReadFncUsed = false
          DcmDspDataSize = 32
          DcmDspDataType = UINT32
          DcmDspDataUsePort = USE_DATA_ASYNCH_CLIENT_SERVER
          DcmDspDataInfoRef = DataInfo_SampleIoControl_DID_Data
        DcmDspSecurity
          3 x DcmDspSecurityRow, all with DcmDspSecurityDelayTimeOnBoot=0, DcmDspSecurityAttemptCounterEnabled=false, DcmDspSecurityUsePort=USE_ASYNCH_CLIENT_SERVER:
            UnlockedL1: DcmDspSecurityDelayTime=10, DcmDspSecurityKeySize=4, DcmDspSecurityLevel=1, DcmDspSecurityNumAttDelay=3, DcmDspSecuritySeedSize=4
            Level_3: DcmDspSecurityDelayTime=10, DcmDspSecurityKeySize=2, DcmDspSecurityLevel=2, DcmDspSecurityNumAttDelay=3, DcmDspSecuritySeedSize=2
            Locked: DcmDspSecurityLevel=0, DcmDspSecurityDelayTime=0, DcmDspSecurityKeySize=4, DcmDspSecurityNumAttDelay=0, DcmDspSecuritySeedSize=4
        DID_0xF412 (DcmDspDid): DcmDspDidIdentifier=62482, DcmDspDidUsed=true, DcmDspDidUsePort=USE_DATA_ELEMENT_SPECIFIC_INTERFACES, DcmDspDidInfoRef=DidInfo_DID_0xF412
          DID_Data (DcmDspDidSignal): DcmDspDidDataPos=0, DcmDspDidDataRef=DID_0xF412_DID_Data
        DID_0xF413 (DcmDspDid): DcmDspDidIdentifier=62483, DcmDspDidUsed=true, DcmDspDidUsePort=USE_DATA_ELEMENT_SPECIFIC_INTERFACES, DcmDspDidInfoRef=DidInfo_DID_0xF413
          DID_Data (DcmDspDidSignal): DcmDspDidDataPos=0, DcmDspDidDataRef=DID_0xF413_DID_Data
        DcmDspControlDTCSetting: DcmSupportDTCSettingControlOptionRecord=true
        DidInfo_PeriodicDataSample (DcmDspDidInfo)
          DcmDspDidAccess
            DcmDspDidRead: DcmDspDidReadSessionRef=DcmDspSession/Programming, DcmDspDidReadSessionRef=DcmDspSession/Extended
        3 x DcmDspDid, all with DcmDspDidUsed=true, DcmDspDidUsePort=USE_DATA_ELEMENT_SPECIFIC_INTERFACES:
          DID_0xF410: DcmDspDidIdentifier=62480, DcmDspDidInfoRef=DidInfo_DID_0xF410
            DID_Data (DcmDspDidSignal): DcmDspDidDataPos=0, DcmDspDidDataRef=DID_0xF410_DID_Data
          EcuIdentification: DcmDspDidIdentifier=61833, DcmDspDidInfoRef=DidInfo_EcuIdentification
            Part_Number (DcmDspDidSignal): DcmDspDidDataPos=0, DcmDspDidDataRef=EcuIdentification_Part_Number
          Example_ReadOnlyDID: DcmDspDidIdentifier=1, DcmDspDidInfoRef=DidInfo_Example_ReadOnlyDID
            DID_Data_GlobalTime (DcmDspDidSignal): DcmDspDidDataPos=0, DcmDspDidDataRef=Example_ReadOnlyDID_DID_Data_GlobalTime
        PeriodicDataSample_DataRecord (DcmDspData):
          DcmDspDataSize = 16
          DcmDspDataType = UINT16
          DcmDspDataUsePort = USE_DATA_ASYNCH_CLIENT_SERVER
          DcmDspDataInfoRef = DataInfo_PeriodicDataSample_DataRecord
        SerialNumber (DcmDspDid): DcmDspDidIdentifier=61836, DcmDspDidUsed=true, DcmDspDidUsePort=USE_DATA_ELEMENT_SPECIFIC_INTERFACES, DcmDspDidInfoRef=DidInfo_SerialNumber
          SerialNumber (DcmDspDidSignal): DcmDspDidDataPos=0, DcmDspDidDataRef=SerialNumber_SerialNumber
        DataInfo_Vehicle_Identification_VIN (DcmDspDataInfo): DcmDspDataFixedLength=true
        CheckProgrammingPreconditions (DcmDspRoutine):
          DcmDspRequestResultsRoutineSupported = false
          DcmDspStopRoutineSupported = false
          DcmDspRoutineIdentifier = 515
          DcmDspRoutineFixedLength = false
          DcmDspRoutineUsePort = true
          DcmDspRoutineUsed = true
          DcmDspRoutineInfoRef = RoutineInfo_CheckProgrammingPreconditions
        DevelopmentData_DiagnosticModuleVersion (DcmDspData):
          DcmDspDataSize = 16
          DcmDspDataType = UINT16
          DcmDspDataUsePort = USE_DATA_ASYNCH_CLIENT_SERVER
          DcmDspDataInfoRef = DataInfo_DevelopmentData_DiagnosticModuleVersion
        DataInfo_DevelopmentData_CanDriverVersion (DcmDspDataInfo): DcmDspDataFixedLength=true
        Example_ReadOnlyDID_DID_Data_GlobalTime (DcmDspData):
          DcmDspDataSize = 48
          DcmDspDataType = UINT8_N
          DcmDspDataUsePort = USE_DATA_ASYNCH_CLIENT_SERVER
          DcmDspDataInfoRef = DataInfo_Example_ReadOnlyDID_DID_Data_GlobalTime
        Example_WriteOnlyDID (DcmDspDid): DcmDspDidIdentifier=4, DcmDspDidUsed=true, DcmDspDidUsePort=USE_DATA_ELEMENT_SPECIFIC_INTERFACES, DcmDspDidInfoRef=DidInfo_Example_WriteOnlyDID
          DID_DataObject (DcmDspDidSignal): DcmDspDidDataPos=0, DcmDspDidDataRef=Example_WriteOnlyDID_DID_DataObject
        DID_0xF410_DID_Data (DcmDspData): DcmDspDataSize=16, DcmDspDataType=UINT16, DcmDspDataUsePort=USE_DATA_ASYNCH_CLIENT_SERVER, DcmDspDataInfoRef=DataInfo_DID_0xF410_DID_Data
        DidInfo_SerialNumber (DcmDspDidInfo)
          DcmDspDidAccess
            DcmDspDidWrite
            DcmDspDidRead
        DataInfo_Example_WriteOnlyDID_DID_DataObject (DcmDspDataInfo): DcmDspDataFixedLength=true
        RoutineInfo_SampleRoutineControl_StartOnly (DcmDspRoutineInfo)
          DcmDspRoutineRequestResOut
            Out_Result (DcmDspRoutineRequestResOutSignal): DcmDspRoutineSignalLength=32, DcmDspRoutineSignalType=UINT32, DcmDspRoutineSignalEndianness=BIG_ENDIAN, DcmDspRoutineSignalPos=0
          DcmDspStartRoutineIn
            In_Option1 (DcmDspStartRoutineInSignal): DcmDspRoutineSignalLength=24, DcmDspRoutineSignalType=UINT8, DcmDspRoutineSignalEndianness=opaque, DcmDspRoutineSignalPos=0
          DcmDspRoutineAuthorization: DcmDspRoutineSessionRef=DcmDspSession/Programming, DcmDspRoutineSessionRef=DcmDspSession/Extended
        Example_ReadWriteData (DcmDspDid): DcmDspDidIdentifier=2, DcmDspDidUsed=true, DcmDspDidUsePort=USE_DATA_ELEMENT_SPECIFIC_INTERFACES, DcmDspDidInfoRef=DidInfo_Example_ReadWriteData
          GlobalTime (DcmDspDidSignal): DcmDspDidDataPos=0, DcmDspDidDataRef=Example_ReadWriteData_GlobalTime
        DataInfo_EcuIdentification_Part_Number (DcmDspDataInfo): DcmDspDataFixedLength=true
        3 x DcmDspData, all with DcmDspDataUsePort=USE_DATA_ASYNCH_CLIENT_SERVER:
          EcuIdentification_Part_Number: DcmDspDataSize=104, DcmDspDataType=UINT8_N, DcmDspDataInfoRef=DataInfo_EcuIdentification_Part_Number
          Spare_Part_Number_Spare_Part_Number: DcmDspDataSize=32, DcmDspDataType=UINT32, DcmDspDataInfoRef=DataInfo_Spare_Part_Number_Spare_Part_Number
          Example_WriteOnlyDID_DID_DataObject: DcmDspDataSize=8, DcmDspDataType=UINT8, DcmDspDataInfoRef=DataInfo_Example_WriteOnlyDID_DID_DataObject
        DidInfo_DevelopmentData (DcmDspDidInfo)
          DcmDspDidAccess
            DcmDspDidWrite
            DcmDspDidRead
        DidInfo_Spare_Part_Number (DcmDspDidInfo)
          DcmDspDidAccess
            DcmDspDidWrite
            DcmDspDidRead
        DID_0xF413_DID_Data (DcmDspData): DcmDspDataSize=16, DcmDspDataType=UINT16, DcmDspDataUsePort=USE_DATA_ASYNCH_CLIENT_SERVER, DcmDspDataInfoRef=DataInfo_DID_0xF413_DID_Data
        DataInfo_DevelopmentData_NmVersion (DcmDspDataInfo): DcmDspDataFixedLength=true
        DataInfo_Boot_Software_Boot_Software_Identification (DcmDspDataInfo): DcmDspDataFixedLength=true
        3 x DcmDspDidInfo:
          DidInfo_Boot_Software
            DcmDspDidAccess
              DcmDspDidWrite
              DcmDspDidRead
          DidInfo_Example_WriteOnlyDID
            DcmDspDidAccess
              DcmDspDidWrite
          DidInfo_SampleIoControl
            DcmDspDidAccess
              DcmDspDidControl:
                DcmDspDidFreezeCurrentState = true
                DcmDspDidResetToDefault = true
                DcmDspDidReturnControlToEcu = true
                DcmDspDidShortTermAdjustment = true
                DcmDspDidControlMask = DCM_CONTROLMASK_INTERNAL
                DcmDspDidControlSessionRef = DcmDspSession/Extended
              DcmDspDidRead
        SerialNumber_SerialNumber (DcmDspData): DcmDspDataSize=32, DcmDspDataType=UINT32, DcmDspDataUsePort=USE_DATA_ASYNCH_CLIENT_SERVER, DcmDspDataInfoRef=DataInfo_SerialNumber_SerialNumber
        DataInfo_DataDiagnosticIdentifier_DID_DataDiagnosticIdentifier (DcmDspDataInfo): DcmDspDataFixedLength=true
        DataInfo_Boot_Software_NumberOfModules (DcmDspDataInfo): DcmDspDataFixedLength=true
        DidInfo_Example_ReadWriteData (DcmDspDidInfo)
          DcmDspDidAccess
            DcmDspDidWrite
            DcmDspDidRead
        DataDiagnosticIdentifier_DID_DataDiagnosticIdentifier (DcmDspData):
          DcmDspDataSize = 16
          DcmDspDataType = UINT16
          DcmDspDataUsePort = USE_DATA_ASYNCH_CLIENT_SERVER
          DcmDspDataInfoRef = DataInfo_DataDiagnosticIdentifier_DID_DataDiagnosticIdentifier
        ComControl (DcmDspComControl)
          DspComContolAllChannel (DcmDspComControlAllChannel): DcmDspAllComMChannelRef=ComMConfigSet/CAN_f26020e5
        Boot_Software_Boot_Software_Identification (DcmDspData):
          DcmDspDataSize = 32
          DcmDspDataType = UINT32
          DcmDspDataUsePort = USE_DATA_ASYNCH_CLIENT_SERVER
          DcmDspDataInfoRef = DataInfo_Boot_Software_Boot_Software_Identification
        DataInfo_Example_ReadOnlyDID_DID_Data_GlobalTime (DcmDspDataInfo): DcmDspDataFixedLength=true
        DataDiagnosticIdentifier_DID (DcmDspDid):
          DcmDspDidIdentifier = 257
          DcmDspDidUsed = true
          DcmDspDidUsePort = USE_DATA_ELEMENT_SPECIFIC_INTERFACES
          DcmDspDidInfoRef = DidInfo_DataDiagnosticIdentifier_DID
          DataDiagnosticIdentifier (DcmDspDidSignal): DcmDspDidDataPos=0, DcmDspDidDataRef=DataDiagnosticIdentifier_DID_DataDiagnosticIdentifier
        DidInfo_Vehicle_Identification (DcmDspDidInfo)
          DcmDspDidAccess
            DcmDspDidWrite
            DcmDspDidRead
        DataInfo_DID_0xF412_DID_Data (DcmDspDataInfo): DcmDspDataFixedLength=true
        Example_ReadWriteData_GlobalTime (DcmDspData):
          DcmDspDataSize = 32
          DcmDspDataType = UINT32
          DcmDspDataUsePort = USE_DATA_ASYNCH_CLIENT_SERVER
          DcmDspDataInfoRef = DataInfo_Example_ReadWriteData_GlobalTime
        Hardware_Version_Hardware_Version_Number (DcmDspData):
          DcmDspDataSize = 32
          DcmDspDataType = UINT32
          DcmDspDataUsePort = USE_DATA_ASYNCH_CLIENT_SERVER
          DcmDspDataInfoRef = DataInfo_Hardware_Version_Hardware_Version_Number
        DidInfo_EcuIdentification (DcmDspDidInfo)
          DcmDspDidAccess
            DcmDspDidWrite
            DcmDspDidRead
        5 x DcmDspData, all with DcmDspDataSize=16, DcmDspDataType=UINT16, DcmDspDataUsePort=USE_DATA_ASYNCH_CLIENT_SERVER:
          DevelopmentData_NmVersion: DcmDspDataInfoRef=DataInfo_DevelopmentData_NmVersion
          DevelopmentData_OperatingSystemVersion: DcmDspDataInfoRef=DataInfo_DevelopmentData_OperatingSystemVersion
          DevelopmentData_TransportLayerVersion: DcmDspDataInfoRef=DataInfo_DevelopmentData_TransportLayerVersion
          DevelopmentData_CanDriverVersion: DcmDspDataInfoRef=DataInfo_DevelopmentData_CanDriverVersion
          DID_0xF412_DID_Data: DcmDspDataInfoRef=DataInfo_DID_0xF412_DID_Data
        RoutineInfo_SampleRoutineControl (DcmDspRoutineInfo)
          DcmDspRoutineRequestResOut
            Out_Result (DcmDspRoutineRequestResOutSignal): DcmDspRoutineSignalLength=16, DcmDspRoutineSignalType=UINT16, DcmDspRoutineSignalEndianness=BIG_ENDIAN, DcmDspRoutineSignalPos=0
          DcmDspStartRoutineIn
            In_Option0 (DcmDspStartRoutineInSignal): DcmDspRoutineSignalLength=8, DcmDspRoutineSignalType=UINT8, DcmDspRoutineSignalPos=0
          DcmDspRoutineAuthorization: DcmDspRoutineSessionRef=DcmDspSession/Programming, DcmDspRoutineSessionRef=DcmDspSession/Extended
          DcmDspRoutineStopOut
            Out_StopState (DcmDspRoutineStopOutSignal): DcmDspRoutineSignalLength=32, DcmDspRoutineSignalType=UINT32, DcmDspRoutineSignalEndianness=BIG_ENDIAN, DcmDspRoutineSignalPos=0
          DcmDspStartRoutineOut
            Out_InitState (DcmDspStartRoutineOutSignal): DcmDspRoutineSignalLength=32, DcmDspRoutineSignalType=UINT32, DcmDspRoutineSignalEndianness=BIG_ENDIAN, DcmDspRoutineSignalPos=0
        DcmDspSession
          3 x DcmDspSessionRow, all with DcmDspSessionP2ServerMax=0.05, DcmDspSessionP2StarServerMax=5, DcmDspSessionForBoot=DCM_NO_BOOT:
            Default: DcmDspSessionLevel=1
            Programming: DcmDspSessionLevel=2
            Extended: DcmDspSessionLevel=3
        Boot_Software_NumberOfModules (DcmDspData): DcmDspDataSize=8, DcmDspDataType=UINT8, DcmDspDataUsePort=USE_DATA_ASYNCH_CLIENT_SERVER, DcmDspDataInfoRef=DataInfo_Boot_Software_NumberOfModules
        SampleRoutineControl_StartOnly (DcmDspRoutine):
          DcmDspRequestResultsRoutineSupported = true
          DcmDspStopRoutineSupported = false
          DcmDspRoutineIdentifier = 260
          DcmDspRoutineFixedLength = false
          DcmDspRoutineUsePort = true
          DcmDspRoutineUsed = true
          DcmDspRoutineInfoRef = RoutineInfo_SampleRoutineControl_StartOnly
        ForceBootMode (DcmDspRoutine):
          DcmDspRequestResultsRoutineSupported = false
          DcmDspStopRoutineSupported = false
          DcmDspRoutineIdentifier = 62744
          DcmDspRoutineFixedLength = false
          DcmDspRoutineUsePort = true
          DcmDspRoutineUsed = true
          DcmDspRoutineInfoRef = RoutineInfo_ForceBootMode
        DcmDspMemory: DcmDspUseMemoryId=false
          DcmDspMemoryIdInfo
            DcmDspReadMemoryRangeInfo: DcmDspReadMemoryRangeHigh=4294967294, DcmDspReadMemoryRangeLow=0
            DcmDspWriteMemoryRangeInfo: DcmDspWriteMemoryRangeHigh=4294967294, DcmDspWriteMemoryRangeLow=0
        DidInfo_DID_StartApplication (DcmDspDidInfo)
          DcmDspDidAccess
            DcmDspDidRead
            DcmDspDidWrite
        DataInfo_DID_StartApplication (DcmDspDataInfo): DcmDspDataFixedLength=true
        Data_DID_StartApplication (DcmDspData): DcmDspDataSize=16, DcmDspDataUsePort=USE_DATA_SYNCH_CLIENT_SERVER, DcmDspDataType=UINT16, DcmDspDataInfoRef=DataInfo_DID_StartApplication
        DID_StartApplication (DcmDspDid): DcmDspDidIdentifier=85, DcmDspDidUsed=true, DcmDspDidUsePort=USE_DATA_ELEMENT_SPECIFIC_INTERFACES, DcmDspDidInfoRef=DidInfo_DID_StartApplication
          DcmDspDidSignal_Data_DID_StartApplication (DcmDspDidSignal): DcmDspDidDataPos=0, DcmDspDidDataRef=Data_DID_StartApplication
      DcmPageBufferCfg: DcmPagedBufferEnabled=true
  module config CanIf: implementation-config-variant=VARIANT-PRE-COMPILE, module-description=CanIf_Impl
    CanIfDispatchCfg:
      CanIfDispatchUserCtrlBusOffName = CanSM_ControllerBusOff
      CanIfDispatchUserCtrlBusOffUL = CAN_SM
      CanIfDispatchUserCtrlModeIndicationName = CanSM_ControllerModeIndication
      CanIfDispatchUserCtrlModeIndicationUL = CAN_SM
    Can (CanIfCtrlDrvCfg): CanIfCtrlDrvTxCancellation=false, CanIfCtrlDrvInitHohConfigRef=CanIfInitHohCfg, CanIfCtrlDrvNameRef=CanGeneral
      CT_CAN_e98c47e6 (CanIfCtrlCfg): CanIfCtrlId=0, CanIfCtrlWakeupSupport=false, CanIfCtrlJ1939DynAddrSupport=DISABLED, CanIfCtrlCanCtrlRef=CanConfigSet/CT_CAN_e98c47e6
    CanIfInitCfg
      3 x CanIfRxPduCfg, all with CanIfRxPduCanIdType=STANDARD_CAN, CanIfRxPduDlc=8, CanIfRxPduReadData=false, CanIfRxPduReadNotifyStatus=false, CanIfRxPduDlcCheck=true, CanIfRxPduHrhIdRef=CanIfInitHohCfg/CN_CAN_e98c47e6_Rx_Std:
        GlobalTimeMaster_oCAN_Rx_3abd61be: CanIfRxPduCanId=896, CanIfRxPduId=6, CanIfRxPduUserRxIndicationName=NULL_PTR, CanIfRxPduUserRxIndicationUL=NONE, CanIfRxPduRef=EcucPduCollection/PT_GlobalTimeMaster_PP_GlobalTimeMaster_Rx_346f2748_fe6ecc87
        msg_XCP_Request_MyECU_oCAN_Rx_3abd61be: CanIfRxPduCanId=1795, CanIfRxPduUserRxIndicationName=Xcp_CanIfRxIndication, CanIfRxPduUserRxIndicationUL=XCP, CanIfRxPduId=1, CanIfRxPduRef=PT_msg_XCP_Request_MyECU_PP_msg_XCP_Request_MyECU_Rx_346f2748_fe6ecc87
        msg_diag_RequestGlobal_Tp_oCAN_Rx_3abd61be: CanIfRxPduCanId=1556, CanIfRxPduUserRxIndicationName=CanTp_RxIndication, CanIfRxPduUserRxIndicationType=PDUID_PDUINFOPTR, CanIfRxPduUserRxIndicationUL=CAN_TP, CanIfRxPduId=2, CanIfRxPduRef=PT_msg_diag_RequestGlobal_Tp_PP_msg_diag_RequestGlobal_Tp_Rx_346f2748_fe6ecc87
      msg_XCP_Response_MyECU_oCAN_Tx_3abd61be (CanIfTxPduCfg):
        CanIfTxPduCanId = 1796
        CanIfTxPduCanIdType = STANDARD_CAN
        CanIfTxPduDlc = 8
        CanIfTxPduUserTxConfirmationName = Xcp_CanIfTxConfirmation
        CanIfTxPduUserTxConfirmationUL = XCP
        CanIfTxPduId = 0
        CanIfTxPduReadNotifyStatus = false
        CanIfTxPduType = STATIC
        CanIfTxPduBufferRef = CanIfBufferCfg_346f2748
        CanIfTxPduRef = PT_msg_XCP_Response_MyECU_PP_msg_XCP_Response_MyECU_Tx_346f2748_fe6ecc87
      CanIfBufferCfg_346f2748 (CanIfBufferCfg):  # CHNL
        CanIfBufferSize = 10
        CanIfTxBufferHandlingType = PRIO_BY_CANID
        CanIfTxBufferMappedTxPdus = 10
        CanIfTxBufferMaxPduLength = 8
        CanIfBufferHthRef = CanIfInitHohCfg/CN_CAN_e98c47e6_Tx
      msg_RxCycle_E2eProf1C_500_10_oCAN_Rx_3abd61be (CanIfRxPduCfg):
        CanIfRxPduCanId = 288
        CanIfRxPduCanIdType = STANDARD_CAN
        CanIfRxPduDlc = 8
        CanIfRxPduUserRxIndicationName = PduR_CanIfRxIndication
        CanIfRxPduUserRxIndicationUL = PDUR
        CanIfRxPduId = 9
        CanIfRxPduReadData = false
        CanIfRxPduReadNotifyStatus = false
        CanIfRxPduDlcCheck = true
        CanIfRxPduHrhIdRef = CanIfInitHohCfg/CN_CAN_e98c47e6_Rx_Std
        CanIfRxPduRef = PT_msg_RxCycle_E2eProf1C_500_10_PP_msg_RxCycle_E2eProf1C_500_10_Rx_346f2748_fe6ecc87
      msg_TxCycle1000_10_oCAN_Tx_3abd61be (CanIfTxPduCfg):
        CanIfTxPduCanId = 872
        CanIfTxPduCanIdType = STANDARD_CAN
        CanIfTxPduDlc = 2
        CanIfTxPduUserTxConfirmationName = NULL_PTR
        CanIfTxPduUserTxConfirmationUL = NONE
        CanIfTxPduId = 7
        CanIfTxPduReadNotifyStatus = false
        CanIfTxPduType = STATIC
        CanIfTxPduBufferRef = CanIfBufferCfg_346f2748
        CanIfTxPduRef = PT_msg_TxCycle1000_10_PP_msg_TxCycle1000_10_Tx_346f2748_fe6ecc87
      msg_diag_Request_MyECU_Slave3_oCAN_Rx_3abd61be (CanIfRxPduCfg):
        CanIfRxPduCanId = 1553
        CanIfRxPduCanIdType = STANDARD_CAN
        CanIfRxPduDlc = 8
        CanIfRxPduId = 3
        CanIfRxPduReadData = false
        CanIfRxPduReadNotifyStatus = false
        CanIfRxPduUserRxIndicationName = NULL_PTR
        CanIfRxPduUserRxIndicationUL = NONE
        CanIfRxPduDlcCheck = true
        CanIfRxPduHrhIdRef = CanIfInitHohCfg/CN_CAN_e98c47e6_Rx_Std
        CanIfRxPduRef = EcucPduCollection/PT_msg_diag_Request_MyECU_Slave3_PP_msg_diag_Request_MyECU_Slave3_Rx_346f2748_fe6ecc87
      msg_nm_MyECU_oCAN_Tx_3abd61be (CanIfTxPduCfg):
        CanIfTxPduCanId = 1024
        CanIfTxPduCanIdType = STANDARD_CAN
        CanIfTxPduDlc = 8
        CanIfTxPduUserTxConfirmationName = CanNm_TxConfirmation
        CanIfTxPduUserTxConfirmationUL = CAN_NM
        CanIfTxPduId = 5
        CanIfTxPduReadNotifyStatus = false
        CanIfTxPduType = STATIC
        CanIfTxPduBufferRef = CanIfBufferCfg_346f2748
        CanIfTxPduRef = PT_msg_nm_MyECU_PP_msg_nm_MyECU_Tx_346f2748_fe6ecc87
      msg_RxEvent_20_oCAN_Rx_3abd61be (CanIfRxPduCfg):
        CanIfRxPduCanId = 784
        CanIfRxPduCanIdType = STANDARD_CAN
        CanIfRxPduDlc = 4
        CanIfRxPduUserRxIndicationName = PduR_CanIfRxIndication
        CanIfRxPduUserRxIndicationUL = PDUR
        CanIfRxPduId = 7
        CanIfRxPduReadData = false
        CanIfRxPduReadNotifyStatus = false
        CanIfRxPduDlcCheck = true
        CanIfRxPduHrhIdRef = CanIfInitHohCfg/CN_CAN_e98c47e6_Rx_Std
        CanIfRxPduRef = PT_msg_RxEvent_20_PP_msg_RxEvent_20_Rx_346f2748_fe6ecc87
      3 x CanIfTxPduCfg, all with CanIfTxPduCanIdType=STANDARD_CAN, CanIfTxPduReadNotifyStatus=false, CanIfTxPduType=STATIC, CanIfTxPduBufferRef=CanIfBufferCfg_346f2748:
        msg_TxEvent_10_oCAN_Tx_3abd61be: CanIfTxPduCanId=360, CanIfTxPduDlc=7, CanIfTxPduUserTxConfirmationName=NULL_PTR, CanIfTxPduUserTxConfirmationUL=NONE, CanIfTxPduId=9, CanIfTxPduRef=PT_msg_TxEvent_10_PP_msg_TxEvent_10_Tx_346f2748_fe6ecc87
        msg_TxCycle_E2eProf1C_500_30_oCAN_Tx_3abd61be: CanIfTxPduCanId=888, CanIfTxPduDlc=8, CanIfTxPduUserTxConfirmationName=NULL_PTR, CanIfTxPduUserTxConfirmationUL=NONE, CanIfTxPduId=6, CanIfTxPduRef=PT_msg_TxCycle_E2eProf1C_500_30_PP_msg_TxCycle_E2eProf1C_500_30_Tx_346f2748_fe6ecc87
        msg_diag_Response_MyECU_Tp_oCAN_Tx_3abd61be: CanIfTxPduCanId=1554, CanIfTxPduDlc=8, CanIfTxPduUserTxConfirmationName=CanTp_TxConfirmation, CanIfTxPduUserTxConfirmationUL=CAN_TP, CanIfTxPduId=3, CanIfTxPduRef=PT_msg_diag_Response_MyECU_Tp_PP_msg_diag_Response_MyECU_Tp_Tx_346f2748_fe6ecc87
      msg_RxCycle500_20_oCAN_Rx_3abd61be (CanIfRxPduCfg):
        CanIfRxPduCanId = 272
        CanIfRxPduCanIdType = STANDARD_CAN
        CanIfRxPduDlc = 6
        CanIfRxPduUserRxIndicationName = PduR_CanIfRxIndication
        CanIfRxPduUserRxIndicationUL = PDUR
        CanIfRxPduId = 10
        CanIfRxPduReadData = false
        CanIfRxPduReadNotifyStatus = false
        CanIfRxPduDlcCheck = true
        CanIfRxPduHrhIdRef = CanIfInitHohCfg/CN_CAN_e98c47e6_Rx_Std
        CanIfRxPduRef = PT_msg_RxCycle500_20_PP_msg_RxCycle500_20_Rx_346f2748_fe6ecc87
      msg_diag_Request_MyECU_Tp_oCAN_Rx_3abd61be (CanIfRxPduCfg):
        CanIfRxPduCanId = 1552
        CanIfRxPduCanIdType = STANDARD_CAN
        CanIfRxPduDlc = 8
        CanIfRxPduUserRxIndicationName = CanTp_RxIndication
        CanIfRxPduUserRxIndicationType = PDUID_PDUINFOPTR
        CanIfRxPduUserRxIndicationUL = CAN_TP
        CanIfRxPduId = 4
        CanIfRxPduReadData = false
        CanIfRxPduReadNotifyStatus = false
        CanIfRxPduDlcCheck = true
        CanIfRxPduHrhIdRef = CanIfInitHohCfg/CN_CAN_e98c47e6_Rx_Std
        CanIfRxPduRef = PT_msg_diag_Request_MyECU_Tp_PP_msg_diag_Request_MyECU_Tp_Rx_346f2748_fe6ecc87
      msg_TxCycle10_0_oCAN_Tx_3abd61be (CanIfTxPduCfg):
        CanIfTxPduCanId = 616
        CanIfTxPduCanIdType = STANDARD_CAN
        CanIfTxPduDlc = 7
        CanIfTxPduUserTxConfirmationName = NULL_PTR
        CanIfTxPduUserTxConfirmationUL = NONE
        CanIfTxPduId = 8
        CanIfTxPduReadNotifyStatus = false
        CanIfTxPduType = STATIC
        CanIfTxPduBufferRef = CanIfBufferCfg_346f2748
        CanIfTxPduRef = PT_msg_TxCycle10_0_PP_msg_TxCycle10_0_Tx_346f2748_fe6ecc87
      msg_StartAppl_Rx_MyECU_oCAN_Rx_3abd61be (CanIfRxPduCfg):
        CanIfRxPduCanId = 1281
        CanIfRxPduCanIdType = STANDARD_CAN
        CanIfRxPduDlc = 8
        CanIfRxPduUserRxIndicationName = PduR_CanIfRxIndication
        CanIfRxPduUserRxIndicationUL = PDUR
        CanIfRxPduId = 5
        CanIfRxPduReadData = false
        CanIfRxPduReadNotifyStatus = false
        CanIfRxPduDlcCheck = true
        CanIfRxPduHrhIdRef = CanIfInitHohCfg/CN_CAN_e98c47e6_Rx_Std
        CanIfRxPduRef = PT_msg_StartAppl_Rx_MyECU_PP_msg_StartAppl_Rx_MyECU_Rx_346f2748_fe6ecc87
      CanIfInitHohCfg: CanIfInitRefCfgSet=CanConfigSet
        CN_CAN_e98c47e6_Rx_Std (CanIfHrhCfg): CanIfHrhSoftwareFilter=true, CanIfHrhCanCtrlIdRef=Can/CT_CAN_e98c47e6, CanIfHrhIdSymRef=CanConfigSet/CN_CAN_e98c47e6_Rx_Std
        CN_CAN_e98c47e6_Tx (CanIfHthCfg): CanIfHthCanCtrlIdRef=Can/CT_CAN_e98c47e6, CanIfHthIdSymRef=CanConfigSet/CN_CAN_e98c47e6_Tx
      msg_RxCycle100_0_oCAN_Rx_3abd61be (CanIfRxPduCfg):
        CanIfRxPduCanId = 528
        CanIfRxPduCanIdType = STANDARD_CAN
        CanIfRxPduDlc = 1
        CanIfRxPduUserRxIndicationName = PduR_CanIfRxIndication
        CanIfRxPduUserRxIndicationUL = PDUR
        CanIfRxPduId = 8
        CanIfRxPduReadData = false
        CanIfRxPduReadNotifyStatus = false
        CanIfRxPduDlcCheck = true
        CanIfRxPduHrhIdRef = CanIfInitHohCfg/CN_CAN_e98c47e6_Rx_Std
        CanIfRxPduRef = PT_msg_RxCycle100_0_PP_msg_RxCycle100_0_Rx_346f2748_fe6ecc87
      msg_StartAppl_Tx_MyECU_oCAN_Tx_3abd61be (CanIfTxPduCfg):
        CanIfTxPduCanId = 1280
        CanIfTxPduCanIdType = STANDARD_CAN
        CanIfTxPduDlc = 8
        CanIfTxPduUserTxConfirmationName = NULL_PTR
        CanIfTxPduUserTxConfirmationUL = NONE
        CanIfTxPduId = 4
        CanIfTxPduReadNotifyStatus = false
        CanIfTxPduType = STATIC
        CanIfTxPduBufferRef = CanIfBufferCfg_346f2748
        CanIfTxPduRef = PT_msg_StartAppl_Tx_MyECU_PP_msg_StartAppl_Tx_MyECU_Tx_346f2748_fe6ecc87
      msg_diag_Response_MyECU_Slave3_oCAN_Tx_3abd61be (CanIfTxPduCfg):
        CanIfTxPduCanId = 1555
        CanIfTxPduCanIdType = STANDARD_CAN
        CanIfTxPduDlc = 8
        CanIfTxPduId = 2
        CanIfTxPduReadNotifyStatus = false
        CanIfTxPduType = STATIC
        CanIfTxPduUserTxConfirmationUL = PDUR
        CanIfTxPduUserTxConfirmationName = PduR_CanIfTxConfirmation
        CanIfTxPduBufferRef = CanIfBufferCfg_346f2748
        CanIfTxPduRef = EcucPduCollection/PT_msg_diag_Response_MyECU_Slave3_PP_msg_diag_Response_MyECU_Slave3_Tx_346f2748_fe6ecc87
      MyECU_5f8bc0cc_NMCanIDRange (CanIfRxPduCfg):
        CanIfRxPduCanIdType = STANDARD_CAN
        CanIfRxPduDlc = 8
        CanIfRxPduUserRxIndicationName = CanNm_RxIndication
        CanIfRxPduUserRxIndicationUL = CAN_NM
        CanIfRxPduId = 0
        CanIfRxPduReadData = false
        CanIfRxPduReadNotifyStatus = false
        CanIfRxPduDlcCheck = true
        CanIfRxPduHrhIdRef = CanIfInitHohCfg/CN_CAN_e98c47e6_Rx_Std
        CanIfRxPduRef = MyECU_NmRxPdu_5f8bc0cc
        CHNL (CanIfRxPduCanIdRange): CanIfRxPduCanIdRangeLowerCanId=1024, CanIfRxPduCanIdRangeUpperCanId=1087
      msg_diag_Uudt_Response_MyECU_oCAN_Tx_3abd61be (CanIfTxPduCfg):
        CanIfTxPduCanId = 1558
        CanIfTxPduCanIdType = STANDARD_CAN
        CanIfTxPduDlc = 8
        CanIfTxPduUserTxConfirmationName = PduR_CanIfTxConfirmation
        CanIfTxPduUserTxConfirmationUL = PDUR
        CanIfTxPduId = 1
        CanIfTxPduReadNotifyStatus = false
        CanIfTxPduType = STATIC
        CanIfTxPduBufferRef = CanIfBufferCfg_346f2748
        CanIfTxPduRef = PT_msg_diag_Uudt_Response_MyECU_PP_msg_diag_Uudt_Response_MyECU_Tx_346f2748_fe6ecc87
    CanIfPrivateCfg:
      CanIfPrivateSoftwareFilterType = LINEAR
      CanIfPrivateDlcCheck = true
      CanIfSupportTTCAN = false
      CanIfTransceiverMapping = false
      CanIfTransceiverHandling = false
      CanIfSupportExtendedIds = false
      CanIfSupportNmOsek = false
      CanIfTxBufferType = BYTE_QUEUE
      CanIfOptimizeOneController = true
      CanIfWakeupSupport = false
      CanIfStaticFdTxBufferSupport = false
      CanIfRxSearchConsiderMsgType = false
      CanIfMultipleBasicCANTxObjects = false
      CanIfTxBufferFifoSupport = false
      CanIfSetPduReceptionModeSupport = false
      CanIfDataChecksumRxSupport = false
      CanIfDataChecksumTxSupport = false
    CanIfPublicCfg:
      CanIfPublicPnSupport = false
      CanIfPublicCancelTransmitSupport = true
      CanIfPublicDevErrorDetect = true
      CanIfPublicHandleTypeEnum = UINT8
      CanIfPublicMultipleDrvSupport = false
      CanIfPublicNumberOfCanHwUnits = 1
      CanIfPublicReadRxPduDataApi = false
      CanIfPublicReadRxPduNotifyStatusApi = false
      CanIfPublicReadTxPduNotifyStatusApi = false
      CanIfPublicSetDynamicTxIdApi = false
      CanIfPublicTxBuffering = true
      CanIfPublicTxConfirmPollingSupport = false
      CanIfPublicVersionInfoApi = false
      CanIfPublicWakeupCheckValidSupport = false
      CanIfPnWakeupTxPduFilterSupport = false
      CanIfPnTrcvHandlingSupport = false
      CanIfJ1939DynAddrSupport = DISABLED
      CanIfSafeBswChecks = false
      CanIfSetBaudrateApi = false
  module config Can: implementation-config-variant=VARIANT-PRE-COMPILE, module-description=Can_Impl
    CanConfigSet
      CN_CAN_e98c47e6_Tx (CanHardwareObject):
        CanHandleType = BASIC
        CanIdValue = 0
        CanObjectType = TRANSMIT
        CanIdType = STANDARD
        CanObjectId = 0
        CanHwProcessing = false
        CanObjectHwSize = 1
        CanObjectHwHandle = 0
        CanMaxDataLen = 8
        CanFdPaddingValue = 0
        CanObjectMultiplexedTransmission = false
        CanControllerRef = CanConfigSet/CT_CAN_e98c47e6
      CT_CAN_e98c47e6 (CanController):
        CanControllerActivation = true
        CanBusoffProcessing = INTERRUPT
        CanControllerBaseAddress = 4026630656
        CanControllerId = 0
        CanRxProcessing = INTERRUPT
        CanTxProcessing = INTERRUPT
        CanWakeupProcessing = INTERRUPT
        CanWakeupSupport = false
        CanWakeupSourceId = 0
        CanPhysicalNode = Node0
        CanIOPort = b_000
        CanInterruptPriority = 10
        CanSRC = 0
        CanChannelCanObjectStartIndex = 0
        CanNumberOfCANObj = 7
        CanSrcTos = CPU0
        CanInterruptGroupPriority = 0
        CanClockFrequency = 60000000
        CanControllerDefaultBaudrate = CanControllerBaudrateConfig
        CanControllerSystemRef = CT_CAN
        CanWakeupSourceRef = EcuMCommonConfiguration/CAN_f26020e5
        CanCpuClockRef = McuClockReferencePoint
        CanControllerBaudrateConfig:
          CanControllerBaudRate = 500
          CanControllerBaudRateConfigID = 0
          CanControllerPropSeg = 7
          CanControllerSeg1 = 8
          CanControllerSeg2 = 4
          CanControllerSyncJumpWidth = 1
          CanBaudrateClock = 60000
          CanBaudratePrescaler = 6
          CanBaudrateDiv8 = false
        CanFilterMask: CanFilterMaskValue=0, CanFilterCodeValue=0, IsLocked=false
      CN_CAN_e98c47e6_Rx_Std (CanHardwareObject):
        CanHandleType = BASIC
        CanIdType = STANDARD
        CanIdValue = 0
        CanObjectType = RECEIVE
        CanObjectId = 1
        CanHwProcessing = false
        CanObjectHwSize = 2
        CanObjectHwHandle = 1
        CanMaxDataLen = 8
        CanFdPaddingValue = 0
        CanObjectMultiplexedTransmission = false
        CanControllerRef = CanConfigSet/CT_CAN_e98c47e6
        CanFilterMaskRef = CanFilterMask
    CanGeneral:
      CanIndex = 0
      CanChangeBaudrateApi = false
      CanDevErrorDetection = true
      CanHardwareCancellation = false
      CanIdenticalIdCancellation = false
      CanMainFunctionBusoffPeriod = 0.01
      CanMainFunctionModePeriod = 0.01
      CanMainFunctionWakeupPeriod = 0.01
      CanMultiplexedTransmission = false
      CanSetBaudrateApi = false
      CanTimeoutDuration = 0.01
      CanVersionInfoApi = false
      CanGenericPrecopy = false
      CanHardwareLoopCheck = true
      CanSecureTempBuffer = false
      CanRxFullCANSupport = false
      CanTxFullCANSupport = false
      CanRxBasicCANSupport = true
      CanUseNestedCANInterrupts = false
      CanHardwareCancelByAppl = false
      CanIndividualProcessing = false
      CanGenericConfirmation = false
      CanRxQueue = false
      CanSupportMixedID = false
      CanRxQueueSize = 10
      CanMultipleBasicCANObjects = false
      CanMultipleBasicCANTxObjects = false
      CanHardwareHandleType = UINT8
      CanOptimizeOneController = true
      CanInterruptCategory = CATEGORY2
      CanGetStatus = false
      CanInterruptLock = DRIVER
      CanWakeupSupport = false
      CanRamCheck = None
      CanOverrunNotification = DET
      CanReinitStart = false
      CanGenericPreTransmit = false
      CanFdSupport = NONE
      CanRuntimeMeasurementSupport = false
      CanMaxRxDataLen = 8
      CanMaxTxDataLen = 8
      CanUsePeripheralAccessApi = false
      CanEnableMultipleCanDriver = false
      CanMaxNumberOfHwCANChannels = 3
      CanMaxNumberOfHwCANChannelsR = 3
      CanMaxNumberOfHwCANObj = 128
      CanMaxNumberOfHwCANObjR = 128
      CanClockDividerMode = NORMAL
      CanClockDivider = 1
      CanBaseAddress = 4026630144
      CanBaseAddressR = 4026695680
      CanSrcAddress = 4026763520
      CanSrcAddressR = 4026763584
      CanClockSourceSelection = Fosc
      CanFreezeDisable = false
      CanMirrorModeSupport = false
      CanUseOsInterruptControl = true
      CanRxHwFiFoFullNotification = false
      CanFdIsoSupport = false
      CanFdNiso = false
      CanFdPed = false
      CanSilentModeSupport = false
      CanSafeBswChecks = false
      CanCounterRef = SystemTimer
      CanMainFunctionRWPeriods
  module config CanTp: implementation-config-variant=VARIANT-PRE-COMPILE, module-description=CanTp_Impl
    CanTpGeneral:
      CanTpChangeParameterApi = false
      CanTpDevErrorDetect = true
      CanTpPaddingByte = 204
      CanTpReadParameterApi = false
      CanTpVersionInfoApi = false
      CanTpPaddingActive = true
      CanTpHavePaddingByte = false
      CanTpNumRxChannels = 0
      CanTpNumTxChannels = 0
      CanTpEnableSplitMainFunction = false
      CanTpSupportStandardAddressing = true
      CanTpSupportExtendedAddressing = true
      CanTpSupportMixed11Addressing = true
      CanTpOnlyNotifyInformedAppl = true
      CanTpRc = false
      CanTpTc = true
      CanTpSafeBswChecks = false
      CanTpEnableConstantBS = true
      CanTpEnableTransmitQueue = false
      CanTpUseOnlyFirstFc = true
      CanTpEnableSynchronousTransmit = true
    CanTpConfig: CanTpMainFunctionPeriod=0.005
      TPCH_df418442 (CanTpChannel): CanTpChannelMode=CANTP_MODE_FULL_DUPLEX
        RxNSdu_df418442 (CanTpRxNSdu):
          CanTpRxAddressingFormat = CANTP_STANDARD
          CanTpRxDl = 8
          CanTpRxTaType = CANTP_FUNCTIONAL
          CanTpNbr = 0.1
          CanTpRxNSduId = 1
          CanTpRxPaddingActivation = CANTP_ON
          CanTpRxNSduRef = EcucPduCollection/PT_msg_diag_RequestGlobal_PP_msg_diag_RequestGlobal_Rx_346f2748_fe6ecc87
          CanTpRxNPdu_a6b5883d (CanTpRxNPdu): CanTpRxNPduId=1, CanTpRxNPduRef=PT_msg_diag_RequestGlobal_Tp_PP_msg_diag_RequestGlobal_Tp_Rx_346f2748_fe6ecc87
      TPCH_2afe666d (CanTpChannel): CanTpChannelMode=CANTP_MODE_FULL_DUPLEX
        RxNSdu_2afe666d (CanTpRxNSdu):
          CanTpRxAddressingFormat = CANTP_STANDARD
          CanTpRxDl = 8
          CanTpRxTaType = CANTP_PHYSICAL
          CanTpNbr = 0.1
          CanTpRxNSduId = 0
          CanTpRxPaddingActivation = CANTP_ON
          CanTpBs = 8
          CanTpNar = 0.1
          CanTpNcr = 0.5
          CanTpRxWftMax = 15
          CanTpSTmin = 0.02
          CanTpRxNSduRef = EcucPduCollection/PT_msg_diag_Request_MyECU_PP_msg_diag_Request_MyECU_Rx_346f2748_fe6ecc87
          CanTpTxFcNPdu_389d90ae (CanTpTxFcNPdu): CanTpTxFcNPduConfirmationPduId=0, CanTpTxFcNPduRef=PT_msg_diag_Response_MyECU_Tp_PP_msg_diag_Response_MyECU_Tp_Tx_346f2748_fe6ecc87
          CanTpRxNPdu_389d90ae (CanTpRxNPdu): CanTpRxNPduId=0, CanTpRxNPduRef=PT_msg_diag_Request_MyECU_Tp_PP_msg_diag_Request_MyECU_Tp_Rx_346f2748_fe6ecc87
        TxNSdu_7c5f02f8 (CanTpTxNSdu):
          CanTpTxAddressingFormat = CANTP_STANDARD
          CanTpTxDl = 8
          CanTpTxTaType = CANTP_PHYSICAL
          CanTpNas = 0.1
          CanTpNcs = 0.2
          CanTpTc = false
          CanTpTxNSduId = 0
          CanTpTxPaddingActivation = CANTP_ON
          CanTpNbs = 0.5
          CanTpTxNSduRef = EcucPduCollection/PT_msg_diag_Response_MyECU_PP_msg_diag_Response_MyECU_Tx_346f2748_fe6ecc87
          CanTpTxNPdu_5a3ff36f (CanTpTxNPdu): CanTpTxNPduConfirmationPduId=0, CanTpTxNPduRef=PT_msg_diag_Response_MyECU_Tp_PP_msg_diag_Response_MyECU_Tp_Tx_346f2748_fe6ecc87
          CanTpRxFcNPdu_5a3ff36f (CanTpRxFcNPdu): CanTpRxFcNPduId=0, CanTpRxFcNPduRef=PT_msg_diag_Request_MyECU_Tp_PP_msg_diag_Request_MyECU_Tp_Rx_346f2748_fe6ecc87
  module config CanNm: implementation-config-variant=VARIANT-PRE-COMPILE, module-description=CanNm_Impl
    CanNmGlobalConfig:
      CanNmComUserDataSupport = true
      CanNmPnEiraCalcEnabled = false
      CanNmUserDataEnabled = true
      CanNmBusLoadReductionEnabled = false
      CanNmBusSynchronizationEnabled = false
      CanNmComControlEnabled = false
      CanNmCoordinatorSyncSupport = false
      CanNmDevErrorDetect = true
      CanNmImmediateRestartEnabled = false
      CanNmImmediateTxconfEnabled = false
      CanNmMainFunctionPeriod = 0.01
      CanNmNodeDetectionEnabled = false
      CanNmPassiveModeEnabled = false
      CanNmPduRxIndicationEnabled = false
      CanNmRemoteSleepIndEnabled = false
      CanNmRepeatMsgIndEnabled = false
      CanNmStateChangeIndEnabled = false
      CanNmVersionInfoApi = false
      CanNmDisableTxErrReport = false
      CanNmApiOptimization = false
      CanNmCanIfRangeConfigDLCCheck = true
      CanNmNodeIdEnabled = true
      CanNmRuntimeMeasurementSupport = false
      CanNmSafeBswChecks = false
      CAN_17d0077e (CanNmChannelConfig):
        CanNmMsgCycleTime = 0.1
        CanNmMsgReducedTime = 0.05
        CanNmNodeId = 0
        CanNmPduCbvPosition = CANNM_PDU_BYTE_0
        CanNmPduNidPosition = CANNM_PDU_BYTE_1
        CanNmRepeatMessageTime = 0.4
        CanNmTimeoutTime = 1
        CanNmUserDataLength = 6
        CanNmWaitBusSleepTime = 0.75
        CanNmBusLoadReductionActive = false
        CanNmCarWakeUpRxEnabled = false
        CanNmImmediateNmTransmissions = 0
        CanNmMsgCycleOffset = 0
        CanNmMsgTimeoutTime = 0.06
        CanNmRemoteSleepIndTime = 0.5
        CanNmActiveWakeupBitEnabled = false
        CanNmComMNetworkHandleRef = ComMConfigSet/CAN_f26020e5
        CAN_17d0077e_RxPdu_5c9d081e (CanNmRxPdu): CanNmRxPduId=0, CanNmRxPduRef=MyECU_NmRxPdu_5f8bc0cc
        msg_nm_MyECU_oCAN_TxPdu_3abd61be (CanNmTxPdu): CanNmTxConfirmationPduId=0, CanNmTxPduRef=PT_msg_nm_MyECU_PP_msg_nm_MyECU_Tx_346f2748_fe6ecc87
        NmUsrData_msg_nm_MyECU_oCAN_3abd61be (CanNmUserDataTxPdu): CanNmTxUserDataPduId=0, CanNmTxUserDataPduRef=EcucPduCollection/NmUsrData_msg_nm_MyECU_oCAN_3abd61be  # msg_nm_MyECU_oCAN
      CanNmGeneration: CanNmOutOfBoundsWriteSanitizer=false, CanNmOutOfBoundsReadSanitizer=false, CanNmInterfacesForDeactivatedData=false
  module config Det: implementation-config-variant=VARIANT-PRE-COMPILE, module-description=Det_Impl
    DetGeneral:
      DetVersionInfoApi = false
      DetEnableDet = true
      DetExtDebugSupport = true
      DetGlobalFilterSize = 10
      DetBreakFilterSize = 0
      DetLogBufferSize = 0
      DetReportErrorRecursionLimit = 0
      DetReportRuntimeErrorRecursionLimit = 0
      DetReportTransientFaultRecursionLimit = 0
      DetDltFilterSize = 0
      DetForwardToDlt = false
    DetConfigSet
  module config PduR: implementation-config-variant=VARIANT-PRE-COMPILE, module-description=PduR_Impl
    PduRGeneral: PduRDevErrorDetect=true, PduRVersionInfoApi=false, PduRMetaDataSupport=false, PduRPduCallback=false, PduRSwitching=false, PduRSafeBswChecks=false
      PduRGeneration:
        PduROutOfBoundsWriteProtectionStrategy = NONE
        PduROutOfBoundsWriteSanitizer = false
        PduROutOfBoundsReadSanitizer = false
        PduRNumericalDataTypeMinimizationStrategy = WITH_CAST
        PduRReduceConstantData2Define = false
        PduRBoolDataInArrayOfStructStrategy = BITMASKING
        PduRDeduplicateIndirectedData = true
        PduRDataDeduplicationStrategy = WITH_CAST
        PduRReduceBoolDataByNegationThreshold = 2
        PduRReduceBoolDataByNumericalComparisonThreshold = 2
        PduRReduceBoolDataByNumericalRelationThreshold = 2
        PduRReduceBoolDataByNumericalOperandStrategy = WITH_ANY_VALUE
        PduRReduceNumericalDataByOffsetThreshold = 2
        PduRReduceNumericalDataByArraySubtractionThreshold = 2
        PduRReduceDataByStreaming = false
        PduRShortSymbols = false
        PduRInterfacesForDeactivatedData = false
        PduRReferringKeysInComments = false
    PduRRoutingTables: PduRConfigurationId=0
      PduRRoutingTable
        18 x PduRRoutingPath:
          Can_PT_msg_StartAppl_Tx_MyECU_346f2748: PduRRoutingPathCommunicationType=COMMUNICATION_INTERFACE  # msg_StartAppl_Tx_MyECU_oCAN
            DST_Can_PT_msg_StartAppl_Tx_MyECU_346f2748 (PduRDestPdu):
              PduRDestPduHandleId = 1
              PduRDestPduDirection = TRANSMIT
              PduRDestPduRoutingType = API_FORWARDING
              PduRDestPduDataProvision = PDUR_DIRECT
              PduRTransmissionConfirmation = false
              PduRDestPduRef = PT_msg_StartAppl_Tx_MyECU_PP_msg_StartAppl_Tx_MyECU_Tx_346f2748_fe6ecc87
              PduRDestPduPduRBswModulesRef = PduR/CanIf
            SRC_Can_PT_msg_StartAppl_Tx_MyECU_346f2748 (PduRSrcPdu):
              PduRSourcePduHandleId = 0
              PduRSrcPduDirection = TRANSMIT
              PduRSrcPduRef = PT_msg_StartAppl_Tx_MyECU_PP_msg_StartAppl_Tx_MyECU_Tx_346f2748_fe6ecc87
              PduRSrcPduPduRBswModulesRef = PduR/Com
          Can_PT_msg_diag_RequestGlobal_346f2748: PduRRoutingPathCommunicationType=TRANSPORT_PROTOCOL  # msg_diag_RequestGlobal_oCAN
            DST_Can_PT_msg_diag_RequestGlobal_346f2748 (PduRDestPdu):
              PduRDestPduHandleId = 0
              PduRDestPduDirection = RECEIVE
              PduRDestPduRoutingType = API_FORWARDING
              PduRDestPduRef = EcucPduCollection/PT_msg_diag_RequestGlobal_PP_msg_diag_RequestGlobal_Rx_346f2748_fe6ecc87
              PduRDestPduPduRBswModulesRef = PduR/Dcm
            SRC_Can_PT_msg_diag_RequestGlobal_346f2748 (PduRSrcPdu):
              PduRSourcePduHandleId = 0
              PduRSrcPduDirection = RECEIVE
              PduRSrcPduRef = EcucPduCollection/PT_msg_diag_RequestGlobal_PP_msg_diag_RequestGlobal_Rx_346f2748_fe6ecc87
              PduRSrcPduPduRBswModulesRef = PduR/CanTp
          Can_PT_msg_RxCycle100_0_346f2748: PduRRoutingPathCommunicationType=COMMUNICATION_INTERFACE  # msg_RxCycle100_0_oCAN
            SRC_Can_PT_msg_RxCycle100_0_346f2748 (PduRSrcPdu):
              PduRSourcePduHandleId = 0
              PduRSrcPduDirection = RECEIVE
              PduRSrcPduRef = PT_msg_RxCycle100_0_PP_msg_RxCycle100_0_Rx_346f2748_fe6ecc87
              PduRSrcPduPduRBswModulesRef = PduR/CanIf
            DST_Can_PT_msg_RxCycle100_0_346f2748 (PduRDestPdu):
              PduRDestPduHandleId = 1
              PduRDestPduDirection = RECEIVE
              PduRDestPduRoutingType = API_FORWARDING
              PduRTransmissionConfirmation = false
              PduRDestPduRef = PT_msg_RxCycle100_0_PP_msg_RxCycle100_0_Rx_346f2748_fe6ecc87
              PduRDestPduPduRBswModulesRef = PduR/Com
          Can_PT_msg_RxCycle500_20_346f2748: PduRRoutingPathCommunicationType=COMMUNICATION_INTERFACE  # msg_RxCycle500_20_oCAN
            DST_Can_PT_msg_RxCycle500_20_346f2748 (PduRDestPdu):
              PduRDestPduHandleId = 2
              PduRDestPduDirection = RECEIVE
              PduRDestPduRoutingType = API_FORWARDING
              PduRTransmissionConfirmation = false
              PduRDestPduRef = PT_msg_RxCycle500_20_PP_msg_RxCycle500_20_Rx_346f2748_fe6ecc87
              PduRDestPduPduRBswModulesRef = PduR/Com
            SRC_Can_PT_msg_RxCycle500_20_346f2748 (PduRSrcPdu):
              PduRSourcePduHandleId = 1
              PduRSrcPduDirection = RECEIVE
              PduRSrcPduRef = PT_msg_RxCycle500_20_PP_msg_RxCycle500_20_Rx_346f2748_fe6ecc87
              PduRSrcPduPduRBswModulesRef = PduR/CanIf
          Can_PT_msg_diag_Request_MyECU_346f2748: PduRRoutingPathCommunicationType=TRANSPORT_PROTOCOL  # msg_diag_Request_MyECU_oCAN
            DST_Can_PT_msg_diag_Request_MyECU_346f2748 (PduRDestPdu):
              PduRDestPduHandleId = 1
              PduRDestPduDirection = RECEIVE
              PduRDestPduRoutingType = API_FORWARDING
              PduRDestPduRef = EcucPduCollection/PT_msg_diag_Request_MyECU_PP_msg_diag_Request_MyECU_Rx_346f2748_fe6ecc87
              PduRDestPduPduRBswModulesRef = PduR/Dcm
            SRC_Can_PT_msg_diag_Request_MyECU_346f2748 (PduRSrcPdu):
              PduRSourcePduHandleId = 1
              PduRSrcPduDirection = RECEIVE
              PduRSrcPduRef = EcucPduCollection/PT_msg_diag_Request_MyECU_PP_msg_diag_Request_MyECU_Rx_346f2748_fe6ecc87
              PduRSrcPduPduRBswModulesRef = PduR/CanTp
          Can_PT_msg_RxEvent_20_346f2748: PduRRoutingPathCommunicationType=COMMUNICATION_INTERFACE  # msg_RxEvent_20_oCAN
            SRC_Can_PT_msg_RxEvent_20_346f2748 (PduRSrcPdu):
              PduRSourcePduHandleId = 3
              PduRSrcPduDirection = RECEIVE
              PduRSrcPduRef = PT_msg_RxEvent_20_PP_msg_RxEvent_20_Rx_346f2748_fe6ecc87
              PduRSrcPduPduRBswModulesRef = PduR/CanIf
            DST_Can_PT_msg_RxEvent_20_346f2748 (PduRDestPdu):
              PduRDestPduHandleId = 4
              PduRDestPduDirection = RECEIVE
              PduRDestPduRoutingType = API_FORWARDING
              PduRTransmissionConfirmation = false
              PduRDestPduRef = PT_msg_RxEvent_20_PP_msg_RxEvent_20_Rx_346f2748_fe6ecc87
              PduRDestPduPduRBswModulesRef = PduR/Com
          Can_PT_msg_RxCycle_E2eProf1C_500_10_346f2748: PduRRoutingPathCommunicationType=COMMUNICATION_INTERFACE  # msg_RxCycle_E2eProf1C_500_10_oCAN
            DST_Can_PT_msg_RxCycle_E2eProf1C_500_10_346f2748 (PduRDestPdu):
              PduRDestPduHandleId = 3
              PduRDestPduDirection = RECEIVE
              PduRDestPduRoutingType = API_FORWARDING
              PduRTransmissionConfirmation = false
              PduRDestPduRef = PT_msg_RxCycle_E2eProf1C_500_10_PP_msg_RxCycle_E2eProf1C_500_10_Rx_346f2748_fe6ecc87
              PduRDestPduPduRBswModulesRef = PduR/Com
            SRC_Can_PT_msg_RxCycle_E2eProf1C_500_10_346f2748 (PduRSrcPdu):
              PduRSourcePduHandleId = 2
              PduRSrcPduDirection = RECEIVE
              PduRSrcPduRef = PT_msg_RxCycle_E2eProf1C_500_10_PP_msg_RxCycle_E2eProf1C_500_10_Rx_346f2748_fe6ecc87
              PduRSrcPduPduRBswModulesRef = PduR/CanIf
          Can_PT_msg_StartAppl_Rx_MyECU_346f2748: PduRRoutingPathCommunicationType=COMMUNICATION_INTERFACE  # msg_StartAppl_Rx_MyECU_oCAN
            DST_Can_PT_msg_StartAppl_Rx_MyECU_346f2748 (PduRDestPdu):
              PduRDestPduHandleId = 5
              PduRDestPduDirection = RECEIVE
              PduRDestPduRoutingType = API_FORWARDING
              PduRTransmissionConfirmation = false
              PduRDestPduRef = PT_msg_StartAppl_Rx_MyECU_PP_msg_StartAppl_Rx_MyECU_Rx_346f2748_fe6ecc87
              PduRDestPduPduRBswModulesRef = PduR/Com
            SRC_Can_PT_msg_StartAppl_Rx_MyECU_346f2748 (PduRSrcPdu):
              PduRSourcePduHandleId = 4
              PduRSrcPduDirection = RECEIVE
              PduRSrcPduRef = PT_msg_StartAppl_Rx_MyECU_PP_msg_StartAppl_Rx_MyECU_Rx_346f2748_fe6ecc87
              PduRSrcPduPduRBswModulesRef = PduR/CanIf
          Can_PT_msg_TxCycle_E2eProf1C_500_30_346f2748: PduRRoutingPathCommunicationType=COMMUNICATION_INTERFACE  # msg_TxCycle_E2eProf1C_500_30_oCAN
            SRC_Can_PT_msg_TxCycle_E2eProf1C_500_30_346f2748 (PduRSrcPdu):
              PduRSourcePduHandleId = 3
              PduRSrcPduDirection = TRANSMIT
              PduRSrcPduRef = PT_msg_TxCycle_E2eProf1C_500_30_PP_msg_TxCycle_E2eProf1C_500_30_Tx_346f2748_fe6ecc87
              PduRSrcPduPduRBswModulesRef = PduR/Com
            DST_Can_PT_msg_TxCycle_E2eProf1C_500_30_346f2748 (PduRDestPdu):
              PduRDestPduHandleId = 4
              PduRDestPduDirection = TRANSMIT
              PduRDestPduRoutingType = API_FORWARDING
              PduRDestPduDataProvision = PDUR_DIRECT
              PduRTransmissionConfirmation = false
              PduRDestPduRef = PT_msg_TxCycle_E2eProf1C_500_30_PP_msg_TxCycle_E2eProf1C_500_30_Tx_346f2748_fe6ecc87
              PduRDestPduPduRBswModulesRef = PduR/CanIf
          Can_PT_msg_diag_Response_MyECU_346f2748: PduRRoutingPathCommunicationType=TRANSPORT_PROTOCOL  # msg_diag_Response_MyECU_oCAN
            DST_Can_PT_msg_diag_Response_MyECU_346f2748 (PduRDestPdu):
              PduRDestPduHandleId = 0
              PduRDestPduDirection = TRANSMIT
              PduRDestPduRoutingType = API_FORWARDING
              PduRDestPduRef = EcucPduCollection/PT_msg_diag_Response_MyECU_PP_msg_diag_Response_MyECU_Tx_346f2748_fe6ecc87
              PduRDestPduPduRBswModulesRef = PduR/CanTp
            SRC_Can_PT_msg_diag_Response_MyECU_346f2748 (PduRSrcPdu):
              PduRSourcePduHandleId = 5
              PduRSrcPduDirection = TRANSMIT
              PduRSrcPduRef = EcucPduCollection/PT_msg_diag_Response_MyECU_PP_msg_diag_Response_MyECU_Tx_346f2748_fe6ecc87
              PduRSrcPduPduRBswModulesRef = PduR/Dcm
          Can_PT_msg_diag_Uudt_Response_MyECU_346f2748: PduRRoutingPathCommunicationType=COMMUNICATION_INTERFACE  # msg_diag_Uudt_Response_MyECU_oCAN
            SRC_Can_PT_msg_diag_Uudt_Response_MyECU_346f2748 (PduRSrcPdu):
              PduRSourcePduHandleId = 6
              PduRSrcPduDirection = TRANSMIT
              PduRSrcPduRef = PT_msg_diag_Uudt_Response_MyECU_PP_msg_diag_Uudt_Response_MyECU_Tx_346f2748_fe6ecc87
              PduRSrcPduPduRBswModulesRef = PduR/Dcm
            DST_Can_PT_msg_diag_Uudt_Response_MyECU_346f2748 (PduRDestPdu):
              PduRDestPduHandleId = 7
              PduRDestPduDirection = TRANSMIT
              PduRDestPduRoutingType = API_FORWARDING
              PduRDestPduDataProvision = PDUR_DIRECT
              PduRTransmissionConfirmation = true
              PduRDestPduRef = PT_msg_diag_Uudt_Response_MyECU_PP_msg_diag_Uudt_Response_MyECU_Tx_346f2748_fe6ecc87
              PduRDestPduPduRBswModulesRef = PduR/CanIf
          Can_PT_msg_TxCycle10_0_346f2748: PduRRoutingPathCommunicationType=COMMUNICATION_INTERFACE  # msg_TxCycle10_0_oCAN
            DST_Can_PT_msg_TxCycle10_0_346f2748 (PduRDestPdu):
              PduRDestPduHandleId = 2
              PduRDestPduDirection = TRANSMIT
              PduRDestPduRoutingType = API_FORWARDING
              PduRDestPduDataProvision = PDUR_DIRECT
              PduRTransmissionConfirmation = false
              PduRDestPduRef = PT_msg_TxCycle10_0_PP_msg_TxCycle10_0_Tx_346f2748_fe6ecc87
              PduRDestPduPduRBswModulesRef = PduR/CanIf
            SRC_Can_PT_msg_TxCycle10_0_346f2748 (PduRSrcPdu):
              PduRSourcePduHandleId = 1
              PduRSrcPduDirection = TRANSMIT
              PduRSrcPduRef = PT_msg_TxCycle10_0_PP_msg_TxCycle10_0_Tx_346f2748_fe6ecc87
              PduRSrcPduPduRBswModulesRef = PduR/Com
          Can_msg_nm_MyECU_oCAN_3abd61be: PduRRoutingPathCommunicationType=COMMUNICATION_INTERFACE  # msg_nm_MyECU_oCAN
            SRC_Can_msg_nm_MyECU_oCAN_3abd61be (PduRSrcPdu):
              PduRSourcePduHandleId = 7
              PduRSrcPduDirection = TRANSMIT
              PduRSrcPduRef = EcucPduCollection/NmUsrData_msg_nm_MyECU_oCAN_3abd61be
              PduRSrcPduPduRBswModulesRef = PduR/Com
            DST_Can_msg_nm_MyECU_oCAN_3abd61be (PduRDestPdu):
              PduRDestPduHandleId = 0
              PduRDestPduDirection = TRANSMIT
              PduRDestPduRoutingType = API_FORWARDING
              PduRDestPduDataProvision = PDUR_TRIGGERTRANSMIT
              PduRTransmissionConfirmation = false
              PduRDestPduRef = EcucPduCollection/NmUsrData_msg_nm_MyECU_oCAN_3abd61be
              PduRDestPduPduRBswModulesRef = PduR/CanNm
          Can_PT_msg_TxCycle1000_10_346f2748: PduRRoutingPathCommunicationType=COMMUNICATION_INTERFACE  # msg_TxCycle1000_10_oCAN
            SRC_Can_PT_msg_TxCycle1000_10_346f2748 (PduRSrcPdu):
              PduRSourcePduHandleId = 2
              PduRSrcPduDirection = TRANSMIT
              PduRSrcPduRef = PT_msg_TxCycle1000_10_PP_msg_TxCycle1000_10_Tx_346f2748_fe6ecc87
              PduRSrcPduPduRBswModulesRef = PduR/Com
            DST_Can_PT_msg_TxCycle1000_10_346f2748 (PduRDestPdu):
              PduRDestPduHandleId = 3
              PduRDestPduDirection = TRANSMIT
              PduRDestPduRoutingType = API_FORWARDING
              PduRDestPduDataProvision = PDUR_DIRECT
              PduRTransmissionConfirmation = false
              PduRDestPduRef = PT_msg_TxCycle1000_10_PP_msg_TxCycle1000_10_Tx_346f2748_fe6ecc87
              PduRDestPduPduRBswModulesRef = PduR/CanIf
          Can_PT_msg_TxEvent_10_346f2748: PduRRoutingPathCommunicationType=COMMUNICATION_INTERFACE  # msg_TxEvent_10_oCAN
            DST_Can_PT_msg_TxEvent_10_346f2748 (PduRDestPdu):
              PduRDestPduHandleId = 5
              PduRDestPduDirection = TRANSMIT
              PduRDestPduRoutingType = API_FORWARDING
              PduRDestPduDataProvision = PDUR_DIRECT
              PduRTransmissionConfirmation = false
              PduRDestPduRef = PT_msg_TxEvent_10_PP_msg_TxEvent_10_Tx_346f2748_fe6ecc87
              PduRDestPduPduRBswModulesRef = PduR/CanIf
            SRC_Can_PT_msg_TxEvent_10_346f2748 (PduRSrcPdu):
              PduRSourcePduHandleId = 4
              PduRSrcPduDirection = TRANSMIT
              PduRSrcPduRef = PT_msg_TxEvent_10_PP_msg_TxEvent_10_Tx_346f2748_fe6ecc87
              PduRSrcPduPduRBswModulesRef = PduR/Com
          PduRRoutingPath: PduRRoutingPathCommunicationType=COMMUNICATION_INTERFACE
            PduRDestPdu:
              PduRDestPduHandleId = 6
              PduRDestPduDirection = RECEIVE
              PduRDestPduRoutingType = API_FORWARDING
              PduRTransmissionConfirmation = false
              PduRDestPduRef = EcucPduCollection/PT_msg_diag_Request_MyECU_Slave3_PP_msg_diag_Request_MyECU_Slave3_Rx_346f2748_fe6ecc87
              PduRDestPduPduRBswModulesRef = Cdd_Com
            PduRSrcPdu:
              PduRSourcePduHandleId = 5
              PduRSrcPduDirection = RECEIVE
              PduRSrcPduRef = EcucPduCollection/PT_msg_diag_Request_MyECU_Slave3_PP_msg_diag_Request_MyECU_Slave3_Rx_346f2748_fe6ecc87
              PduRSrcPduPduRBswModulesRef = PduR/CanIf
          PduRRoutingPath_001: PduRRoutingPathCommunicationType=COMMUNICATION_INTERFACE
            PduRDestPdu_1 (PduRDestPdu):
              PduRDestPduHandleId = 6
              PduRDestPduDirection = TRANSMIT
              PduRDestPduRoutingType = API_FORWARDING
              PduRDestPduDataProvision = PDUR_DIRECT
              PduRTransmissionConfirmation = true
              PduRDestPduRef = EcucPduCollection/PT_msg_diag_Response_MyECU_Slave3_PP_msg_diag_Response_MyECU_Slave3_Tx_346f2748_fe6ecc87
              PduRDestPduPduRBswModulesRef = PduR/CanIf
            PduRSrcPdu_1 (PduRSrcPdu):
              PduRSourcePduHandleId = 8
              PduRSrcPduDirection = TRANSMIT
              PduRSrcPduRef = EcucPduCollection/PT_msg_diag_Response_MyECU_Slave3_PP_msg_diag_Response_MyECU_Slave3_Tx_346f2748_fe6ecc87
              PduRSrcPduPduRBswModulesRef = Cdd_Com
          PduRRoutingPath_002: PduRRoutingPathCommunicationType=COMMUNICATION_INTERFACE
            PduRDestPdu_2 (PduRDestPdu):
              PduRDestPduHandleId = 0
              PduRDestPduDirection = RECEIVE
              PduRDestPduRoutingType = API_FORWARDING
              PduRTransmissionConfirmation = false
              PduRDestPduRef = EcucPduCollection/PT_GlobalTimeMaster_PP_GlobalTimeMaster_Rx_346f2748_fe6ecc87
              PduRDestPduPduRBswModulesRef = Cdd_Com
            PduRSrcPdu_2 (PduRSrcPdu):
              PduRSourcePduHandleId = 6
              PduRSrcPduDirection = RECEIVE
              PduRSrcPduRef = EcucPduCollection/PT_GlobalTimeMaster_PP_GlobalTimeMaster_Rx_346f2748_fe6ecc87
              PduRSrcPduPduRBswModulesRef = PduR/CanIf
    6 x PduRBswModules, all with PduRCancelReceive=false, PduRChangeParameterRequestApi=false:
      CanIf: PduRCancelTransmit=true, PduRCommunicationInterface=true, PduRLowerModule=true, PduRTransportProtocol=false, PduRTriggertransmit=false, PduRTxConfirmation=true, PduRUpperModule=false, PduRUseTag=false, PduRBswModuleRef=CanIf
      CanNm: PduRCancelTransmit=false, PduRCommunicationInterface=true, PduRLowerModule=true, PduRTransportProtocol=false, PduRTriggertransmit=true, PduRTxConfirmation=false, PduRUpperModule=false, PduRUseTag=false, PduRBswModuleRef=CanNm
      CanTp: PduRCancelTransmit=true, PduRCommunicationInterface=false, PduRLowerModule=true, PduRTransportProtocol=true, PduRTriggertransmit=false, PduRTxConfirmation=false, PduRUpperModule=false, PduRUseTag=false, PduRBswModuleRef=CanTp
      Com: PduRCancelTransmit=false, PduRCommunicationInterface=true, PduRLowerModule=false, PduRTransportProtocol=false, PduRTriggertransmit=true, PduRTxConfirmation=false, PduRUpperModule=true, PduRUseTag=false, PduRBswModuleRef=Com
      Dcm: PduRCancelTransmit=true, PduRCommunicationInterface=true, PduRLowerModule=false, PduRTransportProtocol=true, PduRTriggertransmit=false, PduRTxConfirmation=true, PduRUpperModule=true, PduRUseTag=true, PduRBswModuleRef=Dcm
      Cdd_Com: PduRCancelTransmit=false, PduRCommunicationInterface=true, PduRLowerModule=false, PduRTransportProtocol=false, PduRTriggertransmit=false, PduRTxConfirmation=true, PduRUpperModule=true, PduRUseTag=false, PduRBswModuleRef=Cdd_Com
  module config EcuM: implementation-config-variant=VARIANT-PRE-COMPILE, module-description=EcuM_Impl
    EcuMConfiguration
      EcuMFlexConfiguration: EcuMFlexModuleConfigurationRef=CanConfigSet, EcuMNormalMcuModeRef=McuModeSettingConf_0
        ECUM_CAUSE_UNKNOWN (EcuMShutdownCause): EcuMShutdownCauseId=0
        ECUM_RESET_IO (EcuMResetMode): EcuMResetModeId=2
        ECUM_RESET_MCU (EcuMResetMode): EcuMResetModeId=0
        ECUM_CAUSE_DCM (EcuMShutdownCause): EcuMShutdownCauseId=3
        ECUM_RESET_WAKEUP (EcuMResetMode): EcuMResetModeId=3
        ECUM_CAUSE_ECU_STATE (EcuMShutdownCause): EcuMShutdownCauseId=1
        ECUM_RESET_WDG (EcuMResetMode): EcuMResetModeId=1
        ECUM_CAUSE_WDGM (EcuMShutdownCause): EcuMShutdownCauseId=2
      EcuMCommonConfiguration: EcuMConfigConsistencyHash=12593960309591106034, EcuMDefaultAppMode=OSDEFAULTAPPMODE, EcuMOSResource=OsResource_EcuM
        ECUM_WKSOURCE_POWER (EcuMWakeupSource): EcuMWakeupSourceId=0, EcuMValidationTimeout=0, EcuMCheckWakeupTimeout=0, EcuMWakeupSourcePolling=false
        EcuMDriverInitListOne
          13 x EcuMDriverInitItem:
            Mcu_Init: index=0, EcuMModuleID=Mcu, EcuMModuleService=Mcu_Init, EcuMModuleHeader=Mcu.h
            Mcu_InitClock: index=10, EcuMModuleID=Code, EcuMAdditionalInitCode=Mcu_InitClock(McuConf_McuModeSettingConf_McuModeSettingConf_0)
            Mcu_GetPllStatus: index=11, EcuMModuleID=Code, EcuMAdditionalInitCode=while (Mcu_GetPllStatus() != MCU_PLL_LOCKED)
            Mcu_DistributePllClock: index=12, EcuMModuleID=Code, EcuMAdditionalInitCode=Mcu_DistributePllClock()
            Adc_Init: index=1, EcuMModuleID=Adc, EcuMModuleService=Adc_Init, EcuMModuleHeader=Adc.h
            Dio_Init: index=2, EcuMModuleID=Dio, EcuMModuleService=Dio_Init, EcuMModuleHeader=Dio.h
            Fls_17_Pmu_Init: index=3, EcuMModuleID=Fls, EcuMModuleService=Fls_17_Pmu_Init, EcuMModuleHeader=Fls_17_Pmu.h
            Gpt_Init: index=4, EcuMModuleID=Gpt, EcuMModuleService=Gpt_Init, EcuMModuleHeader=Gpt.h
            Icu_17_GtmCcu6_Init: index=5, EcuMModuleID=Icu, EcuMModuleService=Icu_17_GtmCcu6_Init, EcuMModuleHeader=Icu_17_GtmCcu6.h
            Port_Init: index=6, EcuMModuleID=Port, EcuMModuleService=Port_Init, EcuMModuleHeader=Port.h
            Pwm_17_Gtm_Init: index=7, EcuMModuleID=Pwm, EcuMModuleService=Pwm_17_Gtm_Init, EcuMModuleHeader=Pwm_17_Gtm.h
            Spi_Init: index=8, EcuMModuleID=Spi, EcuMModuleService=Spi_Init, EcuMModuleHeader=Spi.h
            Wdg_17_Scu_Init: index=9, EcuMModuleID=Wdg, EcuMModuleService=Wdg_17_Scu_Init, EcuMModuleHeader=Wdg_17_Scu.h
        4 x EcuMWakeupSource, all with EcuMWakeupSourcePolling=false:
          ECUM_WKSOURCE_INTERNAL_WDG: EcuMWakeupSourceId=3, EcuMValidationTimeout=0, EcuMCheckWakeupTimeout=0
          ECUM_WKSOURCE_INTERNAL_RESET: EcuMWakeupSourceId=2, EcuMValidationTimeout=0, EcuMCheckWakeupTimeout=0
          CAN_f26020e5: EcuMWakeupSourceId=5, EcuMComMChannelRef=ComMConfigSet/CAN_f26020e5  # CN_CAN
          ECUM_WKSOURCE_RESET: EcuMWakeupSourceId=1, EcuMValidationTimeout=0, EcuMCheckWakeupTimeout=0
        EcuMDefaultShutdownTarget: EcuMDefaultState=EcuMStateOff
        EcuMDriverRestartList
        ECUM_WKSOURCE_EXTERNAL_WDG (EcuMWakeupSource): EcuMWakeupSourceId=4, EcuMValidationTimeout=0, EcuMCheckWakeupTimeout=0, EcuMWakeupSourcePolling=false
        EcuMDriverInitListZero
          18 x EcuMDriverInitItem:
            BswM_InitMemory: index=0, EcuMModuleID=BswM, EcuMModuleService=BswM_InitMemory, EcuMModuleHeader=BswM.h
            CanIf_InitMemory: index=1, EcuMModuleID=CanIf, EcuMModuleService=CanIf_InitMemory, EcuMModuleHeader=CanIf.h
            CanNm_InitMemory: index=2, EcuMModuleID=CanNm, EcuMModuleService=CanNm_InitMemory, EcuMModuleHeader=CanNm.h
            CanSM_InitMemory: index=3, EcuMModuleID=CanSM, EcuMModuleService=CanSM_InitMemory, EcuMModuleHeader=CanSM_EcuM.h
            CanTp_InitMemory: index=4, EcuMModuleID=CanTp, EcuMModuleService=CanTp_InitMemory, EcuMModuleHeader=CanTp.h
            Can_InitMemory: index=5, EcuMModuleID=Can, EcuMModuleService=Can_InitMemory, EcuMModuleHeader=Can.h
            ComM_InitMemory: index=6, EcuMModuleID=ComM, EcuMModuleService=ComM_InitMemory, EcuMModuleHeader=ComM.h
            Com_InitMemory: index=7, EcuMModuleID=Com, EcuMModuleService=Com_InitMemory, EcuMModuleHeader=Com.h
            Dcm_InitMemory: index=8, EcuMModuleID=Dcm, EcuMModuleService=Dcm_InitMemory, EcuMModuleHeader=Dcm.h
            Dem_InitMemory: index=9, EcuMModuleID=Dem, EcuMModuleService=Dem_InitMemory, EcuMModuleHeader=Dem.h
            Dem_PreInit: index=10, EcuMModuleID=Dem, EcuMModuleService=Dem_PreInit, EcuMModuleHeader=Dem.h
            Det_InitMemory: index=11, EcuMModuleID=Det, EcuMModuleService=Det_InitMemory, EcuMModuleHeader=Det.h
            Det_Init: index=12, EcuMModuleID=Det, EcuMModuleService=Det_Init, EcuMModuleHeader=Det.h
            Nm_InitMemory: index=13, EcuMModuleID=Nm, EcuMModuleService=Nm_InitMemory, EcuMModuleHeader=Nm.h
            PduR_InitMemory: index=14, EcuMModuleID=PduR, EcuMModuleService=PduR_InitMemory, EcuMModuleHeader=PduR.h
            Rte_InitMemory: index=15, EcuMModuleID=Rte, EcuMModuleService=Rte_InitMemory, EcuMModuleHeader=Rte_Main.h
            Xcp_InitMemory: index=16, EcuMModuleID=Xcp, EcuMModuleService=Xcp_InitMemory, EcuMModuleHeader=Xcp.h
            CanXcp_InitMemory: index=17, EcuMModuleID=Xcp, EcuMModuleService=CanXcp_InitMemory, EcuMModuleHeader=CanXcp.h
    EcuMGeneral:
      EcuMDevErrorDetect = true
      EcuMIncludeDem = true
      EcuMIncludeDet = true
      EcuMMainFunctionPeriod = 0.01
      EcuMVersionInfoApi = false
      EcuMDeferredBswMNotification = false
      EcuMSlaveCoreHandling = true
      EcuMEnableFixBehavior = false
      EcuMGeneration: EcuMOutOfBoundsWriteSanitizer=false, EcuMOutOfBoundsReadSanitizer=false, EcuMInterfacesForDeactivatedData=false
    EcuMFlexGeneral: EcuMAlarmClockPresent=false, EcuMResetLoopDetection=false, EcuMEnableDefBehaviour=false
  module config CanSM: implementation-config-variant=VARIANT-PRE-COMPILE, module-description=CanSM_Impl
    CanSMConfiguration: CanSMModeRequestRepetitionMax=10, CanSMModeRequestRepetitionTime=0.1
      CHNL_3c6d4e43 (CanSMManagerNetwork):
        CanSMBorCounterL1ToL2 = 5
        CanSMBorTimeL1 = 1
        CanSMBorTimeL2 = 3
        CanSMBorTimeTxEnsured = 5
        CanSMBorTxConfirmationPolling = false
        CanSMComMNetworkHandleRef = ComMConfigSet/CAN_f26020e5
        CT_CAN_e98c47e6 (CanSMController): CanSMControllerId=Can/CT_CAN_e98c47e6
    CanSMGeneral: CanSMDevErrorDetect=true, CanSMMainFunctionTimePeriod=0.01, CanSMVersionInfoApi=false, CanSMBorCheckLevel=false, CanSMSetBaudrateApi=false
      CanSMGeneration: CanSMOutOfBoundsWriteSanitizer=false, CanSMOutOfBoundsReadSanitizer=false
