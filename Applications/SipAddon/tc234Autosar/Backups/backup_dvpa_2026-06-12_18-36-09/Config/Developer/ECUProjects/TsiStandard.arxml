AUTOSAR XML (schema 4-3-0)
package /VehicleProject
  system System: category=SYSTEM_EXTRACT
    system mapping System_MPPNG
    root-software-compositions:
      root sw composition prototype ECU_Composition: software-composition=ECU_Composition
package /ECUCompositionTypes
  composition sw component type ECU_Composition
    component StartApplication: type=StartApplication
package /EndToEndProtections
  end to end protection set EndToEndConnections
