AUTOSAR XML (schema 4-2-1)
package /ActiveEcuC
  ecuc value collection ActiveEcuC: ecu-extract=SYSTEM, ecuc-values=[Os, EcuC, Com, Rte, ComM, CanIf, Can, Det, PduR, EcuM, CanSM, BswM, Resource, Dio, Port, Mcu]
  module config Os: implementation-config-variant=VARIANT-PRE-COMPILE, module-description=Os_Impl
    SystemTimer (OsCounter):
      OsCounterMaxAllowedValue = 2147483647
      OsCounterMinCycle = 1
      OsCounterType = HARDWARE
      OsSecondsPerTick = 0.001
      OsCounterTicksPerBase = 60000
      OsCounterAccessingApplication = SystemApplication_OsCore_Core0
      OsDriver: OsDriverHighResolution=false, OsDriverHardwareTimerChannelRef=STM0_Ch0, OsDriverIsrRef=CounterIsr_SystemTimer
    OsOS:
      OsStackMonitoring = true
      OsStatus = STANDARD
      OsUseGetServiceId = false
      OsUseParameterAccess = false
      OsUseResScheduler = false
      OsForcibleTermination = false
      OsGenerateCalloutStubs = true
      OsGenerateMemMap = COMPLETE
      OsGenerateMemMapForNearAddressing = true
      OsGenerateMemMapForThreads = false
      OsServiceProtection = false
      OsStackUsageMeasurement = false
      OsUseXSignalAsyncApiCalls = false
      OsScalabilityClass = SC1
      OsNumberOfCores = 1
      OsMasterCore = OsCore_Core0
      OsSystemTimer = SystemTimer
      OsHooks: OsErrorHook=true, OsPostTaskHook=false, OsPreTaskHook=false, OsShutdownHook=false, OsStartupHook=false
    OSDEFAULTAPPMODE (OsAppMode)
    OS_APPMODE_ANY (OsAppMode)
    OsPublishedInformation: OsKernelVersion=7, OsPlatformName=TriCoreAurix
      TC23x (OsDerivativeInformation):
        OsMpuAlignment = 8
        OsStackAlignment = 8
        OsExceptionVectorTableAlignment = 32
        OsInterruptVectorTableAlignment = 32
        OsHardwareManuals = User Manual: tc23x_tc22x_tc21x_um_v1.1.pdf V1.1 Errata Sheet: TC22x_TC21x_AB_Errata_Sheet_v1_2_03804A.pdf V1.2 Safety Manual: AURIX Safety Manual_3.pdf V1.3 2015-09
        Core0 (OsPhysicalCore):
          OsPhysicalCoreId = 0
          OsPhysicalCoreDefaultEntrySymbol = _start_tc0
          OsPhysicalCoreType = TC1.6.1E
          OsPhysicalCoreExceptionSources = 8
          OsPhysicalCoreMasterStartAllowed = true
          OsPhysicalCorePrivelegedHwAccess = true
          OsPhysicalCoreIsAutostart = true
          OsPhysicalCoreStackProtectionUnit = OsPhysicalCore0DataMpu
          OsPhysicalCore0DataMpu (OsPhysicalCoreMpu): OsPhysicalCoreMpuId=0, OsPhysicalCoreMpuMaxRegions=15, OsPhysicalCoreMpuType=DATA
          OsPhysicalCore0CodeMpu (OsPhysicalCoreMpu): OsPhysicalCoreMpuId=1, OsPhysicalCoreMpuMaxRegions=8, OsPhysicalCoreMpuType=CODE
        STM0 (OsHardwareTimer): OsHardwareTimerSize=32, OsHardwareTimerUnit=FRT, OsHardwareTimerBaseAddress=4026531840, OsHardwareTimerId=0, OsHardwareTimerType=STM
          STM0_Ch0 (OsHardwareTimerChannel): OsHardwareTimerChannelIntSource=1168, OsHardwareTimerChannelOffset=0, OsHardwareTimerChannelId=0
          STM0_Ch1 (OsHardwareTimerChannel): OsHardwareTimerChannelIntSource=1172, OsHardwareTimerChannelOffset=1, OsHardwareTimerChannelId=1
        AURIXTC2XX_IR (OsSystemIntCtrl): OsSystemIntCtrlMaxPrios=255, OsSystemIntCtrlPrioOrder=ASC, OsSystemIntCtrlMaxSources=8192, OsSystemIntCtrlBaseAddress=4026757120
        GPT (OsHardwareTimer): OsHardwareTimerSize=16, OsHardwareTimerUnit=PIT, OsHardwareTimerBaseAddress=4026543616, OsHardwareTimerId=0, OsHardwareTimerType=PIT
          GPT_Ch0 (OsHardwareTimerChannel): OsHardwareTimerChannelIntSource=1128, OsHardwareTimerChannelOffset=0, OsHardwareTimerChannelId=0
          GPT_Ch1 (OsHardwareTimerChannel): OsHardwareTimerChannelIntSource=1140, OsHardwareTimerChannelOffset=1, OsHardwareTimerChannelId=1
        OsMemoryRegionSpecifics
          12 x OsMemoryRegionAccess:
            PS0_R: OsMemoryRegionAccessRights=R, OsMemoryRegionAccessType=PROTECTION_SET0
            PS0_W: OsMemoryRegionAccessRights=W, OsMemoryRegionAccessType=PROTECTION_SET0
            PS0_X: OsMemoryRegionAccessRights=X, OsMemoryRegionAccessType=PROTECTION_SET0
            PS1_R: OsMemoryRegionAccessRights=R, OsMemoryRegionAccessType=PROTECTION_SET1
            PS1_W: OsMemoryRegionAccessRights=W, OsMemoryRegionAccessType=PROTECTION_SET1
            PS1_X: OsMemoryRegionAccessRights=X, OsMemoryRegionAccessType=PROTECTION_SET1
            PS2_R: OsMemoryRegionAccessRights=R, OsMemoryRegionAccessType=PROTECTION_SET2
            PS2_W: OsMemoryRegionAccessRights=W, OsMemoryRegionAccessType=PROTECTION_SET2
            PS2_X: OsMemoryRegionAccessRights=X, OsMemoryRegionAccessType=PROTECTION_SET2
            PS3_R: OsMemoryRegionAccessRights=R, OsMemoryRegionAccessType=PROTECTION_SET3
            PS3_W: OsMemoryRegionAccessRights=W, OsMemoryRegionAccessType=PROTECTION_SET3
            PS3_X: OsMemoryRegionAccessRights=X, OsMemoryRegionAccessType=PROTECTION_SET3
    OsCore_Core0 (OsCore):
      OsCoreIsAutostart = true
      OsCoreIsAutosar = true
      OsCoreEntrySymbol = _start_tc0
      OsCorePhysicalCoreRef = TC23x/Core0
      OsCoreIdleTask = IdleTask_OsCore_Core0
      OsCoreSystemApplication = SystemApplication_OsCore_Core0
      OsCoreEcucCoreRef = EcucHardware/Core0
      OsCoreStacks:
        OsCoreKernelStackSize = 1024
        OsCoreStartupStackSize = 1024
        OsCoreShutdownStackSize = 1024
        OsCoreErrorStackSize = 1024
        OsCoreProtectionStackSize = 1024
        OsCoreInitStackSize = 1024
    IdleTask_OsCore_Core0 (OsTask):
      OsTaskActivation = 1
      OsTaskPriority = 4294967295
      OsTaskSchedule = FULL
      OsTaskStackSharing = false
      OsTaskStackSize = 1024
      OsTaskType = AUTO
      OsTaskAccessingApplication = SystemApplication_OsCore_Core0
      OsTaskAutostart: OsTaskAppModeRef=OS_APPMODE_ANY
    SystemApplication_OsCore_Core0 (OsApplication):
      OsTrusted = true
      OsTrustedApplicationDelayTimingViolationCall = false
      OsTrustedApplicationWithProtection = false
      OsApplicationIsPrivileged = true
      OsAppUseTrustedFunctionStubs = false
      OsAppTaskRef = IdleTask_OsCore_Core0
      OsApplicationCoreRef = EcucHardware/Core0
      OsAppIsrRef = CounterIsr_SystemTimer
      OsAppTaskRef = Default_Appl_Init_Task
      OsAppTaskRef = Default_Appl_Task
      OsAppTaskRef = Default_BSW_Async_Task
      OsAppTaskRef = Default_BSW_Sync_Task
      OsAppTaskRef = Default_Background_Task
      OsAppTaskRef = Default_Init_Task
      OsAppTaskRef = Default_RTE_Mode_switch_Task
      OsAppCounterRef = SystemTimer
      OsAppIsrRef = CanIsr_0
      OsAppAlarmRef = Os/Rte_Al_TE2_Default_BSW_Async_Task_0_10ms
      OsAppAlarmRef = Os/Rte_Al_TE2_Default_BSW_Async_Task_0_20ms
      OsAppAlarmRef = Os/Rte_Al_TE_StartApplication_StartApplication_Cyclic1000ms
      OsAppAlarmRef = Os/Rte_Al_TE_StartApplication_StartApplication_Cyclic10ms
      OsAppAlarmRef = Os/Rte_Al_TE_StartApplication_StartApplication_Cyclic1ms
      OsAppAlarmRef = Os/Rte_Al_TE_StartApplication_StartApplication_Cyclic250ms
      OsAppAlarmRef = Os/Rte_Al_TE_AppCom_RWsignal
      OsApplicationHooks: OsAppErrorHook=false, OsAppShutdownHook=false, OsAppStartupHook=false
    7 x OsTask, all with OsTaskActivation=1, OsTaskSchedule=NON, OsTaskStackSharing=false, OsTaskType=AUTO, OsTaskAccessingApplication=SystemApplication_OsCore_Core0:
      Default_Init_Task: OsTaskPriority=50, OsTaskStackSize=1024, OsTaskResourceRef=OsResource_EcuM
        OsTaskAutostart: OsTaskAppModeRef=OSDEFAULTAPPMODE
      Default_BSW_Sync_Task: OsTaskPriority=40, OsTaskStackSize=1024
      Default_BSW_Async_Task: OsTaskPriority=30, OsTaskStackSize=2048, OsTaskResourceRef=OsResource_EcuM, OsTaskEventRef=Rte_Ev_Cyclic2_Default_BSW_Async_Task_0_10ms, OsTaskEventRef=Rte_Ev_Cyclic2_Default_BSW_Async_Task_0_20ms
      Default_RTE_Mode_switch_Task: OsTaskPriority=10, OsTaskStackSize=1024
      Default_Appl_Task: OsTaskPriority=5, OsTaskStackSize=1024, OsTaskEventRef=Rte_Ev_Run_StartApplication_StartApplication_Cyclic1000ms, OsTaskEventRef=Rte_Ev_Run_StartApplication_StartApplication_Cyclic10ms, OsTaskEventRef=Rte_Ev_Run_StartApplication_StartApplication_Cyclic1ms, OsTaskEventRef=Rte_Ev_Run_StartApplication_StartApplication_Cyclic250ms, OsTaskEventRef=Rte_Ev_Run_StartApplication_StartApplication_OnDataRec_RxCtrl, OsTaskEventRef=Rte_Ev_Run_StartApplication_StartApplication_OnDataRec_RxData, OsTaskEventRef=Rte_Ev_Run_AppCom_RWsignal
      Default_Background_Task: OsTaskPriority=0, OsTaskStackSize=1024
        OsTaskAutostart: OsTaskAppModeRef=OSDEFAULTAPPMODE
      Default_Appl_Init_Task: OsTaskPriority=45, OsTaskStackSize=1024
    CanIsr_0 (OsIsr):  # Os Interrupt Service Routine PLAIN_TEXT Can transmit, receive and busoff events of controller CT_CAN_e98c47e6. This OsIsr container has been created automatically based on the driver configuration.
      OsIsrCategory = CATEGORY_2
      OsIsrInterruptType = EXTERNAL
      OsIsrInterruptSource = 2304
      OsIsrInterruptPriority = 10
      OsIsrStackSize = 1024
      OsIsrEnableNesting = false
    OsResource_EcuM (OsResource): OsResourceProperty=STANDARD, OsResourceAccessingApplication=SystemApplication_OsCore_Core0
    CounterIsr_SystemTimer (OsIsr):
      OsIsrCategory = CATEGORY_2
      OsIsrInterruptType = EXTERNAL
      OsIsrInterruptSource = 1168
      OsIsrInterruptPriority = 1
      OsIsrStackSize = 1024
      OsIsrEnableNesting = false
      OsIsrSpecialFunctionName = Os_TimerPfrtIsr
    Rte_Al_TE2_Default_BSW_Async_Task_0_10ms (OsAlarm): OsAlarmCounterRef=SystemTimer, OsAlarmAccessingApplication=SystemApplication_OsCore_Core0
      OsAlarmAction
        OsAlarmSetEvent: OsAlarmSetEventRef=Rte_Ev_Cyclic2_Default_BSW_Async_Task_0_10ms, OsAlarmSetEventTaskRef=Default_BSW_Async_Task
    Rte_Al_TE2_Default_BSW_Async_Task_0_20ms (OsAlarm): OsAlarmCounterRef=SystemTimer, OsAlarmAccessingApplication=SystemApplication_OsCore_Core0
      OsAlarmAction
        OsAlarmSetEvent: OsAlarmSetEventRef=Rte_Ev_Cyclic2_Default_BSW_Async_Task_0_20ms, OsAlarmSetEventTaskRef=Default_BSW_Async_Task
    Rte_Ev_Cyclic2_Default_BSW_Async_Task_0_10ms (OsEvent)
    Rte_Ev_Cyclic2_Default_BSW_Async_Task_0_20ms (OsEvent)
    4 x OsAlarm, all with OsAlarmCounterRef=SystemTimer, OsAlarmAccessingApplication=SystemApplication_OsCore_Core0:
      Rte_Al_TE_StartApplication_StartApplication_Cyclic1000ms
        OsAlarmAction
          OsAlarmSetEvent: OsAlarmSetEventRef=Rte_Ev_Run_StartApplication_StartApplication_Cyclic1000ms, OsAlarmSetEventTaskRef=Default_Appl_Task
      Rte_Al_TE_StartApplication_StartApplication_Cyclic10ms
        OsAlarmAction
          OsAlarmSetEvent: OsAlarmSetEventRef=Rte_Ev_Run_StartApplication_StartApplication_Cyclic10ms, OsAlarmSetEventTaskRef=Default_Appl_Task
      Rte_Al_TE_StartApplication_StartApplication_Cyclic1ms
        OsAlarmAction
          OsAlarmSetEvent: OsAlarmSetEventRef=Rte_Ev_Run_StartApplication_StartApplication_Cyclic1ms, OsAlarmSetEventTaskRef=Default_Appl_Task
      Rte_Al_TE_StartApplication_StartApplication_Cyclic250ms
        OsAlarmAction
          OsAlarmSetEvent: OsAlarmSetEventRef=Rte_Ev_Run_StartApplication_StartApplication_Cyclic250ms, OsAlarmSetEventTaskRef=Default_Appl_Task
    6 x OsEvent:
      Rte_Ev_Run_StartApplication_StartApplication_Cyclic1000ms
      Rte_Ev_Run_StartApplication_StartApplication_Cyclic10ms
      Rte_Ev_Run_StartApplication_StartApplication_Cyclic1ms
      Rte_Ev_Run_StartApplication_StartApplication_Cyclic250ms
      Rte_Ev_Run_StartApplication_StartApplication_OnDataRec_RxCtrl
      Rte_Ev_Run_StartApplication_StartApplication_OnDataRec_RxData
    Rte_Al_TE_AppCom_RWsignal (OsAlarm): OsAlarmCounterRef=SystemTimer, OsAlarmAccessingApplication=SystemApplication_OsCore_Core0
      OsAlarmAction
        OsAlarmSetEvent: OsAlarmSetEventRef=Rte_Ev_Run_AppCom_RWsignal, OsAlarmSetEventTaskRef=Default_Appl_Task
    Rte_Ev_Run_AppCom_RWsignal (OsEvent)
  module config EcuC: implementation-config-variant=VARIANT-PRE-COMPILE, module-description=EcuC_Impl
    EcucGeneral:
      CPUType = CPU32Bit
      SizeOfInt = Size32Bit
      ByteOrder = LITTLE_ENDIAN
      BitOrder = LSB_to_MSB
      AtomicBitAccessInBitfield = false
      AtomicVariableAccess = Atomic32BitAccess
      SizeOfEnum = Size8Bit
      SizeOfROMPointer = Size32Bit
      SizeOfRAMPointer = Size32Bit
      BitFieldDataType = INT
      StructAlignment = Auto
      ArrayAlignment = Align8Bit
      StructInArrayAlignment = Auto
      DummyFunction = false
      EcuCSafeBswChecks = false
      DummyStatement = true
      DummyStatementKind = None
      ConditionalGenerating = true
      EcucBswImplementationCodeType = EcuCSourceCode
      EcuCUseStdReturnTypeForRte = false
      PostbuildLoadable: AlignmentFillPattern=90, PBROMStartAddress=0, PBRAMStartAddress=0, PBROMEndAddress=0, PBRAMEndAddress=0
      BswInitialization
        22 x InitFunction:
          BswM_Init: Header=BswM.h, InitPhase=NO_INIT, ConfigType=BswM_ConfigType, ConfigPtrName=BswM_Config_Ptr, ConfigPtrClass=BSWM_INIT_DATA, ModuleRef=BswM
          BswM_InitMemory: Header=BswM.h, InitPhase=INIT_MEMORY, ModuleRef=BswM
          CanIf_InitMemory: Header=CanIf.h, InitPhase=INIT_MEMORY, ModuleRef=CanIf
          CanIf_Init: Header=CanIf.h, InitPhase=INIT_TWO_IF, ConfigType=CanIf_ConfigType, ConfigPtrName=CanIf_Config_Ptr, ConfigPtrClass=CANIF_INIT_DATA, ModuleRef=CanIf
          CanSM_Init: Header=CanSM_EcuM.h, InitPhase=INIT_TWO_SM, ConfigType=CanSM_ConfigType, ConfigPtrName=CanSM_Config_Ptr, ConfigPtrClass=CANSM_INIT_DATA, ModuleRef=CanSM
          CanSM_InitMemory: Header=CanSM_EcuM.h, InitPhase=INIT_MEMORY, ModuleRef=CanSM
          Can_InitMemory: Header=Can.h, InitPhase=INIT_MEMORY, ModuleRef=Can
          Can_Init: Header=Can.h, InitPhase=INIT_TWO_DRV, ConfigType=Can_ConfigType, ConfigPtrName=Can_Config_Ptr, ConfigPtrClass=CAN_INIT_DATA, ModuleRef=Can
          ComM_InitMemory: Header=ComM.h, InitPhase=INIT_MEMORY, ModuleRef=ComM
          ComM_Init: Header=ComM.h, InitPhase=INIT_TWO_POST_NVMREADALL, ModuleRef=ComM
          Com_InitMemory: Header=Com.h, InitPhase=INIT_MEMORY, ModuleRef=Com
          Com_Init: Header=Com.h, InitPhase=INIT_TWO_COM, ConfigType=Com_ConfigType, ConfigPtrName=Com_Config_Ptr, ConfigPtrClass=COM_INIT_DATA, ModuleRef=Com
          Det_InitMemory: Header=Det.h, InitPhase=INIT_MEMORY, ModuleRef=Det
          Det_Init: Header=Det.h, InitPhase=INIT_ZERO, ConfigType=Det_ConfigType, ConfigPtrName=Det_Config_Ptr, ConfigPtrClass=DET_INIT_DATA, ModuleRef=Det
          EcuM_Init: Header=EcuM.h, InitPhase=NO_INIT, ConfigType=EcuM_PbConfigType, ConfigPtrName=EcuM_Config_Ptr, ConfigPtrClass=ECUM_INIT_DATA, ModuleRef=EcuM
          PduR_Init: Header=PduR.h, InitPhase=INIT_TWO_COM, ConfigType=PduR_PBConfigType, ConfigPtrName=PduR_Config_Ptr, ConfigPtrClass=PDUR_INIT_DATA, ModuleRef=PduR
          PduR_InitMemory: Header=PduR.h, InitPhase=INIT_MEMORY, ModuleRef=PduR
          Rte_InitMemory: Header=Rte_Main.h, InitPhase=INIT_MEMORY, ModuleRef=Rte
          SchM_Init: Header=Rte_Main.h, InitPhase=NO_INIT, ModuleRef=Rte
          Mcu_Init: Header=Mcu.h, InitPhase=INIT_ONE_EARLY, ConfigType=Mcu_ConfigType, ConfigPtrName=Mcu_ConfigRoot, ConfigPtrClass=const, ModuleRef=Mcu
          Dio_Init: Header=Dio.h, InitPhase=INIT_ONE, ConfigType=Dio_ConfigType, ConfigPtrName=Dio_ConfigRoot, ConfigPtrClass=const, ModuleRef=Dio
          Port_Init: Header=Port.h, InitPhase=INIT_ONE_EARLY, ConfigType=Port_ConfigType, ConfigPtrName=Port_ConfigRoot, ConfigPtrClass=const, ModuleRef=Port
    EcucHardware
      Core0 (EcucCoreDefinition): EcucCoreId=0
    EcucPduCollection: PduIdTypeEnum=UINT8, PduLengthTypeEnum=UINT16
      3 x Pdu, all with J1939Requestable=false:
        PT_msg_MyECU_Lamp_PP_msg_MyECU_Lamp_Tx_0fb271d2_5e566ad9: PduLength=8, SysTPduToFrameMappingRef=msg_MyECU_Lamp  # msg_MyECU_Lamp_oCAN00
        PT_msg_Receive_PP_msg_Receive_Rx_0fb271d2_5e566ad9: PduLength=1, SysTPduToFrameMappingRef=msg_Receive  # msg_Receive_oCAN00
        PT_msg_Transmit_PP_msg_Transmit_Tx_0fb271d2_5e566ad9: PduLength=1, SysTPduToFrameMappingRef=msg_Transmit  # msg_Transmit_oCAN00
  module config Com: implementation-config-variant=VARIANT-PRE-COMPILE, module-description=Com_Impl
    ComGeneration:
      ComOutOfBoundsWriteProtectionStrategy = NONE
      ComOutOfBoundsWriteSanitizer = false
      ComOutOfBoundsReadSanitizer = false
      ComReduceConstantData2Define = false
      ComBoolDataInArrayOfStructStrategy = BOOLEAN
      ComDeduplicateIndirectedData = true
      ComDataDeduplicationStrategy = WITH_CAST
      ComReduceBoolDataByNegationThreshold = 2
      ComReduceBoolDataByNumericalComparisonThreshold = 2
      ComReduceBoolDataByNumericalRelationThreshold = 2
      ComReduceBoolDataByNumericalOperandStrategy = WITH_ANY_VALUE
      ComReduceNumericalDataByOffsetThreshold = 2
      ComReduceNumericalDataByArraySubtractionThreshold = 2
      ComReduceDataByStreaming = false
      ComShortSymbols = false
      ComInterfacesForDeactivatedData = false
      ComReferringKeysInComments = false
    ComOptimization:
      ComTxCyclicProcessingISRLockThreshold = 1
      ComTxDeadlineMonitoringISRLockThreshold = 1
      ComTxProcessingISRLockThreshold = 1
      ComRxDeadlineMonitoringISRLockThreshold = 1
      ComRxDeferredProcessingISRLockThreshold = 1
      ComGatewayProcessingISRLockThreshold = 1
      ComGatewayDescriptionProcessingISRLockThreshold = 1
      ComIPduGroupISRLockThreshold = 1
    ComConfig: ComConfigurationId=0, ComRxDeferredNotificationCacheSize=0, ComRxImmediateNotificationCacheSize=0
      ComTimeBase: ComRxTimeBase=0.01, ComTxTimeBase=0.01, ComGwTimeBase=0.01
      msg_MyECU_Lamp_oCAN00_3abd61be (ComIPdu):
        ComIPduDirection = SEND
        ComIPduType = NORMAL
        ComIPduHandleId = 0
        ComIPduSignalProcessing = DEFERRED
        ComIPduCancellationSupport = false
        ComIPduGroupRef = MyECU_oCAN00_Tx_fcef2243
        ComIPduSignalRef = sig_LampCnt_818e1651
        ComPduIdRef = PT_msg_MyECU_Lamp_PP_msg_MyECU_Lamp_Tx_0fb271d2_5e566ad9
        ComTxIPdu: ComMinimumDelayTime=0, ComTxIPduUnusedAreasDefault=0
          ComTxModeTrue
            ComTxMode: ComTxModeMode=PERIODIC, ComTxModeTimeOffset=0, ComTxModeTimePeriod=0.1
          ComTxModeFalse
            ComTxMode: ComTxModeMode=PERIODIC, ComTxModeTimeOffset=0, ComTxModeTimePeriod=0.1
      msg_Receive_oCAN00_3abd61be (ComIPdu):
        ComIPduDirection = RECEIVE
        ComIPduType = NORMAL
        ComIPduHandleId = 0
        ComIPduSignalProcessing = DEFERRED
        ComIPduCancellationSupport = false
        ComIPduGroupRef = MyECU_oCAN00_Rx_fcef2243
        ComIPduSignalRef = sig_State_RearInteriorLight_2b456e3f
        ComIPduSignalRef = sig_State_RearLeftDoor_2b456e3f
        ComIPduSignalRef = sig_State_RearRightDoor_2b456e3f
        ComPduIdRef = PT_msg_Receive_PP_msg_Receive_Rx_0fb271d2_5e566ad9
      MyECU_oCAN00_Rx_fcef2243 (ComIPduGroup): ComIPduGroupHandleId=0
      sig_LampCnt_818e1651 (ComSignal):
        ComBitPosition = 7
        ComBitSize = 8
        ComSignalEndianness = BIG_ENDIAN
        ComSignalInitValue = 0
        ComSignalType = UINT8
        ComTransferProperty = PENDING
        ComSignalAccess = ACCESS_UNCLEAR
        ComHandleId = 0
        ComSystemTemplateSystemSignalRef = sig_LampCnt
      sig_State_RearLeftDoor_2b456e3f (ComSignal):
        ComBitPosition = 0
        ComBitSize = 1
        ComSignalEndianness = LITTLE_ENDIAN
        ComSignalInitValue = 0
        ComSignalType = BOOLEAN
        ComTimeout = 0
        ComSignalAccess = ACCESS_UNCLEAR
        ComHandleId = 1
        ComSystemTemplateSystemSignalRef = sig_State_RearLeftDoor
      msg_Transmit_oCAN00_3abd61be (ComIPdu):
        ComIPduDirection = SEND
        ComIPduType = NORMAL
        ComIPduHandleId = 1
        ComIPduSignalProcessing = DEFERRED
        ComIPduCancellationSupport = false
        ComIPduGroupRef = MyECU_oCAN00_Tx_fcef2243
        ComIPduSignalRef = sig_RearInteriorLight_0723e95e
        ComPduIdRef = PT_msg_Transmit_PP_msg_Transmit_Tx_0fb271d2_5e566ad9
        ComTxIPdu: ComMinimumDelayTime=0, ComTxIPduUnusedAreasDefault=0
          ComTxModeTrue
            ComTxMode: ComTxModeMode=PERIODIC, ComTxModeTimeOffset=0, ComTxModeTimePeriod=0.1
          ComTxModeFalse
            ComTxMode: ComTxModeMode=PERIODIC, ComTxModeTimeOffset=0, ComTxModeTimePeriod=0.1
      sig_State_RearInteriorLight_2b456e3f (ComSignal):
        ComBitPosition = 2
        ComBitSize = 1
        ComSignalEndianness = LITTLE_ENDIAN
        ComSignalInitValue = 0
        ComSignalType = BOOLEAN
        ComTimeout = 0
        ComSignalAccess = ACCESS_UNCLEAR
        ComHandleId = 0
        ComSystemTemplateSystemSignalRef = sig_State_RearInteriorLight
      MyECU_oCAN00_Tx_fcef2243 (ComIPduGroup): ComIPduGroupHandleId=1
      sig_RearInteriorLight_0723e95e (ComSignal):
        ComBitPosition = 0
        ComBitSize = 1
        ComSignalEndianness = LITTLE_ENDIAN
        ComSignalInitValue = 0
        ComSignalType = BOOLEAN
        ComTransferProperty = PENDING
        ComSignalAccess = ACCESS_UNCLEAR
        ComHandleId = 1
        ComSystemTemplateSystemSignalRef = sig_RearInteriorLight
      sig_State_RearRightDoor_2b456e3f (ComSignal):
        ComBitPosition = 1
        ComBitSize = 1
        ComSignalEndianness = LITTLE_ENDIAN
        ComSignalInitValue = 0
        ComSignalType = BOOLEAN
        ComTimeout = 0
        ComSignalAccess = ACCESS_UNCLEAR
        ComHandleId = 2
        ComSystemTemplateSystemSignalRef = sig_State_RearRightDoor
    ComGeneral:
      ComConfigurationUseDet = true
      ComEnableSignalGroupArrayApi = false
      ComRetryFailedTransmitRequests = true
      ComSupportedIPduGroups = 2
      ComVersionInfoApi = false
      ComAdvancedIPduCallouts = true
      ComOptimizedIPduGroupHandling = false
      ComMetaDataSupport = false
      ComReceiveSignalMacroAPI = false
      ComDeferredEventCacheSupport = false
      ComMainfunctionTimingDomainSupport = false
      ComDescriptionRoutingCodeGeneration = false
      ComSafeBswChecks = false
  module config Rte: implementation-config-variant=VARIANT-PRE-COMPILE, module-description=Rte_Impl
    RteInitializationBehavior: RteInitializationStrategy=RTE_INITIALIZATION_STRATEGY_AT_DATA_DECLARATION, RteSectionInitializationPolicy=INIT
    RteGeneration:
      RteGenerationMode = COMPATIBILITY_MODE
      RteIocInteractionReturnValue = RTE_IOC
      RteValueRangeCheckEnabled = false
      RteCalibrationSupport = INITIALIZED_RAM
      RteCodeVendorId = 30
      RteDevErrorDetect = true
      RteDevErrorDetectUninit = false
      RteMeasurementSupport = false
      RteOptimizationMode = MEMORY
      RteVfbTraceEnabled = false
      RteXcpEventSupport = false
    RteBswGeneral: RteSchMVersionInfoApi=false, RteUseComShadowSignalApi=false
    RteOsInteraction
      7 x RteUsedOsActivation, all with RteExpectedActivationOffset=0, RteExpectedTickDuration=0:
        Rte_Al_TE2_Default_BSW_Async_Task_0_10ms: RteActivationOsAlarmRef=Os/Rte_Al_TE2_Default_BSW_Async_Task_0_10ms, RteActivationOsTaskRef=Default_BSW_Async_Task
        Rte_Al_TE2_Default_BSW_Async_Task_0_20ms: RteActivationOsAlarmRef=Os/Rte_Al_TE2_Default_BSW_Async_Task_0_20ms, RteActivationOsTaskRef=Default_BSW_Async_Task
        Rte_Al_TE_StartApplication_StartApplication_Cyclic1000ms: RteActivationOsAlarmRef=Os/Rte_Al_TE_StartApplication_StartApplication_Cyclic1000ms, RteActivationOsTaskRef=Default_Appl_Task
        Rte_Al_TE_StartApplication_StartApplication_Cyclic10ms: RteActivationOsAlarmRef=Os/Rte_Al_TE_StartApplication_StartApplication_Cyclic10ms, RteActivationOsTaskRef=Default_Appl_Task
        Rte_Al_TE_StartApplication_StartApplication_Cyclic1ms: RteActivationOsAlarmRef=Os/Rte_Al_TE_StartApplication_StartApplication_Cyclic1ms, RteActivationOsTaskRef=Default_Appl_Task
        Rte_Al_TE_StartApplication_StartApplication_Cyclic250ms: RteActivationOsAlarmRef=Os/Rte_Al_TE_StartApplication_StartApplication_Cyclic250ms, RteActivationOsTaskRef=Default_Appl_Task
        Rte_Al_TE_AppCom_RWsignal: RteActivationOsAlarmRef=Os/Rte_Al_TE_AppCom_RWsignal, RteActivationOsTaskRef=Default_Appl_Task
    10 x RteBswModuleInstance:
      BswM: RteBswImplementationRef=BswM_Impl, RteBswModuleConfigurationRef=BswM
        BswM_MainFunctionTimingEvent0 (RteBswEventToTaskMapping):
          RteBswImmediateRestart = false
          RteBswPositionInTask = 0
          RteBswEventRef = BswM_MainFunctionTimingEvent0
          RteBswMappedToTaskRef = Default_BSW_Async_Task
          RteBswUsedOsEventRef = Rte_Ev_Cyclic2_Default_BSW_Async_Task_0_10ms
          RteBswUsedOsAlarmRef = Os/Rte_Al_TE2_Default_BSW_Async_Task_0_10ms
        BSWM_EXCLUSIVE_AREA_0 (RteBswExclusiveAreaImpl): RteExclusiveAreaImplMechanism=ALL_INTERRUPT_BLOCKING, RteBswExclusiveAreaRef=BSWM_EXCLUSIVE_AREA_0
      Can: RteBswImplementationRef=Can_Impl, RteBswModuleConfigurationRef=Can
        3 x RteBswEventToTaskMapping, all with RteBswImmediateRestart=false, RteBswMappedToTaskRef=Default_BSW_Async_Task, RteBswUsedOsEventRef=Rte_Ev_Cyclic2_Default_BSW_Async_Task_0_10ms, RteBswUsedOsAlarmRef=Os/Rte_Al_TE2_Default_BSW_Async_Task_0_10ms:
          Can_MainFunction_BusOffTimingEvent0: RteBswPositionInTask=5, RteBswEventRef=Can_MainFunction_BusOffTimingEvent0
          Can_MainFunction_WakeupTimingEvent0: RteBswPositionInTask=7, RteBswEventRef=Can_MainFunction_WakeupTimingEvent0
          Can_MainFunction_ModeTimingEvent0: RteBswPositionInTask=6, RteBswEventRef=Can_MainFunction_ModeTimingEvent0
        7 x RteBswExclusiveAreaImpl, all with RteExclusiveAreaImplMechanism=ALL_INTERRUPT_BLOCKING:
          CAN_EXCLUSIVE_AREA_{0..6}: RteBswExclusiveAreaRef=CAN_EXCLUSIVE_AREA_{0..6}
        Can_MainFunction_ReadTimingEvent0 (RteBswEventToTaskMapping): RteBswImmediateRestart=false, RteBswEventRef=Can_MainFunction_ReadTimingEvent0
      CanIf: RteBswImplementationRef=CanIf_Impl, RteBswModuleConfigurationRef=CanIf
        8 x RteBswExclusiveAreaImpl, all with RteExclusiveAreaImplMechanism=ALL_INTERRUPT_BLOCKING:
          CANIF_EXCLUSIVE_AREA_{0..7}: RteBswExclusiveAreaRef=CANIF_EXCLUSIVE_AREA_{0..7}
      CanSM: RteBswImplementationRef=CanSM_Impl, RteBswModuleConfigurationRef=CanSM
        CanSM_MainFunctionTimingEvent0 (RteBswEventToTaskMapping):
          RteBswImmediateRestart = false
          RteBswPositionInTask = 2
          RteBswEventRef = CanSM_MainFunctionTimingEvent0
          RteBswMappedToTaskRef = Default_BSW_Async_Task
          RteBswUsedOsEventRef = Rte_Ev_Cyclic2_Default_BSW_Async_Task_0_10ms
          RteBswUsedOsAlarmRef = Os/Rte_Al_TE2_Default_BSW_Async_Task_0_10ms
        6 x RteBswExclusiveAreaImpl, all with RteExclusiveAreaImplMechanism=ALL_INTERRUPT_BLOCKING:
          CANSM_EXCLUSIVE_AREA_{1..6}: RteBswExclusiveAreaRef=CANSM_EXCLUSIVE_AREA_{1..6}
      Com: RteBswImplementationRef=Com_Impl, RteBswModuleConfigurationRef=Com
        Com_MainFunctionTxTimingEvent0 (RteBswEventToTaskMapping):
          RteBswImmediateRestart = false
          RteBswPositionInTask = 10
          RteBswEventRef = Com_MainFunctionTxTimingEvent0
          RteBswMappedToTaskRef = Default_BSW_Async_Task
          RteBswUsedOsEventRef = Rte_Ev_Cyclic2_Default_BSW_Async_Task_0_10ms
          RteBswUsedOsAlarmRef = Os/Rte_Al_TE2_Default_BSW_Async_Task_0_10ms
        Com_MainFunctionRxTimingEvent0 (RteBswEventToTaskMapping):
          RteBswImmediateRestart = false
          RteBswPositionInTask = 9
          RteBswEventRef = Com_MainFunctionRxTimingEvent0
          RteBswMappedToTaskRef = Default_BSW_Async_Task
          RteBswUsedOsEventRef = Rte_Ev_Cyclic2_Default_BSW_Async_Task_0_10ms
          RteBswUsedOsAlarmRef = Os/Rte_Al_TE2_Default_BSW_Async_Task_0_10ms
        3 x RteBswExclusiveAreaImpl, all with RteExclusiveAreaImplMechanism=ALL_INTERRUPT_BLOCKING:
          COM_EXCLUSIVE_AREA_TX: RteBswExclusiveAreaRef=COM_EXCLUSIVE_AREA_TX
          COM_EXCLUSIVE_AREA_RX: RteBswExclusiveAreaRef=COM_EXCLUSIVE_AREA_RX
          COM_EXCLUSIVE_AREA_BOTH: RteBswExclusiveAreaRef=COM_EXCLUSIVE_AREA_BOTH
      ComM: RteBswImplementationRef=ComM_Impl, RteBswModuleConfigurationRef=ComM
        ComM_MainFunction_0TimingEvent0 (RteBswEventToTaskMapping):
          RteBswImmediateRestart = false
          RteBswPositionInTask = 8
          RteBswEventRef = ComM_MainFunction_0TimingEvent0
          RteBswMappedToTaskRef = Default_BSW_Async_Task
          RteBswUsedOsEventRef = Rte_Ev_Cyclic2_Default_BSW_Async_Task_0_20ms
          RteBswUsedOsAlarmRef = Os/Rte_Al_TE2_Default_BSW_Async_Task_0_20ms
        COMM_EXCLUSIVE_AREA_0 (RteBswExclusiveAreaImpl): RteExclusiveAreaImplMechanism=ALL_INTERRUPT_BLOCKING, RteBswExclusiveAreaRef=COMM_EXCLUSIVE_AREA_0
        COMM_EXCLUSIVE_AREA_1 (RteBswExclusiveAreaImpl): RteExclusiveAreaImplMechanism=ALL_INTERRUPT_BLOCKING, RteBswExclusiveAreaRef=COMM_EXCLUSIVE_AREA_1
      Det: RteBswImplementationRef=Det_Impl, RteBswModuleConfigurationRef=Det
        DET_EXCLUSIVE_AREA_0 (RteBswExclusiveAreaImpl): RteExclusiveAreaImplMechanism=ALL_INTERRUPT_BLOCKING, RteBswExclusiveAreaRef=DET_EXCLUSIVE_AREA_0
      EcuM: RteBswImplementationRef=EcuM_Impl, RteBswModuleConfigurationRef=EcuM
        EcuM_MainFunctionTimingEvent0 (RteBswEventToTaskMapping):
          RteBswImmediateRestart = false
          RteBswPositionInTask = 14
          RteBswEventRef = EcuM_MainFunctionTimingEvent0
          RteBswMappedToTaskRef = Default_BSW_Async_Task
          RteBswUsedOsEventRef = Rte_Ev_Cyclic2_Default_BSW_Async_Task_0_10ms
          RteBswUsedOsAlarmRef = Os/Rte_Al_TE2_Default_BSW_Async_Task_0_10ms
        3 x RteBswExclusiveAreaImpl, all with RteExclusiveAreaImplMechanism=ALL_INTERRUPT_BLOCKING:
          ECUM_EXCLUSIVE_AREA_{0..2}: RteBswExclusiveAreaRef=ECUM_EXCLUSIVE_AREA_{0..2}
      PduR: RteBswImplementationRef=PduR_Impl, RteBswModuleConfigurationRef=PduR
        PDUR_EXCLUSIVE_AREA_0 (RteBswExclusiveAreaImpl): RteExclusiveAreaImplMechanism=ALL_INTERRUPT_BLOCKING, RteBswExclusiveAreaRef=PDUR_EXCLUSIVE_AREA_0
      Rte: RteBswImplementationRef=Rte_Impl, RteBswModuleConfigurationRef=Rte
    4 x RteSwComponentInstance:
      ComM_EcuSwComposition: RteSoftwareComponentInstanceRef=ComM
        13 x RteEventToTaskMapping, all with RteImmediateRestart=false:
          Timer_ComM_MainFunction_0: RtePositionInTask=8, RteEventRef=Timer_ComM_MainFunction_0, RteMappedToTaskRef=Default_BSW_Async_Task, RteUsedOsEventRef=Rte_Ev_Cyclic2_Default_BSW_Async_Task_0_20ms, RteUsedOsAlarmRef=Os/Rte_Al_TE2_Default_BSW_Async_Task_0_20ms
          OpEventLimitECUToNoComMode_LimitECUToNoComMode_modeLimitation: RteEventRef=OpEventLimitECUToNoComMode_LimitECUToNoComMode_modeLimitation
          OpEventReadInhibitCounter_ReadInhibitCounter_modeLimitation: RteEventRef=OpEventReadInhibitCounter_ReadInhibitCounter_modeLimitation
          OpEventResetInhibitCounter_ResetInhibitCounter_modeLimitation: RteEventRef=OpEventResetInhibitCounter_ResetInhibitCounter_modeLimitation
          OpEventSetECUGroupClassification_SetECUGroupClassification_modeLimitation: RteEventRef=OpEventSetECUGroupClassification_SetECUGroupClassification_modeLimitation
          OpEventPreventWakeUp_PreventWakeUp_CW_CAN00_f26020e5: RteEventRef=OpEventPreventWakeUp_PreventWakeUp_CW_CAN00_f26020e5
          OpEventGetMaxComMode_GetMaxComMode_UR_USR_CHNL_f276589c: RteEventRef=OpEventGetMaxComMode_GetMaxComMode_UR_USR_CHNL_f276589c
          OpEventGetInhibitionStatus_GetInhibitionStatus_CL_CAN00_f26020e5: RteEventRef=OpEventGetInhibitionStatus_GetInhibitionStatus_CL_CAN00_f26020e5
          OpEventGetCurrentComMode_GetCurrentComMode_UR_USR_CHNL_f276589c: RteEventRef=OpEventGetCurrentComMode_GetCurrentComMode_UR_USR_CHNL_f276589c
          OpEventGetInhibitionStatus_GetInhibitionStatus_CW_CAN00_f26020e5: RteEventRef=OpEventGetInhibitionStatus_GetInhibitionStatus_CW_CAN00_f26020e5
          OpEventLimitChannelToNoComMode_LimitChannelToNoComMode_CL_CAN00_f26020e5: RteEventRef=OpEventLimitChannelToNoComMode_LimitChannelToNoComMode_CL_CAN00_f26020e5
          OpEventGetRequestedComMode_GetRequestedComMode_UR_USR_CHNL_f276589c: RteEventRef=OpEventGetRequestedComMode_GetRequestedComMode_UR_USR_CHNL_f276589c
          OpEventRequestComMode_RequestComMode_UR_USR_CHNL_f276589c: RteEventRef=OpEventRequestComMode_RequestComMode_UR_USR_CHNL_f276589c
      BswM_EcuSwComposition: RteSoftwareComponentInstanceRef=BswM
        Timer_BswM_MainFunction (RteEventToTaskMapping):
          RteImmediateRestart = false
          RtePositionInTask = 0
          RteEventRef = Timer_BswM_MainFunction
          RteMappedToTaskRef = Default_BSW_Async_Task
          RteUsedOsEventRef = Rte_Ev_Cyclic2_Default_BSW_Async_Task_0_10ms
          RteUsedOsAlarmRef = Os/Rte_Al_TE2_Default_BSW_Async_Task_0_10ms
      Det_EcuSwComposition: RteSoftwareComponentInstanceRef=Det
      EcuM_EcuSwComposition: RteSoftwareComponentInstanceRef=EcuM
        8 x RteEventToTaskMapping, all with RteImmediateRestart=false:
          Timer_EcuM_MainFunction: RtePositionInTask=14, RteEventRef=Timer_EcuM_MainFunction, RteMappedToTaskRef=Default_BSW_Async_Task, RteUsedOsEventRef=Rte_Ev_Cyclic2_Default_BSW_Async_Task_0_10ms, RteUsedOsAlarmRef=Os/Rte_Al_TE2_Default_BSW_Async_Task_0_10ms
          OpEventSelectShutdownTarget_SelectShutdownTarget_EcuM_ShutdownTarget: RteEventRef=OpEventSelectShutdownTarget_SelectShutdownTarget_EcuM_ShutdownTarget
          OpEventGetShutdownTarget_GetShutdownTarget_EcuM_ShutdownTarget: RteEventRef=OpEventGetShutdownTarget_GetShutdownTarget_EcuM_ShutdownTarget
          OpEventGetLastShutdownTarget_GetLastShutdownTarget_EcuM_ShutdownTarget: RteEventRef=OpEventGetLastShutdownTarget_GetLastShutdownTarget_EcuM_ShutdownTarget
          OpEventSelectShutdownCause_SelectShutdownCause_EcuM_ShutdownTarget: RteEventRef=OpEventSelectShutdownCause_SelectShutdownCause_EcuM_ShutdownTarget
          OpEventGetShutdownCause_GetShutdownCause_EcuM_ShutdownTarget: RteEventRef=OpEventGetShutdownCause_GetShutdownCause_EcuM_ShutdownTarget
          OpEventSelectBootTarget_SelectBootTarget_EcuM_BootTarget: RteEventRef=OpEventSelectBootTarget_SelectBootTarget_EcuM_BootTarget
          OpEventGetBootTarget_GetBootTarget_EcuM_BootTarget: RteEventRef=OpEventGetBootTarget_GetBootTarget_EcuM_BootTarget
    Mcu (RteBswModuleInstance): RteBswImplementationRef=Mcu_Impl, RteBswModuleConfigurationRef=Mcu
    Os_OsCore_Core0_swc_EcuSwComposition (RteSwComponentInstance): RteSoftwareComponentInstanceRef=Os_OsCore_Core0_swc
      OpEventGetCounterValue_GetCounterValue_OsService_SystemTimer (RteEventToTaskMapping): RteImmediateRestart=false, RteEventRef=OpEventGetCounterValue_GetCounterValue_OsService_SystemTimer
      OpEventGetElapsedValue_GetElapsedValue_OsService_SystemTimer (RteEventToTaskMapping): RteImmediateRestart=false, RteEventRef=OpEventGetElapsedValue_GetElapsedValue_OsService_SystemTimer
    Dio (RteBswModuleInstance): RteBswImplementationRef=Dio_Impl, RteBswModuleConfigurationRef=Dio
    Port (RteBswModuleInstance): RteBswImplementationRef=Port_Impl, RteBswModuleConfigurationRef=Port
    StartApplication (RteSwComponentType): RteComponentTypeRef=StartApplication, RteImplementationRef=StartApplicationImplementation
      ComponentTypeCalibration (RteComponentTypeCalibration): RteCalibrationSupportEnabled=true
    StartApplication_EcuSwComposition (RteSwComponentInstance): RteSoftwareComponentInstanceRef=StartApplication
      8 x RteEventToTaskMapping, all with RteImmediateRestart=false:
        Timer_StartApplication_Cyclic1ms: RtePositionInTask=2, RteEventRef=Timer_StartApplication_Cyclic1ms, RteMappedToTaskRef=Default_Appl_Task, RteUsedOsEventRef=Rte_Ev_Run_StartApplication_StartApplication_Cyclic1ms, RteUsedOsAlarmRef=Os/Rte_Al_TE_StartApplication_StartApplication_Cyclic1ms
        Timer_StartApplication_Cyclic10ms: RtePositionInTask=1, RteEventRef=Timer_StartApplication_Cyclic10ms, RteMappedToTaskRef=Default_Appl_Task, RteUsedOsEventRef=Rte_Ev_Run_StartApplication_StartApplication_Cyclic10ms, RteUsedOsAlarmRef=Os/Rte_Al_TE_StartApplication_StartApplication_Cyclic10ms
        Timer_StartApplication_Cyclic250ms: RtePositionInTask=3, RteEventRef=Timer_StartApplication_Cyclic250ms, RteMappedToTaskRef=Default_Appl_Task, RteUsedOsEventRef=Rte_Ev_Run_StartApplication_StartApplication_Cyclic250ms, RteUsedOsAlarmRef=Os/Rte_Al_TE_StartApplication_StartApplication_Cyclic250ms
        Timer_StartApplication_Cyclic1000ms: RtePositionInTask=0, RteEventRef=Timer_StartApplication_Cyclic1000ms, RteMappedToTaskRef=Default_Appl_Task, RteUsedOsEventRef=Rte_Ev_Run_StartApplication_StartApplication_Cyclic1000ms, RteUsedOsAlarmRef=Os/Rte_Al_TE_StartApplication_StartApplication_Cyclic1000ms
        Timer_StartApplication_Init: RtePositionInTask=0, RteEventRef=Timer_StartApplication_Init, RteMappedToTaskRef=Default_Appl_Init_Task
        OpEventStartApplication_MEM_JobFinished_JobFinished_PpNvmJobFinishedPort: RteEventRef=OpEventStartApplication_MEM_JobFinished_JobFinished_PpNvmJobFinishedPort
        DataReceivedEvent_StartApplication_OnDataRec_RxCtrl_PpRxCtrl_DeSignal_Rx16bit_Cyclic_a691adb3: RtePositionInTask=4, RteEventRef=DataReceivedEvent_StartApplication_OnDataRec_RxCtrl_PpRxCtrl_DeSignal_Rx16bit_Cyclic_a691adb3, RteMappedToTaskRef=Default_Appl_Task, RteUsedOsEventRef=Rte_Ev_Run_StartApplication_StartApplication_OnDataRec_RxCtrl
        DataReceivedEvent_StartApplication_OnDataRec_RxData_PpRxData_DeSignal_Rx15bit_OnWrite_a1df81ad: RtePositionInTask=5, RteEventRef=DataReceivedEvent_StartApplication_OnDataRec_RxData_PpRxData_DeSignal_Rx15bit_OnWrite_a1df81ad, RteMappedToTaskRef=Default_Appl_Task, RteUsedOsEventRef=Rte_Ev_Run_StartApplication_StartApplication_OnDataRec_RxData
    AppCom_EcuSwComposition (RteSwComponentInstance): RteSoftwareComponentInstanceRef=AppCom
      TMT_RWsignal (RteEventToTaskMapping):
        RteImmediateRestart = false
        RtePositionInTask = 6
        RteEventRef = TMT_RWsignal
        RteMappedToTaskRef = Default_Appl_Task
        RteUsedOsEventRef = Rte_Ev_Run_AppCom_RWsignal
        RteUsedOsAlarmRef = Os/Rte_Al_TE_AppCom_RWsignal
    AppCom (RteSwComponentType): RteComponentTypeRef=AppCom, RteImplementationRef=AppCom_Implementation
      ComponentTypeCalibration (RteComponentTypeCalibration): RteCalibrationSupportEnabled=false
  module config ComM: implementation-config-variant=VARIANT-PRE-COMPILE, module-description=ComM_Impl
    ComMGeneral:
      ComMPncIdCounting = COMM_PNC_ID_COUNT_FROM_NM_MESSAGE
      ComMPncSupport = false
      ComMDevErrorDetect = true
      ComMEcuGroupClassification = 3
      ComMModeLimitationEnabled = false
      ComMSynchronousWakeUp = true
      ComMTMinFullComModeDuration = 5
      ComMVersionInfoApi = false
      ComMWakeupInhibitionEnabled = false
      ComMSafeBswChecks = false
      ComMGeneration: ComMOutOfBoundsWriteSanitizer=false, ComMOutOfBoundsReadSanitizer=false
    ComMConfigSet: ComMPncEnabled=false
      CAN00_f26020e5 (ComMChannel):  # CN_CAN00
        ComMBusType = COMM_BUS_TYPE_CAN
        ComMChannelId = 0
        ComMFullCommRequestNotificationEnabled = false
        ComMMainFunctionPeriod = 0.02
        ComMNoCom = false
        ComMNoWakeup = false
        ComMNetworkManagement: ComMNmVariant=NONE, ComMPncNmRequest=false
        CHNL_f276589c (ComMUserPerChannel): ComMUserChannel=USR_CHNL_f276589c  # CN_CAN00
      USR_CHNL_f276589c (ComMUser): ComMUserIdentifier=0, ComMUserModeNotification=false  # CN_CAN00
  module config CanIf: implementation-config-variant=VARIANT-PRE-COMPILE, module-description=CanIf_Impl
    CanIfDispatchCfg:
      CanIfDispatchUserCtrlBusOffName = CanSM_ControllerBusOff
      CanIfDispatchUserCtrlBusOffUL = CAN_SM
      CanIfDispatchUserCtrlModeIndicationName = CanSM_ControllerModeIndication
      CanIfDispatchUserCtrlModeIndicationUL = CAN_SM
    Can (CanIfCtrlDrvCfg): CanIfCtrlDrvTxCancellation=false, CanIfCtrlDrvInitHohConfigRef=CanIfInitHohCfg, CanIfCtrlDrvNameRef=CanGeneral
      CT_CAN00_e98c47e6 (CanIfCtrlCfg): CanIfCtrlId=0, CanIfCtrlWakeupSupport=false, CanIfCtrlJ1939DynAddrSupport=DISABLED, CanIfCtrlCanCtrlRef=CanConfigSet/CT_CAN00_e98c47e6
    CanIfInitCfg
      CanIfInitHohCfg: CanIfInitRefCfgSet=CanConfigSet
        CN_CAN00_e98c47e6_Tx (CanIfHthCfg): CanIfHthCanCtrlIdRef=Can/CT_CAN00_e98c47e6, CanIfHthIdSymRef=CanConfigSet/CN_CAN00_e98c47e6_Tx
        CN_CAN00_e98c47e6_Rx_Std (CanIfHrhCfg): CanIfHrhSoftwareFilter=true, CanIfHrhCanCtrlIdRef=Can/CT_CAN00_e98c47e6, CanIfHrhIdSymRef=CanConfigSet/CN_CAN00_e98c47e6_Rx_Std
      msg_Transmit_oCAN00_Tx_3abd61be (CanIfTxPduCfg):
        CanIfTxPduCanId = 512
        CanIfTxPduCanIdType = STANDARD_CAN
        CanIfTxPduDlc = 1
        CanIfTxPduUserTxConfirmationName = NULL_PTR
        CanIfTxPduUserTxConfirmationUL = NONE
        CanIfTxPduId = 1
        CanIfTxPduReadNotifyStatus = false
        CanIfTxPduType = STATIC
        CanIfTxPduBufferRef = CanIfBufferCfg_0fb271d2
        CanIfTxPduRef = PT_msg_Transmit_PP_msg_Transmit_Tx_0fb271d2_5e566ad9
      msg_MyECU_Lamp_oCAN00_Tx_3abd61be (CanIfTxPduCfg):
        CanIfTxPduCanId = 1297
        CanIfTxPduCanIdType = STANDARD_CAN
        CanIfTxPduDlc = 8
        CanIfTxPduUserTxConfirmationName = NULL_PTR
        CanIfTxPduUserTxConfirmationUL = NONE
        CanIfTxPduId = 0
        CanIfTxPduReadNotifyStatus = false
        CanIfTxPduType = STATIC
        CanIfTxPduBufferRef = CanIfBufferCfg_0fb271d2
        CanIfTxPduRef = PT_msg_MyECU_Lamp_PP_msg_MyECU_Lamp_Tx_0fb271d2_5e566ad9
      CanIfBufferCfg_0fb271d2 (CanIfBufferCfg):  # CHNL
        CanIfBufferSize = 0
        CanIfTxBufferHandlingType = NONE
        CanIfTxBufferMappedTxPdus = 2
        CanIfTxBufferMaxPduLength = 8
        CanIfBufferHthRef = CanIfInitHohCfg/CN_CAN00_e98c47e6_Tx
      msg_Receive_oCAN00_Rx_3abd61be (CanIfRxPduCfg):
        CanIfRxPduCanId = 528
        CanIfRxPduCanIdType = STANDARD_CAN
        CanIfRxPduDlc = 1
        CanIfRxPduUserRxIndicationName = PduR_CanIfRxIndication
        CanIfRxPduUserRxIndicationUL = PDUR
        CanIfRxPduId = 0
        CanIfRxPduReadData = false
        CanIfRxPduReadNotifyStatus = false
        CanIfRxPduDlcCheck = true
        CanIfRxPduHrhIdRef = CanIfInitHohCfg/CN_CAN00_e98c47e6_Rx_Std
        CanIfRxPduRef = PT_msg_Receive_PP_msg_Receive_Rx_0fb271d2_5e566ad9
    CanIfPrivateCfg:
      CanIfPrivateSoftwareFilterType = LINEAR
      CanIfPrivateDlcCheck = true
      CanIfSupportTTCAN = false
      CanIfTransceiverMapping = false
      CanIfTransceiverHandling = false
      CanIfSupportExtendedIds = false
      CanIfSupportNmOsek = false
      CanIfTxBufferType = NONE
      CanIfOptimizeOneController = true
      CanIfWakeupSupport = false
      CanIfStaticFdTxBufferSupport = false
      CanIfRxSearchConsiderMsgType = false
      CanIfMultipleBasicCANTxObjects = false
      CanIfTxBufferFifoSupport = false
      CanIfSetPduReceptionModeSupport = false
      CanIfDataChecksumRxSupport = false
      CanIfDataChecksumTxSupport = false
    CanIfPublicCfg:
      CanIfPublicPnSupport = false
      CanIfPublicCancelTransmitSupport = true
      CanIfPublicDevErrorDetect = true
      CanIfPublicHandleTypeEnum = UINT8
      CanIfPublicMultipleDrvSupport = false
      CanIfPublicNumberOfCanHwUnits = 1
      CanIfPublicReadRxPduDataApi = false
      CanIfPublicReadRxPduNotifyStatusApi = false
      CanIfPublicReadTxPduNotifyStatusApi = false
      CanIfPublicSetDynamicTxIdApi = false
      CanIfPublicTxBuffering = false
      CanIfPublicTxConfirmPollingSupport = false
      CanIfPublicVersionInfoApi = false
      CanIfPublicWakeupCheckValidSupport = false
      CanIfPnWakeupTxPduFilterSupport = false
      CanIfPnTrcvHandlingSupport = false
      CanIfJ1939DynAddrSupport = DISABLED
      CanIfSafeBswChecks = false
      CanIfSetBaudrateApi = false
  module config Can: implementation-config-variant=VARIANT-PRE-COMPILE, module-description=Can_Impl
    CanConfigSet
      CT_CAN00_e98c47e6 (CanController):
        CanControllerActivation = true
        CanBusoffProcessing = INTERRUPT
        CanControllerBaseAddress = 4026630656
        CanControllerId = 0
        CanRxProcessing = INTERRUPT
        CanTxProcessing = INTERRUPT
        CanWakeupProcessing = INTERRUPT
        CanWakeupSupport = false
        CanWakeupSourceId = 0
        CanPhysicalNode = Node0
        CanIOPort = b_000
        CanInterruptPriority = 10
        CanSRC = 0
        CanChannelCanObjectStartIndex = 0
        CanNumberOfCANObj = 7
        CanSrcTos = CPU0
        CanInterruptGroupPriority = 0
        CanClockFrequency = 20000000
        CanCommonCAN = false
        CanControllerDefaultBaudrate = CanControllerBaudrateConfig
        CanControllerSystemRef = CT_CAN00
        CanWakeupSourceRef = EcuMCommonConfiguration/CAN00_f26020e5
        CanCpuClockRef = McuClockReferencePoint
        CanControllerBaudrateConfig:
          CanControllerBaudRate = 500
          CanControllerBaudRateConfigID = 0
          CanControllerPropSeg = 7
          CanControllerSeg1 = 8
          CanControllerSeg2 = 4
          CanControllerSyncJumpWidth = 1
          CanBaudrateClock = 20000
          CanBaudratePrescaler = 2
          CanBaudrateDiv8 = false
        CanFilterMask: CanFilterMaskValue=0, CanFilterCodeValue=0, IsLocked=false
      CN_CAN00_e98c47e6_Rx_Std (CanHardwareObject):
        CanHandleType = BASIC
        CanIdType = STANDARD
        CanIdValue = 0
        CanObjectType = RECEIVE
        CanObjectId = 1
        CanHwProcessing = false
        CanObjectHwSize = 2
        CanObjectHwHandle = 1
        CanMaxDataLen = 8
        CanFdPaddingValue = 0
        CanObjectMultiplexedTransmission = false
        CanControllerRef = CanConfigSet/CT_CAN00_e98c47e6
        CanFilterMaskRef = CanFilterMask
      CN_CAN00_e98c47e6_Tx (CanHardwareObject):
        CanHandleType = BASIC
        CanIdValue = 0
        CanObjectType = TRANSMIT
        CanIdType = STANDARD
        CanObjectId = 0
        CanHwProcessing = false
        CanObjectHwSize = 1
        CanObjectHwHandle = 0
        CanMaxDataLen = 8
        CanFdPaddingValue = 0
        CanObjectMultiplexedTransmission = false
        CanControllerRef = CanConfigSet/CT_CAN00_e98c47e6
    CanGeneral:
      CanIndex = 0
      CanChangeBaudrateApi = false
      CanDevErrorDetection = true
      CanHardwareCancellation = false
      CanIdenticalIdCancellation = false
      CanMainFunctionBusoffPeriod = 0.01
      CanMainFunctionModePeriod = 0.01
      CanMainFunctionWakeupPeriod = 0.01
      CanMultiplexedTransmission = false
      CanSetBaudrateApi = false
      CanTimeoutDuration = 0.01
      CanVersionInfoApi = false
      CanGenericPrecopy = false
      CanHardwareLoopCheck = true
      CanSecureTempBuffer = false
      CanRxFullCANSupport = false
      CanTxFullCANSupport = false
      CanRxBasicCANSupport = true
      CanUseNestedCANInterrupts = false
      CanHardwareCancelByAppl = false
      CanIndividualProcessing = false
      CanGenericConfirmation = false
      CanRxQueue = false
      CanSupportMixedID = false
      CanRxQueueSize = 10
      CanMultipleBasicCANObjects = false
      CanMultipleBasicCANTxObjects = false
      CanHardwareHandleType = UINT8
      CanOptimizeOneController = true
      CanInterruptCategory = CATEGORY2
      CanGetStatus = false
      CanInterruptLock = DRIVER
      CanWakeupSupport = false
      CanRamCheck = None
      CanOverrunNotification = DET
      CanReinitStart = false
      CanGenericPreTransmit = false
      CanFdSupport = NONE
      CanRuntimeMeasurementSupport = false
      CanMaxRxDataLen = 8
      CanMaxTxDataLen = 8
      CanUsePeripheralAccessApi = false
      CanEnableMultipleCanDriver = false
      CanMaxNumberOfHwCANChannels = 3
      CanMaxNumberOfHwCANChannelsR = 3
      CanMaxNumberOfHwCANObj = 128
      CanMaxNumberOfHwCANObjR = 128
      CanClockDividerMode = NORMAL
      CanClockDivider = 1
      CanBaseAddress = 4026630144
      CanBaseAddressR = 4026695680
      CanSrcAddress = 4026763520
      CanSrcAddressR = 4026763584
      CanClockSourceSelection = Fosc
      CanFreezeDisable = false
      CanMirrorModeSupport = false
      CanUseOsInterruptControl = true
      CanRxHwFiFoFullNotification = false
      CanFdIsoSupport = false
      CanFdNiso = false
      CanFdPed = false
      CanSilentModeSupport = false
      CanSafeBswChecks = false
      CanCounterRef = SystemTimer
      CanMainFunctionRWPeriods: CanMainFunctionReadPeriod=0.01
  module config Det: implementation-config-variant=VARIANT-PRE-COMPILE, module-description=Det_Impl
    DetGeneral:
      DetVersionInfoApi = false
      DetEnableDet = true
      DetExtDebugSupport = true
      DetGlobalFilterSize = 10
      DetBreakFilterSize = 0
      DetLogBufferSize = 0
      DetReportErrorRecursionLimit = 0
      DetReportRuntimeErrorRecursionLimit = 0
      DetReportTransientFaultRecursionLimit = 0
      DetDltFilterSize = 0
      DetForwardToDlt = false
    DetConfigSet
  module config PduR: implementation-config-variant=VARIANT-PRE-COMPILE, module-description=PduR_Impl
    PduRGeneral: PduRDevErrorDetect=true, PduRVersionInfoApi=false, PduRMetaDataSupport=false, PduRPduCallback=false, PduRSwitching=false, PduRSafeBswChecks=false
      PduRGeneration:
        PduROutOfBoundsWriteProtectionStrategy = NONE
        PduROutOfBoundsWriteSanitizer = false
        PduROutOfBoundsReadSanitizer = false
        PduRNumericalDataTypeMinimizationStrategy = WITH_CAST
        PduRReduceConstantData2Define = false
        PduRBoolDataInArrayOfStructStrategy = BITMASKING
        PduRDeduplicateIndirectedData = true
        PduRDataDeduplicationStrategy = WITH_CAST
        PduRReduceBoolDataByNegationThreshold = 2
        PduRReduceBoolDataByNumericalComparisonThreshold = 2
        PduRReduceBoolDataByNumericalRelationThreshold = 2
        PduRReduceBoolDataByNumericalOperandStrategy = WITH_ANY_VALUE
        PduRReduceNumericalDataByOffsetThreshold = 2
        PduRReduceNumericalDataByArraySubtractionThreshold = 2
        PduRReduceDataByStreaming = false
        PduRShortSymbols = false
        PduRInterfacesForDeactivatedData = false
        PduRReferringKeysInComments = false
    PduRRoutingTables: PduRConfigurationId=0
      PduRRoutingTable
        3 x PduRRoutingPath, all with PduRRoutingPathCommunicationType=COMMUNICATION_INTERFACE:
          Can_PT_msg_Transmit_0fb271d2  # msg_Transmit_oCAN00
            DST_Can_PT_msg_Transmit_0fb271d2 (PduRDestPdu):
              PduRDestPduHandleId = 1
              PduRDestPduDirection = TRANSMIT
              PduRDestPduRoutingType = API_FORWARDING
              PduRTransmissionConfirmation = false
              PduRDestPduDataProvision = PDUR_DIRECT
              PduRDestPduRef = PT_msg_Transmit_PP_msg_Transmit_Tx_0fb271d2_5e566ad9
              PduRDestPduPduRBswModulesRef = PduR/CanIf
            SRC_Can_PT_msg_Transmit_0fb271d2 (PduRSrcPdu):
              PduRSourcePduHandleId = 1
              PduRSrcPduDirection = TRANSMIT
              PduRSrcPduRef = PT_msg_Transmit_PP_msg_Transmit_Tx_0fb271d2_5e566ad9
              PduRSrcPduPduRBswModulesRef = PduR/Com
          Can_PT_msg_MyECU_Lamp_0fb271d2  # msg_MyECU_Lamp_oCAN00
            DST_Can_PT_msg_MyECU_Lamp_0fb271d2 (PduRDestPdu):
              PduRDestPduHandleId = 0
              PduRDestPduDirection = TRANSMIT
              PduRDestPduRoutingType = API_FORWARDING
              PduRTransmissionConfirmation = false
              PduRDestPduDataProvision = PDUR_DIRECT
              PduRDestPduRef = PT_msg_MyECU_Lamp_PP_msg_MyECU_Lamp_Tx_0fb271d2_5e566ad9
              PduRDestPduPduRBswModulesRef = PduR/CanIf
            SRC_Can_PT_msg_MyECU_Lamp_0fb271d2 (PduRSrcPdu):
              PduRSourcePduHandleId = 0
              PduRSrcPduDirection = TRANSMIT
              PduRSrcPduRef = PT_msg_MyECU_Lamp_PP_msg_MyECU_Lamp_Tx_0fb271d2_5e566ad9
              PduRSrcPduPduRBswModulesRef = PduR/Com
          Can_PT_msg_Receive_0fb271d2  # msg_Receive_oCAN00
            DST_Can_PT_msg_Receive_0fb271d2 (PduRDestPdu):
              PduRDestPduHandleId = 0
              PduRDestPduDirection = RECEIVE
              PduRDestPduRoutingType = API_FORWARDING
              PduRTransmissionConfirmation = false
              PduRDestPduRef = PT_msg_Receive_PP_msg_Receive_Rx_0fb271d2_5e566ad9
              PduRDestPduPduRBswModulesRef = PduR/Com
            SRC_Can_PT_msg_Receive_0fb271d2 (PduRSrcPdu):
              PduRSourcePduHandleId = 0
              PduRSrcPduDirection = RECEIVE
              PduRSrcPduRef = PT_msg_Receive_PP_msg_Receive_Rx_0fb271d2_5e566ad9
              PduRSrcPduPduRBswModulesRef = PduR/CanIf
    CanIf (PduRBswModules):
      PduRCancelReceive = false
      PduRCancelTransmit = false
      PduRChangeParameterRequestApi = false
      PduRCommunicationInterface = true
      PduRLowerModule = true
      PduRTransportProtocol = false
      PduRTriggertransmit = false
      PduRTxConfirmation = false
      PduRUpperModule = false
      PduRUseTag = false
      PduRBswModuleRef = CanIf
    Com (PduRBswModules):
      PduRCancelReceive = false
      PduRCancelTransmit = false
      PduRChangeParameterRequestApi = false
      PduRCommunicationInterface = true
      PduRLowerModule = false
      PduRTransportProtocol = false
      PduRTriggertransmit = false
      PduRTxConfirmation = false
      PduRUpperModule = true
      PduRUseTag = false
      PduRBswModuleRef = Com
  module config EcuM: implementation-config-variant=VARIANT-PRE-COMPILE, module-description=EcuM_Impl
    EcuMConfiguration
      EcuMFlexConfiguration: EcuMFlexModuleConfigurationRef=CanConfigSet, EcuMNormalMcuModeRef=McuModeSettingConf_0
        ECUM_CAUSE_UNKNOWN (EcuMShutdownCause): EcuMShutdownCauseId=0
        ECUM_RESET_IO (EcuMResetMode): EcuMResetModeId=2
        ECUM_RESET_MCU (EcuMResetMode): EcuMResetModeId=0
        ECUM_CAUSE_DCM (EcuMShutdownCause): EcuMShutdownCauseId=3
        ECUM_RESET_WAKEUP (EcuMResetMode): EcuMResetModeId=3
        ECUM_CAUSE_ECU_STATE (EcuMShutdownCause): EcuMShutdownCauseId=1
        ECUM_RESET_WDG (EcuMResetMode): EcuMResetModeId=1
        ECUM_CAUSE_WDGM (EcuMShutdownCause): EcuMShutdownCauseId=2
      EcuMCommonConfiguration: EcuMConfigConsistencyHash=8789373758459766242, EcuMDefaultAppMode=OSDEFAULTAPPMODE, EcuMOSResource=OsResource_EcuM
        ECUM_WKSOURCE_POWER (EcuMWakeupSource): EcuMWakeupSourceId=0, EcuMValidationTimeout=0, EcuMCheckWakeupTimeout=0, EcuMWakeupSourcePolling=false
        EcuMDriverInitListOne
          6 x EcuMDriverInitItem:
            Mcu_Init: index=0, EcuMModuleID=Mcu, EcuMModuleService=Mcu_Init, EcuMModuleHeader=Mcu.h
            Mcu_InitClock: index=10, EcuMModuleID=Code, EcuMAdditionalInitCode=Mcu_InitClock(McuConf_McuModeSettingConf_McuModeSettingConf_0)
            Mcu_GetPllStatus: index=11, EcuMModuleID=Code, EcuMAdditionalInitCode=while (Mcu_GetPllStatus() != MCU_PLL_LOCKED)
            Mcu_DistributePllClock: index=12, EcuMModuleID=Code, EcuMAdditionalInitCode=Mcu_DistributePllClock()
            Dio_Init: index=2, EcuMModuleID=Dio, EcuMModuleService=Dio_Init, EcuMModuleHeader=Dio.h
            Port_Init: index=6, EcuMModuleID=Port, EcuMModuleService=Port_Init, EcuMModuleHeader=Port.h
        3 x EcuMWakeupSource, all with EcuMValidationTimeout=0, EcuMCheckWakeupTimeout=0, EcuMWakeupSourcePolling=false:
          ECUM_WKSOURCE_INTERNAL_WDG: EcuMWakeupSourceId=3
          ECUM_WKSOURCE_INTERNAL_RESET: EcuMWakeupSourceId=2
          ECUM_WKSOURCE_RESET: EcuMWakeupSourceId=1
        EcuMDefaultShutdownTarget: EcuMDefaultState=EcuMStateOff
        EcuMDriverRestartList
        ECUM_WKSOURCE_EXTERNAL_WDG (EcuMWakeupSource): EcuMWakeupSourceId=4, EcuMValidationTimeout=0, EcuMCheckWakeupTimeout=0, EcuMWakeupSourcePolling=false
        EcuMDriverInitListZero
          10 x EcuMDriverInitItem:
            BswM_InitMemory: index=0, EcuMModuleID=BswM, EcuMModuleService=BswM_InitMemory, EcuMModuleHeader=BswM.h
            CanIf_InitMemory: index=1, EcuMModuleID=CanIf, EcuMModuleService=CanIf_InitMemory, EcuMModuleHeader=CanIf.h
            CanSM_InitMemory: index=3, EcuMModuleID=CanSM, EcuMModuleService=CanSM_InitMemory, EcuMModuleHeader=CanSM_EcuM.h
            Can_InitMemory: index=5, EcuMModuleID=Can, EcuMModuleService=Can_InitMemory, EcuMModuleHeader=Can.h
            ComM_InitMemory: index=6, EcuMModuleID=ComM, EcuMModuleService=ComM_InitMemory, EcuMModuleHeader=ComM.h
            Com_InitMemory: index=7, EcuMModuleID=Com, EcuMModuleService=Com_InitMemory, EcuMModuleHeader=Com.h
            Det_InitMemory: index=11, EcuMModuleID=Det, EcuMModuleService=Det_InitMemory, EcuMModuleHeader=Det.h
            Det_Init: index=12, EcuMModuleID=Det, EcuMModuleService=Det_Init, EcuMModuleHeader=Det.h
            PduR_InitMemory: index=14, EcuMModuleID=PduR, EcuMModuleService=PduR_InitMemory, EcuMModuleHeader=PduR.h
            Rte_InitMemory: index=15, EcuMModuleID=Rte, EcuMModuleService=Rte_InitMemory, EcuMModuleHeader=Rte_Main.h
        CAN00_f26020e5 (EcuMWakeupSource): EcuMWakeupSourceId=5, EcuMWakeupSourcePolling=false, EcuMComMChannelRef=ComMConfigSet/CAN00_f26020e5  # CN_CAN00
    EcuMGeneral:
      EcuMDevErrorDetect = true
      EcuMIncludeDem = true
      EcuMIncludeDet = true
      EcuMMainFunctionPeriod = 0.01
      EcuMVersionInfoApi = false
      EcuMDeferredBswMNotification = false
      EcuMSlaveCoreHandling = true
      EcuMEnableFixBehavior = false
      EcuMGeneration: EcuMOutOfBoundsWriteSanitizer=false, EcuMOutOfBoundsReadSanitizer=false, EcuMInterfacesForDeactivatedData=false
    EcuMFlexGeneral: EcuMAlarmClockPresent=false, EcuMResetLoopDetection=false, EcuMEnableDefBehaviour=false
  module config CanSM: implementation-config-variant=VARIANT-PRE-COMPILE, module-description=CanSM_Impl
    CanSMConfiguration: CanSMModeRequestRepetitionMax=10, CanSMModeRequestRepetitionTime=0.1
      CHNL_f276589c (CanSMManagerNetwork):
        CanSMBorCounterL1ToL2 = 5
        CanSMBorTimeL1 = 1
        CanSMBorTimeL2 = 3
        CanSMBorTimeTxEnsured = 5
        CanSMBorTxConfirmationPolling = false
        CanSMComMNetworkHandleRef = ComMConfigSet/CAN00_f26020e5
        CT_CAN00_e98c47e6 (CanSMController): CanSMControllerId=Can/CT_CAN00_e98c47e6
    CanSMGeneral: CanSMDevErrorDetect=true, CanSMMainFunctionTimePeriod=0.01, CanSMVersionInfoApi=false, CanSMBorCheckLevel=false, CanSMSetBaudrateApi=false
      CanSMGeneration: CanSMOutOfBoundsWriteSanitizer=false, CanSMOutOfBoundsReadSanitizer=false
  module config BswM: implementation-config-variant=VARIANT-PRE-COMPILE, module-description=BswM_Impl
    BswMGeneral:
      BswMCanSMEnabled = true
      BswMComMEnabled = true
      BswMDcmEnabled = false
      BswMDevErrorDetect = true
      BswMEcuMEnabled = true
      BswMEthIfEnabled = false
      BswMEthSMEnabled = false
      BswMFrSMEnabled = false
      BswMGenericRequestEnabled = true
      BswMJ1939DcmEnabled = false
      BswMJ1939NmEnabled = false
      BswMLinSMEnabled = false
      BswMLinTPEnabled = false
      BswMNmEnabled = false
      BswMNvMEnabled = false
      BswMPduREnabled = false
      BswMRuleControlEnabled = false
      BswMSdEnabled = false
      BswMVersionInfoApi = false
      BswMWdgMEnabled = false
      BswMModeCheck = true
      BswMMainFunctionPeriod = 0.01
      BswMCommonData
      BswMGeneration:
        BswMOutOfBoundsWriteSanitizer = false
        BswMOutOfBoundsReadSanitizer = false
        BswMReduceConstantData2Define = true
        BswMReduceDataByStreaming = false
        BswMBoolDataInArrayOfStructStrategy = BITMASKING
        BswMInterfacesForDeactivatedData = false
    BswMConfig
      BswMArbitration
        ESH_RunToPostRun (BswMRule):
          BswMNestedExecutionOnly = false
          BswMRuleId = 8
          BswMRuleInitState = BSWM_FALSE
          BswMRuleExpressionRef = ESH_LE_RunToPostRun
          BswMRuleTrueActionList = ESH_AL_ExitRun
        ESH_LE_RunToPostRun (BswMLogicalExpression):
          BswMLogicalOperator = BSWM_AND
          BswMArgumentRef = ESH_Cond_StateIsRun
          BswMArgumentRef = ESH_LE_AllChannelsNoCom
          BswMArgumentRef = ESH_LE_RunReleased
          BswMArgumentRef = ESH_Cond_SelfRunReqTimerExpired
          BswMArgumentRef = ESH_Cond_ModeIsRun
        ESH_Cond_StateIsRun (BswMModeCondition): BswMConditionType=BSWM_EQUALS, BswMConditionMode=ESH_State
          BswMConditionValue
            BswMBswMode: BswMBswRequestedMode=ESH_RUN
        ESH_State (BswMModeRequestPort): BswMArbitrateOnInit=true, BswMRequestProcessing=BSWM_IMMEDIATE
          BswMModeRequestSource
            BswMGenericRequest: BswMModeRequesterId=230, BswMRequestedModeMax=7
              7 x BswMGenericRequestMode:
                ESH_INIT: BswMGenericRequestModeValue=0
                ESH_RUN: BswMGenericRequestModeValue=1
                ESH_POST_RUN: BswMGenericRequestModeValue=2
                ESH_PREP_SHUTDOWN: BswMGenericRequestModeValue=3
                ESH_WAIT_FOR_NVM: BswMGenericRequestModeValue=4
                ESH_SHUTDOWN: BswMGenericRequestModeValue=5
                ESH_WAKEUP: BswMGenericRequestModeValue=6
          BswMModeInitValue
            BswMBswModeInitValue: BswMBswModeInitValueMode=ESH_INIT
        ESH_LE_AllChannelsNoCom (BswMLogicalExpression): BswMLogicalOperator=BSWM_AND, BswMArgumentRef=ESH_Cond_NoComOn_CAN00_f26020e5
        ESH_LE_RunReleased (BswMLogicalExpression): BswMLogicalOperator=BSWM_AND, BswMArgumentRef=ESH_Cond_RunRequest0IsReleased, BswMArgumentRef=ESH_Cond_RunRequest1IsReleased
        ESH_Cond_RunRequest0IsReleased (BswMModeCondition): BswMConditionType=BSWM_EQUALS, BswMConditionMode=ESH_RunRequest_0
          BswMConditionValue
            BswMModeDeclaration: BswMModeValueRef=RELEASED
        ESH_RunRequest_0 (BswMModeRequestPort): BswMArbitrateOnInit=false, BswMRequestProcessing=BSWM_DEFERRED
          BswMModeRequestSource
            BswMSwcModeRequest: BswMModeRequestDataElementPrototypeName=requestedMode, BswMSwcModeRequestModeDeclarationGroupPrototypeRef=BswM_MDGP_ESH_RunRequest
          BswMModeInitValue
            BswMSwcModeInitValue: BswMSwcModeInitValueRef=RELEASED
        ESH_Cond_RunRequest1IsReleased (BswMModeCondition): BswMConditionType=BSWM_EQUALS, BswMConditionMode=ESH_RunRequest_1
          BswMConditionValue
            BswMModeDeclaration: BswMModeValueRef=RELEASED
        ESH_RunRequest_1 (BswMModeRequestPort): BswMArbitrateOnInit=false, BswMRequestProcessing=BSWM_DEFERRED
          BswMModeRequestSource
            BswMSwcModeRequest: BswMModeRequestDataElementPrototypeName=requestedMode, BswMSwcModeRequestModeDeclarationGroupPrototypeRef=BswM_MDGP_ESH_RunRequest
          BswMModeInitValue
            BswMSwcModeInitValue: BswMSwcModeInitValueRef=RELEASED
        ESH_Cond_SelfRunReqTimerExpired (BswMModeCondition): BswMConditionType=BSWM_EQUALS, BswMConditionMode=ESH_SelfRunRequestTimer
          BswMConditionValue
            BswMBswMode: BswMBswRequestedMode=BSWM_TIMER_EXPIRED
        ESH_SelfRunRequestTimer (BswMModeRequestPort): BswMArbitrateOnInit=false, BswMRequestProcessing=BSWM_DEFERRED
          BswMModeRequestSource
            BswMTimer
          BswMModeInitValue
            BswMBswModeInitValue: BswMBswModeInitValueMode=BSWM_TIMER_STOPPED
        ESH_Cond_ModeIsRun (BswMModeCondition): BswMConditionType=BSWM_EQUALS, BswMConditionMode=ESH_ModeNotification
          BswMConditionValue
            BswMModeDeclaration: BswMModeValueRef=RUN
        ESH_ModeNotification (BswMModeRequestPort): BswMArbitrateOnInit=false, BswMRequestProcessing=BSWM_DEFERRED
          BswMModeRequestSource
            BswMSwcModeNotification: BswMSwcModeNotificationModeDeclarationGroupPrototypeRef=BswM_MDGP_ESH_Mode
          BswMModeInitValue
            BswMSwcModeInitValue: BswMSwcModeInitValueRef=STARTUP
        ESH_RunToPostRunNested (BswMRule):
          BswMNestedExecutionOnly = true
          BswMRuleId = 9
          BswMRuleInitState = BSWM_FALSE
          BswMRuleExpressionRef = ESH_LE_ComMNoPendingRequests
          BswMRuleTrueActionList = ESH_AL_RunToPostRun
        ESH_LE_ComMNoPendingRequests (BswMLogicalExpression): BswMLogicalOperator=BSWM_AND, BswMArgumentRef=ESH_Cond_ComMNoPendingRequests
        ESH_Cond_ComMNoPendingRequests (BswMModeCondition): BswMConditionType=BSWM_EQUALS, BswMConditionMode=ESH_ComMPendingRequests
          BswMConditionValue
            BswMBswMode: BswMBswRequestedMode=ESH_COMM_NO_REQUEST
        ESH_ComMPendingRequests (BswMModeRequestPort): BswMArbitrateOnInit=false, BswMRequestProcessing=BSWM_DEFERRED
          BswMModeRequestSource
            BswMGenericRequest: BswMModeRequesterId=232, BswMRequestedModeMax=2
              ESH_COMM_NO_REQUEST (BswMGenericRequestMode): BswMGenericRequestModeValue=0
              ESH_COMM_PENDING_REQUEST (BswMGenericRequestMode): BswMGenericRequestModeValue=1
          BswMModeInitValue
            BswMBswModeInitValue: BswMBswModeInitValueMode=ESH_COMM_NO_REQUEST
        ESH_WaitToShutdown (BswMRule):
          BswMNestedExecutionOnly = false
          BswMRuleId = 10
          BswMRuleInitState = BSWM_FALSE
          BswMRuleExpressionRef = ESH_LE_WaitForNvMToShutdown
          BswMRuleTrueActionList = ESH_AL_WaitForNvMToShutdown
        ESH_LE_WaitForNvMToShutdown (BswMLogicalExpression): BswMLogicalOperator=BSWM_AND, BswMArgumentRef=ESH_Cond_StateIsWaitForNvm, BswMArgumentRef=ESH_LE_NoWakeup
        ESH_Cond_StateIsWaitForNvm (BswMModeCondition): BswMConditionType=BSWM_EQUALS, BswMConditionMode=ESH_State
          BswMConditionValue
            BswMBswMode: BswMBswRequestedMode=ESH_WAIT_FOR_NVM
        ESH_LE_NoWakeup (BswMLogicalExpression): BswMLogicalOperator=BSWM_AND, BswMArgumentRef=ESH_Cond_NoValidatedWakeups, BswMArgumentRef=ESH_Cond_ComMNoPendingRequests
        ESH_Cond_NoValidatedWakeups (BswMModeCondition): BswMConditionType=BSWM_EQUALS, BswMConditionMode=ESH_EcuM_GetValidatedWakeupEvents
          BswMConditionValue
            BswMBswMode: BswMBswRequestedMode=0
        ESH_EcuM_GetValidatedWakeupEvents (BswMModeRequestPort): BswMArbitrateOnInit=false, BswMRequestProcessing=BSWM_DEFERRED
          BswMModeRequestSource
            BswMUserConditionRequest: BswMUserCondition=EcuM_GetValidatedWakeupEvents()
        ESH_WakeupToPrep (BswMRule):
          BswMNestedExecutionOnly = false
          BswMRuleId = 12
          BswMRuleInitState = BSWM_FALSE
          BswMRuleExpressionRef = ESH_LE_WakeupToPrepShutdown
          BswMRuleTrueActionList = ESH_AL_WakeupToPrep
        ESH_LE_WakeupToPrepShutdown (BswMLogicalExpression):
          BswMLogicalOperator = BSWM_AND
          BswMArgumentRef = ESH_Cond_StateIsWakeup
          BswMArgumentRef = ESH_Cond_NoPendingWakeups
          BswMArgumentRef = ESH_LE_NoWakeup
          BswMArgumentRef = ESH_Cond_ModeIsWakeup
        ESH_Cond_StateIsWakeup (BswMModeCondition): BswMConditionType=BSWM_EQUALS, BswMConditionMode=ESH_State
          BswMConditionValue
            BswMBswMode: BswMBswRequestedMode=ESH_WAKEUP
        ESH_Cond_NoPendingWakeups (BswMModeCondition): BswMConditionType=BSWM_EQUALS, BswMConditionMode=ESH_EcuM_GetPendingWakeupEvents
          BswMConditionValue
            BswMBswMode: BswMBswRequestedMode=0
        ESH_EcuM_GetPendingWakeupEvents (BswMModeRequestPort): BswMArbitrateOnInit=false, BswMRequestProcessing=BSWM_DEFERRED
          BswMModeRequestSource
            BswMUserConditionRequest: BswMUserCondition=EcuM_GetPendingWakeupEvents()
        ESH_Cond_ModeIsWakeup (BswMModeCondition): BswMConditionType=BSWM_EQUALS, BswMConditionMode=ESH_ModeNotification
          BswMConditionValue
            BswMModeDeclaration: BswMModeValueRef=WAKEUP
        ESH_WaitToWakeup (BswMRule):
          BswMNestedExecutionOnly = false
          BswMRuleId = 11
          BswMRuleInitState = BSWM_FALSE
          BswMRuleExpressionRef = ESH_LE_WaitForNvMToWakeup
          BswMRuleTrueActionList = ESH_AL_WaitForNvMWakeup
        ESH_LE_WaitForNvMToWakeup (BswMLogicalExpression): BswMLogicalOperator=BSWM_AND, BswMArgumentRef=ESH_Cond_StateIsWaitForNvm, BswMArgumentRef=ESH_LE_ValidWakeup
        ESH_LE_ValidWakeup (BswMLogicalExpression): BswMLogicalOperator=BSWM_OR, BswMArgumentRef=ESH_Cond_ValidatedWakeups, BswMArgumentRef=ESH_Cond_ComMPendingRequests
        ESH_Cond_ValidatedWakeups (BswMModeCondition): BswMConditionType=BSWM_EQUALS_NOT, BswMConditionMode=ESH_EcuM_GetValidatedWakeupEvents
          BswMConditionValue
            BswMBswMode: BswMBswRequestedMode=0
        ESH_Cond_ComMPendingRequests (BswMModeCondition): BswMConditionType=BSWM_EQUALS, BswMConditionMode=ESH_ComMPendingRequests
          BswMConditionValue
            BswMBswMode: BswMBswRequestedMode=ESH_COMM_PENDING_REQUEST
        ESH_WakeupToRun (BswMRule):
          BswMNestedExecutionOnly = false
          BswMRuleId = 13
          BswMRuleInitState = BSWM_FALSE
          BswMRuleExpressionRef = ESH_LE_WakeupToRun
          BswMRuleTrueActionList = ESH_AL_WakeupToRun
        ESH_LE_WakeupToRun (BswMLogicalExpression): BswMLogicalOperator=BSWM_AND, BswMArgumentRef=ESH_Cond_StateIsWakeup, BswMArgumentRef=ESH_LE_ValidWakeup, BswMArgumentRef=ESH_Cond_ModeIsWakeup
        ESH_InitToWakeup (BswMRule):
          BswMNestedExecutionOnly = false
          BswMRuleId = 3
          BswMRuleInitState = BSWM_FALSE
          BswMRuleExpressionRef = ESH_LE_InitToWakeup
          BswMRuleTrueActionList = ESH_AL_InitToWakeup
        ESH_LE_InitToWakeup (BswMLogicalExpression): BswMLogicalOperator=BSWM_AND, BswMArgumentRef=ESH_Cond_StateIsInit
        ESH_Cond_StateIsInit (BswMModeCondition): BswMConditionType=BSWM_EQUALS, BswMConditionMode=ESH_State
          BswMConditionValue
            BswMBswMode: BswMBswRequestedMode=ESH_INIT
        ESH_PostRunToPrepNested (BswMRule):
          BswMNestedExecutionOnly = true
          BswMRuleId = 6
          BswMRuleInitState = BSWM_FALSE
          BswMRuleExpressionRef = ESH_LE_PostRunToPrep
          BswMRuleTrueActionList = ESH_AL_PostRunToPrepShutdown
        ESH_LE_PostRunToPrep (BswMLogicalExpression): BswMLogicalOperator=BSWM_AND, BswMArgumentRef=ESH_LE_PostRunReleased
        ESH_LE_PostRunReleased (BswMLogicalExpression): BswMLogicalOperator=BSWM_AND, BswMArgumentRef=ESH_Cond_PostRunRequest0IsReleased, BswMArgumentRef=ESH_Cond_PostRunRequest1IsReleased
        ESH_Cond_PostRunRequest0IsReleased (BswMModeCondition): BswMConditionType=BSWM_EQUALS, BswMConditionMode=ESH_PostRunRequest_0
          BswMConditionValue
            BswMModeDeclaration: BswMModeValueRef=RELEASED
        ESH_PostRunRequest_0 (BswMModeRequestPort): BswMArbitrateOnInit=false, BswMRequestProcessing=BSWM_DEFERRED
          BswMModeRequestSource
            BswMSwcModeRequest: BswMModeRequestDataElementPrototypeName=requestedMode, BswMSwcModeRequestModeDeclarationGroupPrototypeRef=BswM_MDGP_ESH_RunRequest
          BswMModeInitValue
            BswMSwcModeInitValue: BswMSwcModeInitValueRef=RELEASED
        ESH_Cond_PostRunRequest1IsReleased (BswMModeCondition): BswMConditionType=BSWM_EQUALS, BswMConditionMode=ESH_PostRunRequest_1
          BswMConditionValue
            BswMModeDeclaration: BswMModeValueRef=RELEASED
        ESH_PostRunRequest_1 (BswMModeRequestPort): BswMArbitrateOnInit=false, BswMRequestProcessing=BSWM_DEFERRED
          BswMModeRequestSource
            BswMSwcModeRequest: BswMModeRequestDataElementPrototypeName=requestedMode, BswMSwcModeRequestModeDeclarationGroupPrototypeRef=BswM_MDGP_ESH_RunRequest
          BswMModeInitValue
            BswMSwcModeInitValue: BswMSwcModeInitValueRef=RELEASED
        ESH_PostRunNested (BswMRule):
          BswMNestedExecutionOnly = true
          BswMRuleId = 5
          BswMRuleInitState = BSWM_FALSE
          BswMRuleExpressionRef = ESH_LE_RunRequestsOrWakeup
          BswMRuleFalseActionList = ESH_AL_ESH_PostRunToPrepCheck
          BswMRuleTrueActionList = ESH_AL_PostRunToRun
        ESH_LE_RunRequestsOrWakeup (BswMLogicalExpression): BswMLogicalOperator=BSWM_OR, BswMArgumentRef=ESH_LE_RunRequested, BswMArgumentRef=ESH_LE_ValidWakeup
        ESH_LE_RunRequested (BswMLogicalExpression): BswMLogicalOperator=BSWM_OR, BswMArgumentRef=ESH_Cond_RunRequest0IsRequested, BswMArgumentRef=ESH_Cond_RunRequest1IsRequested
        ESH_Cond_RunRequest0IsRequested (BswMModeCondition): BswMConditionType=BSWM_EQUALS, BswMConditionMode=ESH_RunRequest_0
          BswMConditionValue
            BswMModeDeclaration: BswMModeValueRef=REQUESTED
        ESH_Cond_RunRequest1IsRequested (BswMModeCondition): BswMConditionType=BSWM_EQUALS, BswMConditionMode=ESH_RunRequest_1
          BswMConditionValue
            BswMModeDeclaration: BswMModeValueRef=REQUESTED
        ESH_PostRun (BswMRule):
          BswMNestedExecutionOnly = false
          BswMRuleId = 4
          BswMRuleInitState = BSWM_FALSE
          BswMRuleExpressionRef = ESH_LE_PostRun
          BswMRuleTrueActionList = ESH_AL_ExitPostRun
        ESH_LE_PostRun (BswMLogicalExpression): BswMLogicalOperator=BSWM_AND, BswMArgumentRef=ESH_Cond_StateIsPostRun, BswMArgumentRef=ESH_Cond_ModeIsPostRun
        ESH_Cond_StateIsPostRun (BswMModeCondition): BswMConditionType=BSWM_EQUALS, BswMConditionMode=ESH_State
          BswMConditionValue
            BswMBswMode: BswMBswRequestedMode=ESH_POST_RUN
        ESH_Cond_ModeIsPostRun (BswMModeCondition): BswMConditionType=BSWM_EQUALS, BswMConditionMode=ESH_ModeNotification
          BswMConditionValue
            BswMModeDeclaration: BswMModeValueRef=POSTRUN
        ESH_PrepToWait (BswMRule):
          BswMNestedExecutionOnly = false
          BswMRuleId = 7
          BswMRuleInitState = BSWM_FALSE
          BswMRuleExpressionRef = ESH_LE_PrepShutdownToWaitForNvM
          BswMRuleTrueActionList = ESH_AL_PrepShutdownToWaitForNvM
        ESH_LE_PrepShutdownToWaitForNvM (BswMLogicalExpression): BswMLogicalOperator=BSWM_AND, BswMArgumentRef=ESH_Cond_StateIsPrepShutdown, BswMArgumentRef=ESH_Cond_ModeIsShutdown
        ESH_Cond_StateIsPrepShutdown (BswMModeCondition): BswMConditionType=BSWM_EQUALS, BswMConditionMode=ESH_State
          BswMConditionValue
            BswMBswMode: BswMBswRequestedMode=ESH_PREP_SHUTDOWN
        ESH_Cond_ModeIsShutdown (BswMModeCondition): BswMConditionType=BSWM_EQUALS, BswMConditionMode=ESH_ModeNotification
          BswMConditionValue
            BswMModeDeclaration: BswMModeValueRef=SHUTDOWN
        CC_CAN00_f26020e5_TX (BswMRule):
          BswMNestedExecutionOnly = false
          BswMRuleId = 2
          BswMRuleInitState = BSWM_FALSE
          BswMRuleExpressionRef = CC_LE_CAN00_f26020e5_TX
          BswMRuleFalseActionList = CC_AL_CAN00_f26020e5_TX_Disable
          BswMRuleTrueActionList = CC_AL_CAN00_f26020e5_TX_EnableNoinit
        CC_LE_CAN00_f26020e5_TX (BswMLogicalExpression): BswMLogicalOperator=BSWM_AND, BswMArgumentRef=CC_Cond_CanSMIndication_CAN00_f26020e5_EQ_CANSM_BSWM_FULL_COMMUNICATION
        CC_Cond_CanSMIndication_CAN00_f26020e5_EQ_CANSM_BSWM_FULL_COMMUNICATION (BswMModeCondition): BswMConditionType=BSWM_EQUALS, BswMConditionMode=CC_CanSMIndication_CAN00_f26020e5
          BswMConditionValue
            BswMBswMode: BswMBswRequestedMode=CANSM_BSWM_FULL_COMMUNICATION
        CC_CanSMIndication_CAN00_f26020e5 (BswMModeRequestPort): BswMArbitrateOnInit=false, BswMRequestProcessing=BSWM_IMMEDIATE
          BswMModeRequestSource
            BswMCanSMIndication: BswMCanSMChannelRef=ComMConfigSet/CAN00_f26020e5
          BswMModeInitValue
            BswMBswModeInitValue: BswMBswModeInitValueMode=CANSM_BSWM_NO_COMMUNICATION
        CC_CAN00_f26020e5_RX_DM (BswMRule):
          BswMNestedExecutionOnly = false
          BswMRuleId = 1
          BswMRuleInitState = BSWM_FALSE
          BswMRuleExpressionRef = CC_LE_CAN00_f26020e5_RX_DM
          BswMRuleFalseActionList = CC_AL_CAN00_f26020e5_Disable_DM
          BswMRuleTrueActionList = CC_AL_CAN00_f26020e5_Enable_DM
        CC_LE_CAN00_f26020e5_RX_DM (BswMLogicalExpression): BswMLogicalOperator=BSWM_AND, BswMArgumentRef=CC_Cond_CanSMIndication_CAN00_f26020e5_EQ_CANSM_BSWM_FULL_COMMUNICATION
        CC_CAN00_f26020e5_RX (BswMRule):
          BswMNestedExecutionOnly = false
          BswMRuleId = 0
          BswMRuleInitState = BSWM_FALSE
          BswMRuleExpressionRef = CC_LE_CAN00_f26020e5_RX
          BswMRuleFalseActionList = CC_AL_CAN00_f26020e5_RX_Disable
          BswMRuleTrueActionList = CC_AL_CAN00_f26020e5_RX_EnableNoinit
        CC_LE_CAN00_f26020e5_RX (BswMLogicalExpression): BswMLogicalOperator=BSWM_AND, BswMArgumentRef=CC_Cond_CanSMIndication_CAN00_f26020e5_NEQ_CANSM_BSWM_NO_COMMUNICATION
        CC_Cond_CanSMIndication_CAN00_f26020e5_NEQ_CANSM_BSWM_NO_COMMUNICATION (BswMModeCondition): BswMConditionType=BSWM_EQUALS_NOT, BswMConditionMode=CC_CanSMIndication_CAN00_f26020e5
          BswMConditionValue
            BswMBswMode: BswMBswRequestedMode=CANSM_BSWM_NO_COMMUNICATION
        ESH_Cond_NoComOn_CAN00_f26020e5 (BswMModeCondition): BswMConditionType=BSWM_EQUALS, BswMConditionMode=ESH_ComMIndication_CAN00_f26020e5
          BswMConditionValue
            BswMBswMode: BswMBswRequestedMode=COMM_NO_COMMUNICATION
        ESH_ComMIndication_CAN00_f26020e5 (BswMModeRequestPort): BswMArbitrateOnInit=false, BswMRequestProcessing=BSWM_DEFERRED
          BswMModeRequestSource
            BswMComMIndication: BswMComMChannelRef=ComMConfigSet/CAN00_f26020e5
          BswMModeInitValue
            BswMBswModeInitValue: BswMBswModeInitValueMode=COMM_NO_COMMUNICATION
      BswMModeControl: BswMInitActionListRef=INIT_AL_Initialize
        ESH_AL_ExitRun (BswMActionList): BswMActionListExecution=BSWM_CONDITION
          4 x BswMActionListItem, all with BswMAbortOnFail=false:
            ESH_Action_EnterExclusiveArea: BswMActionListItemIndex=0, BswMActionListItemRef=BswMModeControl/ESH_Action_EnterExclusiveArea
            ESH_Action_ComMCheckPendingRequests: BswMActionListItemIndex=1, BswMActionListItemRef=BswMModeControl/ESH_Action_ComMCheckPendingRequests
            ESH_RunToPostRunNested: BswMActionListItemIndex=2, BswMActionListItemRef=BswMArbitration/ESH_RunToPostRunNested
            ESH_Action_ExitExclusiveArea: BswMActionListItemIndex=3, BswMActionListItemRef=BswMModeControl/ESH_Action_ExitExclusiveArea
        ESH_Action_EnterExclusiveArea (BswMAction)
          BswMAvailableActions
            BswMUserCallout: BswMUserCalloutFunction=SchM_Enter_BswM_BSWM_EXCLUSIVE_AREA_0(), BswMCreateCallout=false, BswMUserIncludeFile=SchM_BswM.h
        ESH_Action_ComMCheckPendingRequests (BswMAction)
          BswMAvailableActions
            BswMUserCallout:
              BswMUserCalloutFunction = ESH_ComM_CheckPendingRequests()
              BswMCreateCallout = true
              BswMUserCode = ComM_StateType CAN00_f26020e5 = COMM_NO_COM_NO_PENDING_REQUEST; (void)ComM_GetState(ComMConf_ComMChannel_CAN00_f26020e5, &CAN00_f26020e5); /* SBSW_BSWM_FCTCALL_LOCALVAR */ if(CAN00_f26020e5 != COMM_NO_COM_NO_PENDING_REQUEST) { BswM_RequestMode(BSWM_GENERIC_ESH_ComMPendingRequests, BSWM_GENERICVALUE_ESH_ComMPendingRequests_ESH_COMM_PENDING_REQUEST); } else { BswM_RequestMode(BSWM_GENERIC_ESH_ComMPendingRequests, BSWM_GENERICVALUE_ESH_ComMPendingRequests_ESH_COMM_NO_REQUEST); }
        ESH_AL_RunToPostRun (BswMActionList): BswMActionListExecution=BSWM_CONDITION
          5 x BswMActionListItem, all with BswMAbortOnFail=false:
            ESH_Action_EcuMClearValidatedWakeupEvents: BswMActionListItemIndex=1, BswMActionListItemRef=BswMModeControl/ESH_Action_EcuMClearValidatedWakeupEvents
            ESH_Action_OnEnterPostRun: BswMActionListItemIndex=2, BswMActionListItemRef=BswMModeControl/ESH_Action_OnEnterPostRun
            ESH_Action_SwitchPostRun: BswMActionListItemIndex=3, BswMActionListItemRef=BswMModeControl/ESH_Action_SwitchPostRun
            ESH_Action_ESH_PostRun: BswMActionListItemIndex=4, BswMActionListItemRef=BswMModeControl/ESH_Action_ESH_PostRun
            ESH_Action_ComMDisallow_CAN00_f26020e5: BswMActionListItemIndex=0, BswMActionListItemRef=BswMModeControl/ESH_Action_ComMDisallow_CAN00_f26020e5
        3 x BswMAction:
          ESH_Action_EcuMClearValidatedWakeupEvents
            BswMAvailableActions
              BswMUserCallout: BswMUserCalloutFunction=EcuM_ClearValidatedWakeupEvent(ECUM_WKSOURCE_ALL_SOURCES), BswMCreateCallout=false, BswMUserIncludeFile=EcuM.h
          ESH_Action_OnEnterPostRun
            BswMAvailableActions
              BswMUserCallout: BswMUserCalloutFunction=BswM_ESH_OnEnterPostRun(), BswMCreateCallout=true
          ESH_Action_SwitchPostRun
            BswMAvailableActions
              BswMRteSwitch: BswMSwitchedMode=POSTRUN, BswMRteSwitchPortRef=ESH_ModeSwitch
        ESH_ModeSwitch (BswMSwitchPort): BswMModeSwitchInterfaceRef=BswM_MSI_ESH_Mode
        ESH_Action_ESH_PostRun (BswMAction)
          BswMAvailableActions
            BswMGenericModeSwitch: BswMGenericRequestRef=ESH_State, BswMGenericRequestModeRef=ESH_POST_RUN
        ESH_Action_ExitExclusiveArea (BswMAction)
          BswMAvailableActions
            BswMUserCallout: BswMUserCalloutFunction=SchM_Exit_BswM_BSWM_EXCLUSIVE_AREA_0(), BswMCreateCallout=false, BswMUserIncludeFile=SchM_BswM.h
        ESH_AL_WaitForNvMToShutdown (BswMActionList): BswMActionListExecution=BSWM_CONDITION
          ESH_Action_OnEnterShutdown (BswMActionListItem): BswMAbortOnFail=false, BswMActionListItemIndex=0, BswMActionListItemRef=BswMModeControl/ESH_Action_OnEnterShutdown
          ESH_Action_EcuMGoToSelectedShutdownTarget (BswMActionListItem): BswMAbortOnFail=false, BswMActionListItemIndex=1, BswMActionListItemRef=BswMModeControl/ESH_Action_EcuMGoToSelectedShutdownTarget
        ESH_Action_OnEnterShutdown (BswMAction)
          BswMAvailableActions
            BswMUserCallout: BswMUserCalloutFunction=BswM_ESH_OnEnterShutdown(), BswMCreateCallout=true
        ESH_Action_EcuMGoToSelectedShutdownTarget (BswMAction)
          BswMAvailableActions
            BswMUserCallout: BswMUserCalloutFunction=(void)EcuM_GoToSelectedShutdownTarget(), BswMCreateCallout=false, BswMUserIncludeFile=EcuM.h
        ESH_AL_WakeupToPrep (BswMActionList): BswMActionListExecution=BSWM_CONDITION
          3 x BswMActionListItem, all with BswMAbortOnFail=false:
            ESH_Action_OnEnterPrepShutdown: BswMActionListItemIndex=0, BswMActionListItemRef=BswMModeControl/ESH_Action_OnEnterPrepShutdown
            ESH_Action_SwitchShutdown: BswMActionListItemIndex=1, BswMActionListItemRef=BswMModeControl/ESH_Action_SwitchShutdown
            ESH_Action_ESH_PrepShutdown: BswMActionListItemIndex=2, BswMActionListItemRef=BswMModeControl/ESH_Action_ESH_PrepShutdown
        3 x BswMAction:
          ESH_Action_OnEnterPrepShutdown
            BswMAvailableActions
              BswMUserCallout: BswMUserCalloutFunction=BswM_ESH_OnEnterPrepShutdown(), BswMCreateCallout=true
          ESH_Action_SwitchShutdown
            BswMAvailableActions
              BswMRteSwitch: BswMSwitchedMode=SHUTDOWN, BswMRteSwitchPortRef=ESH_ModeSwitch
          ESH_Action_ESH_PrepShutdown
            BswMAvailableActions
              BswMGenericModeSwitch: BswMGenericRequestRef=ESH_State, BswMGenericRequestModeRef=ESH_PREP_SHUTDOWN
        ESH_AL_WaitForNvMWakeup (BswMActionList): BswMActionListExecution=BSWM_CONDITION
          3 x BswMActionListItem, all with BswMAbortOnFail=false:
            ESH_Action_OnEnterWakeup: BswMActionListItemIndex=0, BswMActionListItemRef=BswMModeControl/ESH_Action_OnEnterWakeup
            ESH_Action_SwitchWakeup: BswMActionListItemIndex=1, BswMActionListItemRef=BswMModeControl/ESH_Action_SwitchWakeup
            ESH_Action_ESH_Wakeup: BswMActionListItemIndex=2, BswMActionListItemRef=BswMModeControl/ESH_Action_ESH_Wakeup
        3 x BswMAction:
          ESH_Action_OnEnterWakeup
            BswMAvailableActions
              BswMUserCallout: BswMUserCalloutFunction=BswM_ESH_OnEnterWakeup(), BswMCreateCallout=true
          ESH_Action_SwitchWakeup
            BswMAvailableActions
              BswMRteSwitch: BswMSwitchedMode=WAKEUP, BswMRteSwitchPortRef=ESH_ModeSwitch
          ESH_Action_ESH_Wakeup
            BswMAvailableActions
              BswMGenericModeSwitch: BswMGenericRequestRef=ESH_State, BswMGenericRequestModeRef=ESH_WAKEUP
        ESH_AL_WakeupToRun (BswMActionList): BswMActionListExecution=BSWM_CONDITION
          6 x BswMActionListItem, all with BswMAbortOnFail=false:
            ESH_Action_SelfRunRequestTimer_Start: BswMActionListItemIndex=1, BswMActionListItemRef=BswMModeControl/ESH_Action_SelfRunRequestTimer_Start
            ESH_Action_OnEnterRun: BswMActionListItemIndex=2, BswMActionListItemRef=BswMModeControl/ESH_Action_OnEnterRun
            ESH_Action_SwitchRun: BswMActionListItemIndex=3, BswMActionListItemRef=BswMModeControl/ESH_Action_SwitchRun
            ESH_Action_ESH_Run: BswMActionListItemIndex=4, BswMActionListItemRef=BswMModeControl/ESH_Action_ESH_Run
            RTE_REQUEST_BswMRteModeRequestPort_REQUESTED: BswMActionListItemIndex=5, BswMActionListItemRef=BswMModeControl/RTE_REQUEST_BswMRteModeRequestPort_REQUESTED
            ESH_Action_ComMAllow_CAN00_f26020e5: BswMActionListItemIndex=0, BswMActionListItemRef=BswMModeControl/ESH_Action_ComMAllow_CAN00_f26020e5
        4 x BswMAction:
          ESH_Action_SelfRunRequestTimer_Start
            BswMAvailableActions
              BswMTimerControl: BswMTimerAction=BSWM_TIMER_START, BswMTimerValue=0.1, BswMTimerRef=ESH_SelfRunRequestTimer
          ESH_Action_OnEnterRun
            BswMAvailableActions
              BswMUserCallout: BswMUserCalloutFunction=BswM_ESH_OnEnterRun(), BswMCreateCallout=true
          ESH_Action_SwitchRun
            BswMAvailableActions
              BswMRteSwitch: BswMSwitchedMode=RUN, BswMRteSwitchPortRef=ESH_ModeSwitch
          ESH_Action_ESH_Run
            BswMAvailableActions
              BswMGenericModeSwitch: BswMGenericRequestRef=ESH_State, BswMGenericRequestModeRef=ESH_RUN
        6 x BswMActionList, all with BswMActionListExecution=BSWM_CONDITION:
          ESH_AL_InitToWakeup
            3 x BswMActionListItem, all with BswMAbortOnFail=false:
              ESH_Action_OnEnterWakeup: BswMActionListItemIndex=0, BswMActionListItemRef=BswMModeControl/ESH_Action_OnEnterWakeup
              ESH_Action_SwitchWakeup: BswMActionListItemIndex=1, BswMActionListItemRef=BswMModeControl/ESH_Action_SwitchWakeup
              ESH_Action_ESH_Wakeup: BswMActionListItemIndex=2, BswMActionListItemRef=BswMModeControl/ESH_Action_ESH_Wakeup
          ESH_AL_PostRunToPrepShutdown
            3 x BswMActionListItem, all with BswMAbortOnFail=false:
              ESH_Action_OnEnterPrepShutdown: BswMActionListItemIndex=0, BswMActionListItemRef=BswMModeControl/ESH_Action_OnEnterPrepShutdown
              ESH_Action_SwitchShutdown: BswMActionListItemIndex=1, BswMActionListItemRef=BswMModeControl/ESH_Action_SwitchShutdown
              ESH_Action_ESH_PrepShutdown: BswMActionListItemIndex=2, BswMActionListItemRef=BswMModeControl/ESH_Action_ESH_PrepShutdown
          ESH_AL_ESH_PostRunToPrepCheck
            ESH_PostRunToPrepNested (BswMActionListItem): BswMAbortOnFail=false, BswMActionListItemIndex=0, BswMActionListItemRef=BswMArbitration/ESH_PostRunToPrepNested
          ESH_AL_PostRunToRun
            5 x BswMActionListItem, all with BswMAbortOnFail=false:
              ESH_Action_SelfRunRequestTimer_Start: BswMActionListItemIndex=1, BswMActionListItemRef=BswMModeControl/ESH_Action_SelfRunRequestTimer_Start
              ESH_Action_OnEnterRun: BswMActionListItemIndex=2, BswMActionListItemRef=BswMModeControl/ESH_Action_OnEnterRun
              ESH_Action_SwitchRun: BswMActionListItemIndex=3, BswMActionListItemRef=BswMModeControl/ESH_Action_SwitchRun
              ESH_Action_ESH_Run: BswMActionListItemIndex=4, BswMActionListItemRef=BswMModeControl/ESH_Action_ESH_Run
              ESH_Action_ComMAllow_CAN00_f26020e5: BswMActionListItemIndex=0, BswMActionListItemRef=BswMModeControl/ESH_Action_ComMAllow_CAN00_f26020e5
          ESH_AL_ExitPostRun
            4 x BswMActionListItem, all with BswMAbortOnFail=false:
              ESH_Action_EnterExclusiveArea: BswMActionListItemIndex=0, BswMActionListItemRef=BswMModeControl/ESH_Action_EnterExclusiveArea
              ESH_Action_ComMCheckPendingRequests: BswMActionListItemIndex=1, BswMActionListItemRef=BswMModeControl/ESH_Action_ComMCheckPendingRequests
              ESH_PostRunNested: BswMActionListItemIndex=2, BswMActionListItemRef=BswMArbitration/ESH_PostRunNested
              ESH_Action_ExitExclusiveArea: BswMActionListItemIndex=3, BswMActionListItemRef=BswMModeControl/ESH_Action_ExitExclusiveArea
          ESH_AL_PrepShutdownToWaitForNvM
            3 x BswMActionListItem, all with BswMAbortOnFail=false:
              ESH_Action_ComMCheckPendingRequests: BswMActionListItemIndex=0, BswMActionListItemRef=BswMModeControl/ESH_Action_ComMCheckPendingRequests
              ESH_Action_OnEnterWaitForNvm: BswMActionListItemIndex=1, BswMActionListItemRef=BswMModeControl/ESH_Action_OnEnterWaitForNvm
              ESH_Action_ESH_WaitForNvm: BswMActionListItemIndex=2, BswMActionListItemRef=BswMModeControl/ESH_Action_ESH_WaitForNvm
        ESH_Action_OnEnterWaitForNvm (BswMAction)
          BswMAvailableActions
            BswMUserCallout: BswMUserCalloutFunction=BswM_ESH_OnEnterWaitForNvm(), BswMCreateCallout=true
        ESH_Action_ESH_WaitForNvm (BswMAction)
          BswMAvailableActions
            BswMGenericModeSwitch: BswMGenericRequestRef=ESH_State, BswMGenericRequestModeRef=ESH_WAIT_FOR_NVM
        INIT_AL_Initialize (BswMActionList): BswMActionListExecution=BSWM_CONDITION
          7 x BswMActionListItem, all with BswMAbortOnFail=false:
            INIT_Action_Can_Init: BswMActionListItemIndex=0, BswMActionListItemRef=BswMModeControl/INIT_Action_Can_Init
            INIT_Action_CanIf_Init: BswMActionListItemIndex=1, BswMActionListItemRef=BswMModeControl/INIT_Action_CanIf_Init
            INIT_Action_EnableInterrupts: BswMActionListItemIndex=5, BswMActionListItemRef=BswMModeControl/INIT_Action_EnableInterrupts
            INIT_Action_RteStart: BswMActionListItemIndex=6, BswMActionListItemRef=BswMModeControl/INIT_Action_RteStart
            INIT_Action_Com_Init: BswMActionListItemIndex=2, BswMActionListItemRef=BswMModeControl/INIT_Action_Com_Init
            INIT_Action_PduR_Init: BswMActionListItemIndex=3, BswMActionListItemRef=BswMModeControl/INIT_Action_PduR_Init
            INIT_Action_CanSM_Init: BswMActionListItemIndex=4, BswMActionListItemRef=BswMModeControl/INIT_Action_CanSM_Init
        4 x BswMAction:
          INIT_Action_Can_Init
            BswMAvailableActions
              BswMUserCallout: BswMUserCalloutFunction=Can_Init(Can_Config_Ptr), BswMCreateCallout=false, BswMUserIncludeFile=Can.h
          INIT_Action_CanIf_Init
            BswMAvailableActions
              BswMUserCallout: BswMUserCalloutFunction=CanIf_Init(CanIf_Config_Ptr), BswMCreateCallout=false, BswMUserIncludeFile=CanIf.h
          INIT_Action_EnableInterrupts
            BswMAvailableActions
              BswMUserCallout: BswMUserCalloutFunction=BswM_AL_SetProgrammableInterrupts(), BswMCreateCallout=true
          INIT_Action_RteStart
            BswMAvailableActions
              BswMUserCallout: BswMUserCalloutFunction=(void)Rte_Start(), BswMCreateCallout=false, BswMUserIncludeFile=Rte_Main.h
        BswMRteModeRequestPort: BswMRteModeInitValue=REQUESTED, BswMRteModeRequestPortInterfaceRef=BswM.Request_ESH_RunRequest_0.requestedMode
        RTE_REQUEST_BswMRteModeRequestPort_REQUESTED (BswMAction)
          BswMAvailableActions
            BswMRteModeRequest: BswMRequestedMode=REQUESTED, BswMRteModeRequestPortRef=BswMRteModeRequestPort
        CC_AL_CAN00_f26020e5_TX_Disable (BswMActionList): BswMActionListExecution=BSWM_TRIGGER
          CC_DisablePDUGroup_MyECU_oCAN00_Tx_fcef2243 (BswMActionListItem): BswMAbortOnFail=false, BswMActionListItemIndex=0, BswMActionListItemRef=BswMModeControl/CC_DisablePDUGroup_MyECU_oCAN00_Tx_fcef2243
        CC_DisablePDUGroup_MyECU_oCAN00_Tx_fcef2243 (BswMAction)
          BswMAvailableActions
            BswMPduGroupSwitch: BswMPduGroupSwitchReinit=false, BswMDisabledPduGroupRef=MyECU_oCAN00_Tx_fcef2243
        CC_AL_CAN00_f26020e5_TX_EnableNoinit (BswMActionList): BswMActionListExecution=BSWM_TRIGGER
          CC_EnablePDUGroup_MyECU_oCAN00_Tx_fcef2243 (BswMActionListItem): BswMAbortOnFail=false, BswMActionListItemIndex=0, BswMActionListItemRef=BswMModeControl/CC_EnablePDUGroup_MyECU_oCAN00_Tx_fcef2243
        CC_EnablePDUGroup_MyECU_oCAN00_Tx_fcef2243 (BswMAction)
          BswMAvailableActions
            BswMPduGroupSwitch: BswMPduGroupSwitchReinit=false, BswMEnabledPduGroupRef=MyECU_oCAN00_Tx_fcef2243
        CC_AL_CAN00_f26020e5_Disable_DM (BswMActionList): BswMActionListExecution=BSWM_TRIGGER
          CC_DisableDM_MyECU_oCAN00_Rx_fcef2243 (BswMActionListItem): BswMAbortOnFail=false, BswMActionListItemIndex=0, BswMActionListItemRef=BswMModeControl/CC_DisableDM_MyECU_oCAN00_Rx_fcef2243
        CC_DisableDM_MyECU_oCAN00_Rx_fcef2243 (BswMAction)
          BswMAvailableActions
            BswMDeadlineMonitoringControl: BswMDisabledDMPduGroupRef=MyECU_oCAN00_Rx_fcef2243
        CC_AL_CAN00_f26020e5_Enable_DM (BswMActionList): BswMActionListExecution=BSWM_TRIGGER
          CC_EnableDM_MyECU_oCAN00_Rx_fcef2243 (BswMActionListItem): BswMAbortOnFail=false, BswMActionListItemIndex=0, BswMActionListItemRef=BswMModeControl/CC_EnableDM_MyECU_oCAN00_Rx_fcef2243
        CC_EnableDM_MyECU_oCAN00_Rx_fcef2243 (BswMAction)
          BswMAvailableActions
            BswMDeadlineMonitoringControl: BswMEnabledDMPduGroupRef=MyECU_oCAN00_Rx_fcef2243
        CC_AL_CAN00_f26020e5_RX_Disable (BswMActionList): BswMActionListExecution=BSWM_TRIGGER
          CC_DisablePDUGroup_MyECU_oCAN00_Rx_fcef2243 (BswMActionListItem): BswMAbortOnFail=false, BswMActionListItemIndex=0, BswMActionListItemRef=BswMModeControl/CC_DisablePDUGroup_MyECU_oCAN00_Rx_fcef2243
        CC_DisablePDUGroup_MyECU_oCAN00_Rx_fcef2243 (BswMAction)
          BswMAvailableActions
            BswMPduGroupSwitch: BswMPduGroupSwitchReinit=false, BswMDisabledPduGroupRef=MyECU_oCAN00_Rx_fcef2243
        CC_AL_CAN00_f26020e5_RX_EnableNoinit (BswMActionList): BswMActionListExecution=BSWM_TRIGGER
          CC_EnablePDUGroup_MyECU_oCAN00_Rx_fcef2243 (BswMActionListItem): BswMAbortOnFail=false, BswMActionListItemIndex=0, BswMActionListItemRef=BswMModeControl/CC_EnablePDUGroup_MyECU_oCAN00_Rx_fcef2243
        6 x BswMAction:
          CC_EnablePDUGroup_MyECU_oCAN00_Rx_fcef2243
            BswMAvailableActions
              BswMPduGroupSwitch: BswMPduGroupSwitchReinit=false, BswMEnabledPduGroupRef=MyECU_oCAN00_Rx_fcef2243
          ESH_Action_ComMDisallow_CAN00_f26020e5
            BswMAvailableActions
              BswMComMAllowCom: BswMComAllowed=false, BswMComMAllowChannelRef=ComMConfigSet/CAN00_f26020e5
          ESH_Action_ComMAllow_CAN00_f26020e5
            BswMAvailableActions
              BswMComMAllowCom: BswMComAllowed=true, BswMComMAllowChannelRef=ComMConfigSet/CAN00_f26020e5
          INIT_Action_Com_Init
            BswMAvailableActions
              BswMUserCallout: BswMUserCalloutFunction=Com_Init(Com_Config_Ptr), BswMCreateCallout=false, BswMUserIncludeFile=Com.h
          INIT_Action_PduR_Init
            BswMAvailableActions
              BswMUserCallout: BswMUserCalloutFunction=PduR_Init(PduR_Config_Ptr), BswMCreateCallout=false, BswMUserIncludeFile=PduR.h
          INIT_Action_CanSM_Init
            BswMAvailableActions
              BswMUserCallout: BswMUserCalloutFunction=CanSM_Init(CanSM_Config_Ptr), BswMCreateCallout=false, BswMUserIncludeFile=CanSM_EcuM.h
      ESH_Mode (BswMRteModeDclGroup): BswMInitMode=STARTUP
        5 x BswMRteMode:
          STARTUP: BswMModePhysicalValue=0
          RUN: BswMModePhysicalValue=1
          POSTRUN: BswMModePhysicalValue=2
          WAKEUP: BswMModePhysicalValue=3
          SHUTDOWN: BswMModePhysicalValue=4
      ESH_RunRequest (BswMRteModeDclGroup): BswMInitMode=RELEASED
        RELEASED (BswMRteMode): BswMModePhysicalValue=0
        REQUESTED (BswMRteMode): BswMModePhysicalValue=1
      BswMDataTypeMappingSets: BswMDataTypeMappingSetRef=BswMMappingSet
package /Resource
  module config Resource: implementation-config-variant=VARIANT-PRE-COMPILE
    ResourceGeneral: ResourceSubDerivative=TC234LP_32F200F
package /Dio
  module config Dio: implementation-config-variant=VARIANT-POST-BUILD-LOADABLE, module-description=Dio_Impl
    DioConfig_p00 (DioConfig)
      DioPort_P00 (DioPort): DioPortId=0
        DioChannelGroup: DioChannelGroupIdentification=DioChGrpId_P0_0, DioPortMask=384, DioPortOffset=7
        DioChannel_led1 (DioChannel): DioChannelId=7
        DioChannel_led2 (DioChannel): DioChannelId=8
      DioPort: DioPortId=2
        3 x DioChannel:
          DioChannel_canEn: DioChannelId=3
          DioChannel_canNerr: DioChannelId=4
          DioChannel_canNstb: DioChannelId=2
    DioGeneral:
      DioDevErrorDetect = true
      DioFlipChannelApi = true
      DioPBFixedAddress = false
      DioRunningInUser0Mode = false
      DioUserModeInitApiEnable = false
      DioUserModeRuntimeApiEnable = false
      DioVersionInfoApi = false
    DioSafety: DioInitCheckApi=false, DioSafetyEnable=false
    CommonPublishedInformation:
      ArMajorVersion = 2
      ArMinorVersion = 5
      ArPatchVersion = 0
      ModuleId = 120
      Release = _TRICORE_TC234
      SwMajorVersion = 3
      SwMinorVersion = 1
      SwPatchVersion = 0
      VendorId = 17
package /Port
  module config Port: implementation-config-variant=VARIANT-POST-BUILD-LOADABLE, module-description=Port_Impl
    PortConfigSet_0 (PortConfigSet)
      15 x PortContainer:
        PortContainer_P00: PortNumber=0, PortNumberOfPortPins=11
          11 x PortPin, all with PortPinAnalogInput=DISABLE, PortPinControllerSelect=DISABLE, PortPinDirectionChangeable=false, PortPinDriverStrength=PORT_CMOS_SPEED_GRADE1, PortPinInitialMode=PORT_PIN_MODE_GPIO, PortPinInputCharacteristic=PORT_PIN_IN_PULL_UP, PortPinLevelValue=PORT_PIN_LEVEL_LOW, PortPinModeChangeable=false, PortPinPadLevel=PORT_PDR_CMOS_AUTOMOTIVE_LEVEL:
            PortPin_0: PortPinDirection=PORT_PIN_IN, PortPinId=0, PortPinMode=PORT_PIN_MODE_ALL, PortPinSymbolicName=PORT_0_PIN_0
            PortPin_1: PortPinDirection=PORT_PIN_IN, PortPinId=1, PortPinMode=PORT_PIN_MODE_ALL, PortPinSymbolicName=PORT_0_PIN_1
            PortPin_10: PortPinDirection=PORT_PIN_OUT, PortPinId=12, PortPinMode=PORT_PIN_MODE_GPIO, PortPinSymbolicName=PORT_0_PIN_12, PortPinOutputCharacteristic=PORT_PIN_OUT_PUSHPULL
            PortPin_{2..6}: PortPinDirection=PORT_PIN_IN, PortPinId={2..6}, PortPinMode=PORT_PIN_MODE_ALL, PortPinSymbolicName=PORT_0_PIN_{2..6}
            Port0Pin_7_LED2: PortPinDirection=PORT_PIN_OUT, PortPinId=7, PortPinMode=PORT_PIN_MODE_GPIO, PortPinSymbolicName=PORT_0_PIN_7, PortPinOutputCharacteristic=PORT_PIN_OUT_PUSHPULL
            Port0Pin_8_LED1: PortPinDirection=PORT_PIN_OUT, PortPinId=8, PortPinMode=PORT_PIN_MODE_GPIO, PortPinSymbolicName=PORT_0_PIN_8, PortPinOutputCharacteristic=PORT_PIN_OUT_PUSHPULL
            PortPin_9: PortPinDirection=PORT_PIN_IN, PortPinId=9, PortPinMode=PORT_PIN_MODE_ALL, PortPinSymbolicName=PORT_0_PIN_9
        PortContainer_P02: PortNumber=2, PortNumberOfPortPins=9
          9 x PortPin, all with PortPinAnalogInput=DISABLE, PortPinDirectionChangeable=false, PortPinDriverStrength=PORT_CMOS_SPEED_GRADE1, PortPinModeChangeable=false, PortPinPadLevel=PORT_PDR_CMOS_AUTOMOTIVE_LEVEL:
            Port_2_Pin_0_Can1Tx: PortPinControllerSelect=DISABLE, PortPinDirection=PORT_PIN_OUT, PortPinId=32, PortPinInitialMode=PORT_PIN_MODE_ALT5, PortPinInputCharacteristic=PORT_PIN_IN_NO_PULL, PortPinLevelValue=PORT_PIN_LEVEL_LOW, PortPinSymbolicName=PORT_2_PIN_0, PortPinMode=PORT_PIN_MODE_ALT5, PortPinOutputCharacteristic=PORT_PIN_OUT_PUSHPULL
            Port_2_Pin_1_Can1Rx: PortPinControllerSelect=ENABLE, PortPinDirection=PORT_PIN_IN, PortPinId=33, PortPinInitialMode=PORT_PIN_MODE_GPIO, PortPinInputCharacteristic=PORT_PIN_IN_PULL_UP, PortPinLevelValue=PORT_PIN_LEVEL_HIGH, PortPinMode=PORT_PIN_MODE_ALL, PortPinSymbolicName=PORT_2_PIN_1
            Port_2_Pin_2_Can1NsTB: PortPinControllerSelect=DISABLE, PortPinDirection=PORT_PIN_OUT, PortPinId=34, PortPinInitialMode=PORT_PIN_MODE_GPIO, PortPinInputCharacteristic=PORT_PIN_IN_PULL_UP, PortPinLevelValue=PORT_PIN_LEVEL_HIGH, PortPinMode=PORT_PIN_MODE_GPIO, PortPinSymbolicName=PORT_2_PIN_2, PortPinOutputCharacteristic=PORT_PIN_OUT_PUSHPULL
            Port_2_Pin_3_Can1En: PortPinControllerSelect=DISABLE, PortPinDirection=PORT_PIN_OUT, PortPinId=35, PortPinInitialMode=PORT_PIN_MODE_GPIO, PortPinInputCharacteristic=PORT_PIN_IN_PULL_UP, PortPinLevelValue=PORT_PIN_LEVEL_HIGH, PortPinMode=PORT_PIN_MODE_GPIO, PortPinSymbolicName=PORT_2_PIN_3, PortPinOutputCharacteristic=PORT_PIN_OUT_PUSHPULL
            Port02Pin_4_CAN1_NERR: PortPinControllerSelect=DISABLE, PortPinDirection=PORT_PIN_IN, PortPinId=36, PortPinInitialMode=PORT_PIN_MODE_GPIO, PortPinInputCharacteristic=PORT_PIN_IN_PULL_UP, PortPinLevelValue=PORT_PIN_LEVEL_LOW, PortPinMode=PORT_PIN_MODE_GPIO, PortPinSymbolicName=PORT_2_PIN_4
            PortPin_5: PortPinControllerSelect=DISABLE, PortPinDirection=PORT_PIN_IN, PortPinId=37, PortPinInitialMode=PORT_PIN_MODE_GPIO, PortPinInputCharacteristic=PORT_PIN_IN_PULL_UP, PortPinLevelValue=PORT_PIN_LEVEL_LOW, PortPinMode=PORT_PIN_MODE_ALL, PortPinSymbolicName=PORT_2_PIN_5
            PortPin_6: PortPinControllerSelect=DISABLE, PortPinDirection=PORT_PIN_IN, PortPinId=38, PortPinInitialMode=PORT_PIN_MODE_GPIO, PortPinInputCharacteristic=PORT_PIN_IN_PULL_UP, PortPinLevelValue=PORT_PIN_LEVEL_LOW, PortPinMode=PORT_PIN_MODE_ALL, PortPinSymbolicName=PORT_2_PIN_6
            Port02Pin_7_GTMTIM: PortPinControllerSelect=DISABLE, PortPinDirection=PORT_PIN_IN, PortPinId=39, PortPinInitialMode=PORT_PIN_MODE_GPIO, PortPinInputCharacteristic=PORT_PIN_IN_PULL_UP, PortPinLevelValue=PORT_PIN_LEVEL_LOW, PortPinMode=PORT_PIN_MODE_ALL, PortPinSymbolicName=PORT_2_PIN_7
            PortPin_8: PortPinControllerSelect=DISABLE, PortPinDirection=PORT_PIN_IN, PortPinId=40, PortPinInitialMode=PORT_PIN_MODE_GPIO, PortPinInputCharacteristic=PORT_PIN_IN_PULL_UP, PortPinLevelValue=PORT_PIN_LEVEL_LOW, PortPinMode=PORT_PIN_MODE_ALL, PortPinSymbolicName=PORT_2_PIN_8
        PortContainer_P23: PortNumber=23, PortNumberOfPortPins=1
          PortPin_0 (PortPin):
            PortPinAnalogInput = DISABLE
            PortPinControllerSelect = DISABLE
            PortPinDirection = PORT_PIN_IN
            PortPinDirectionChangeable = false
            PortPinDriverStrength = PORT_CMOS_SPEED_GRADE1
            PortPinId = 369
            PortPinInitialMode = PORT_PIN_MODE_GPIO
            PortPinInputCharacteristic = PORT_PIN_IN_PULL_UP
            PortPinLevelValue = PORT_PIN_LEVEL_LOW
            PortPinMode = PORT_PIN_MODE_ALL
            PortPinModeChangeable = false
            PortPinPadLevel = PORT_PDR_CMOS_AUTOMOTIVE_LEVEL
            PortPinSymbolicName = PORT_23_PIN_1
        PortContainer_P33: PortNumber=33, PortNumberOfPortPins=13
          13 x PortPin, all with PortPinAnalogInput=DISABLE, PortPinControllerSelect=DISABLE, PortPinDirection=PORT_PIN_IN, PortPinDirectionChangeable=false, PortPinDriverStrength=PORT_CMOS_SPEED_GRADE1, PortPinInitialMode=PORT_PIN_MODE_GPIO, PortPinLevelValue=PORT_PIN_LEVEL_LOW, PortPinMode=PORT_PIN_MODE_ALL, PortPinModeChangeable=false, PortPinPadLevel=PORT_PDR_CMOS_AUTOMOTIVE_LEVEL:
            PortPin_0: PortPinId=528, PortPinInputCharacteristic=PORT_PIN_IN_PULL_UP, PortPinSymbolicName=PORT_33_PIN_0
            PortPin_1: PortPinId=529, PortPinInputCharacteristic=PORT_PIN_IN_PULL_UP, PortPinSymbolicName=PORT_33_PIN_1
            PortPin_10: PortPinId=538, PortPinInputCharacteristic=PORT_PIN_IN_PULL_UP, PortPinSymbolicName=PORT_33_PIN_10
            PortPin_11: PortPinId=539, PortPinInputCharacteristic=PORT_PIN_IN_PULL_UP, PortPinSymbolicName=PORT_33_PIN_11
            PortPin_12: PortPinId=540, PortPinInputCharacteristic=PORT_PIN_IN_PULL_UP, PortPinSymbolicName=PORT_33_PIN_12
            PortPin_2: PortPinId=530, PortPinInputCharacteristic=PORT_PIN_IN_PULL_UP, PortPinSymbolicName=PORT_33_PIN_2
            PortPin_3: PortPinId=531, PortPinInputCharacteristic=PORT_PIN_IN_PULL_UP, PortPinSymbolicName=PORT_33_PIN_3
            PortPin_4: PortPinId=532, PortPinInputCharacteristic=PORT_PIN_IN_PULL_UP, PortPinSymbolicName=PORT_33_PIN_4
            PortPin_5: PortPinId=533, PortPinInputCharacteristic=PORT_PIN_IN_PULL_UP, PortPinSymbolicName=PORT_33_PIN_5
            PortPin_6: PortPinId=534, PortPinInputCharacteristic=PORT_PIN_IN_PULL_UP, PortPinSymbolicName=PORT_33_PIN_6
            PortPin_P33_7: PortPinId=535, PortPinSymbolicName=PORT_33_PIN_7
            PortPin_P33_8: PortPinId=536, PortPinSymbolicName=PORT_33_PIN_8
            PortPin_9: PortPinId=537, PortPinInputCharacteristic=PORT_PIN_IN_PULL_UP, PortPinSymbolicName=PORT_33_PIN_9
        PortContainer_P34: PortNumber=34, PortNumberOfPortPins=4
          4 x PortPin, all with PortPinAnalogInput=DISABLE, PortPinControllerSelect=DISABLE, PortPinDirection=PORT_PIN_IN, PortPinDirectionChangeable=false, PortPinDriverStrength=PORT_CMOS_SPEED_GRADE1, PortPinInitialMode=PORT_PIN_MODE_GPIO, PortPinInputCharacteristic=PORT_PIN_IN_PULL_UP, PortPinLevelValue=PORT_PIN_LEVEL_LOW, PortPinMode=PORT_PIN_MODE_ALL, PortPinModeChangeable=false, PortPinPadLevel=PORT_PDR_CMOS_AUTOMOTIVE_LEVEL:
            PortPin_0: PortPinId=544, PortPinSymbolicName=PORT_34_PIN_0
            PortPin_1: PortPinId=545, PortPinSymbolicName=PORT_34_PIN_1
            PortPin_2: PortPinId=546, PortPinSymbolicName=PORT_34_PIN_2
            PortPin_3: PortPinId=547, PortPinSymbolicName=PORT_34_PIN_3
        PortContainer_P40: PortNumber=40, PortNumberOfPortPins=12
          12 x PortPin, all with PortPinAnalogInput=DISABLE, PortPinControllerSelect=DISABLE, PortPinDirection=PORT_PIN_IN, PortPinDirectionChangeable=false, PortPinDriverStrength=PORT_CMOS_SPEED_GRADE1, PortPinInitialMode=PORT_PIN_MODE_GPIO, PortPinInputCharacteristic=PORT_PIN_IN_PULL_UP, PortPinLevelValue=PORT_PIN_LEVEL_LOW, PortPinModeChangeable=false, PortPinPadLevel=PORT_PDR_CMOS_AUTOMOTIVE_LEVEL:
            PortPin_0: PortPinId=640, PortPinSymbolicName=PORT_40_PIN_0
            PortPin_1: PortPinId=641, PortPinSymbolicName=PORT_40_PIN_1
            PortPin_10: PortPinId=650, PortPinSymbolicName=PORT_40_PIN_10
            PortPin_11: PortPinId=651, PortPinSymbolicName=PORT_40_PIN_11
            PortPin_2: PortPinId=642, PortPinSymbolicName=PORT_40_PIN_2
            PortPin_3: PortPinId=643, PortPinSymbolicName=PORT_40_PIN_3
            PortPin_4: PortPinId=644, PortPinSymbolicName=PORT_40_PIN_4
            PortPin_5: PortPinId=645, PortPinSymbolicName=PORT_40_PIN_5
            PortPin_6: PortPinId=646, PortPinSymbolicName=PORT_40_PIN_6
            PortPin_7: PortPinId=647, PortPinSymbolicName=PORT_40_PIN_7
            PortPin_8: PortPinId=648, PortPinSymbolicName=PORT_40_PIN_8
            PortPin_9: PortPinId=649, PortPinSymbolicName=PORT_40_PIN_9
        PortContainer_P41: PortNumber=41, PortNumberOfPortPins=12
          12 x PortPin, all with PortPinAnalogInput=DISABLE, PortPinControllerSelect=DISABLE, PortPinDirection=PORT_PIN_IN, PortPinDirectionChangeable=false, PortPinDriverStrength=PORT_CMOS_SPEED_GRADE1, PortPinInitialMode=PORT_PIN_MODE_GPIO, PortPinInputCharacteristic=PORT_PIN_IN_PULL_UP, PortPinLevelValue=PORT_PIN_LEVEL_LOW, PortPinModeChangeable=false, PortPinPadLevel=PORT_PDR_CMOS_AUTOMOTIVE_LEVEL:
            PortPin_0: PortPinId=656, PortPinSymbolicName=PORT_41_PIN_0
            PortPin_1: PortPinId=657, PortPinSymbolicName=PORT_41_PIN_1
            PortPin_10: PortPinId=666, PortPinSymbolicName=PORT_41_PIN_10
            PortPin_11: PortPinId=667, PortPinSymbolicName=PORT_41_PIN_11
            PortPin_2: PortPinId=658, PortPinSymbolicName=PORT_41_PIN_2
            PortPin_3: PortPinId=659, PortPinSymbolicName=PORT_41_PIN_3
            PortPin_4: PortPinId=660, PortPinSymbolicName=PORT_41_PIN_4
            PortPin_5: PortPinId=661, PortPinSymbolicName=PORT_41_PIN_5
            PortPin_6: PortPinId=662, PortPinSymbolicName=PORT_41_PIN_6
            PortPin_7: PortPinId=663, PortPinSymbolicName=PORT_41_PIN_7
            PortPin_8: PortPinId=664, PortPinSymbolicName=PORT_41_PIN_8
            PortPin_9: PortPinId=665, PortPinSymbolicName=PORT_41_PIN_9
        PortContainer_P10: PortNumber=10, PortNumberOfPortPins=5
          5 x PortPin, all with PortPinAnalogInput=DISABLE, PortPinControllerSelect=DISABLE, PortPinDirection=PORT_PIN_IN, PortPinDirectionChangeable=false, PortPinDriverStrength=PORT_CMOS_SPEED_GRADE1, PortPinInitialMode=PORT_PIN_MODE_GPIO, PortPinInputCharacteristic=PORT_PIN_IN_PULL_UP, PortPinLevelValue=PORT_PIN_LEVEL_LOW, PortPinMode=PORT_PIN_MODE_ALL, PortPinModeChangeable=false, PortPinPadLevel=PORT_PDR_CMOS_AUTOMOTIVE_LEVEL:
            PortPin_0: PortPinId=161, PortPinSymbolicName=PORT_10_PIN_1
            PortPin_1: PortPinId=162, PortPinSymbolicName=PORT_10_PIN_2
            PortPin_2: PortPinId=163, PortPinSymbolicName=PORT_10_PIN_3
            PortPin_3: PortPinId=165, PortPinSymbolicName=PORT_10_PIN_5
            PortPin_4: PortPinId=166, PortPinSymbolicName=PORT_10_PIN_6
        PortContainer_P11: PortNumber=11, PortNumberOfPortPins=8
          8 x PortPin, all with PortPinAnalogInput=DISABLE, PortPinControllerSelect=DISABLE, PortPinDirection=PORT_PIN_IN, PortPinDirectionChangeable=false, PortPinDriverStrength=PORT_CMOS_SPEED_GRADE1, PortPinInitialMode=PORT_PIN_MODE_GPIO, PortPinInputCharacteristic=PORT_PIN_IN_PULL_UP, PortPinLevelValue=PORT_PIN_LEVEL_LOW, PortPinMode=PORT_PIN_MODE_ALL, PortPinModeChangeable=false, PortPinPadLevel=PORT_PDR_CMOS_AUTOMOTIVE_LEVEL:
            PortPin_0: PortPinId=178, PortPinSymbolicName=PORT_11_PIN_2
            PortPin_1: PortPinId=179, PortPinSymbolicName=PORT_11_PIN_3
            PortPin_2: PortPinId=182, PortPinSymbolicName=PORT_11_PIN_6
            PortPin_3: PortPinId=184, PortPinSymbolicName=PORT_11_PIN_8
            PortPin_4: PortPinId=185, PortPinSymbolicName=PORT_11_PIN_9
            PortPin_5: PortPinId=186, PortPinSymbolicName=PORT_11_PIN_10
            PortPin_6: PortPinId=187, PortPinSymbolicName=PORT_11_PIN_11
            PortPin_7: PortPinId=188, PortPinSymbolicName=PORT_11_PIN_12
        PortContainer_P13: PortNumber=13, PortNumberOfPortPins=4
          4 x PortPin, all with PortPinAnalogInput=DISABLE, PortPinControllerSelect=DISABLE, PortPinDirection=PORT_PIN_IN, PortPinDirectionChangeable=false, PortPinDriverStrength=PORT_CMOS_SPEED_GRADE1, PortPinInitialMode=PORT_PIN_MODE_GPIO, PortPinInputCharacteristic=PORT_PIN_IN_PULL_UP, PortPinLevelValue=PORT_PIN_LEVEL_LOW, PortPinMode=PORT_PIN_MODE_ALL, PortPinModeChangeable=false, PortPinPadLevel=PORT_PDR_CMOS_AUTOMOTIVE_LEVEL:
            PortPin_0: PortPinId=208, PortPinSymbolicName=PORT_13_PIN_0
            PortPin_1: PortPinId=209, PortPinSymbolicName=PORT_13_PIN_1
            PortPin_2: PortPinId=210, PortPinSymbolicName=PORT_13_PIN_2
            PortPin_3: PortPinId=211, PortPinSymbolicName=PORT_13_PIN_3
        PortContainer_P14: PortNumber=14, PortNumberOfPortPins=9
          9 x PortPin, all with PortPinAnalogInput=DISABLE, PortPinControllerSelect=DISABLE, PortPinDirectionChangeable=false, PortPinDriverStrength=PORT_CMOS_SPEED_GRADE1, PortPinInputCharacteristic=PORT_PIN_IN_PULL_UP, PortPinModeChangeable=false, PortPinPadLevel=PORT_PDR_CMOS_AUTOMOTIVE_LEVEL:
            Port14Pin_0_CanTx: PortPinDirection=PORT_PIN_OUT, PortPinId=224, PortPinInitialMode=PORT_PIN_MODE_ALT5, PortPinLevelValue=PORT_PIN_LEVEL_LOW, PortPinMode=PORT_PIN_MODE_ALT5, PortPinSymbolicName=PORT_14_PIN_0, PortPinOutputCharacteristic=PORT_PIN_OUT_PUSHPULL
            Port14Pin_1_CanRx: PortPinDirection=PORT_PIN_IN, PortPinId=225, PortPinInitialMode=PORT_PIN_MODE_GPIO, PortPinLevelValue=PORT_PIN_LEVEL_LOW, PortPinMode=PORT_PIN_MODE_GPIO, PortPinSymbolicName=PORT_14_PIN_1
            PortPin_2: PortPinDirection=PORT_PIN_IN, PortPinId=226, PortPinInitialMode=PORT_PIN_MODE_GPIO, PortPinLevelValue=PORT_PIN_LEVEL_LOW, PortPinMode=PORT_PIN_MODE_ALL, PortPinSymbolicName=PORT_14_PIN_2
            PortPin_3: PortPinDirection=PORT_PIN_IN, PortPinId=227, PortPinInitialMode=PORT_PIN_MODE_GPIO, PortPinLevelValue=PORT_PIN_LEVEL_LOW, PortPinMode=PORT_PIN_MODE_ALL, PortPinSymbolicName=PORT_14_PIN_3
            Port14Pin_4_Can2En: PortPinDirection=PORT_PIN_OUT, PortPinId=228, PortPinInitialMode=PORT_PIN_MODE_GPIO, PortPinLevelValue=PORT_PIN_LEVEL_HIGH, PortPinMode=PORT_PIN_MODE_GPIO, PortPinSymbolicName=PORT_14_PIN_4, PortPinOutputCharacteristic=PORT_PIN_OUT_PUSHPULL
            PortPin_5: PortPinDirection=PORT_PIN_IN, PortPinId=229, PortPinInitialMode=PORT_PIN_MODE_GPIO, PortPinLevelValue=PORT_PIN_LEVEL_LOW, PortPinMode=PORT_PIN_MODE_ALL, PortPinSymbolicName=PORT_14_PIN_5
            PortPin_6: PortPinDirection=PORT_PIN_IN, PortPinId=230, PortPinInitialMode=PORT_PIN_MODE_GPIO, PortPinLevelValue=PORT_PIN_LEVEL_LOW, PortPinMode=PORT_PIN_MODE_ALL, PortPinSymbolicName=PORT_14_PIN_6
            PortPin_7: PortPinDirection=PORT_PIN_IN, PortPinId=231, PortPinInitialMode=PORT_PIN_MODE_GPIO, PortPinLevelValue=PORT_PIN_LEVEL_LOW, PortPinMode=PORT_PIN_MODE_ALL, PortPinSymbolicName=PORT_14_PIN_7
            PortPin_8: PortPinDirection=PORT_PIN_IN, PortPinId=232, PortPinInitialMode=PORT_PIN_MODE_GPIO, PortPinLevelValue=PORT_PIN_LEVEL_LOW, PortPinMode=PORT_PIN_MODE_ALL, PortPinSymbolicName=PORT_14_PIN_8
        PortContainer_P15: PortNumber=15, PortNumberOfPortPins=9
          9 x PortPin, all with PortPinAnalogInput=DISABLE, PortPinControllerSelect=DISABLE, PortPinDirection=PORT_PIN_IN, PortPinDirectionChangeable=false, PortPinDriverStrength=PORT_CMOS_SPEED_GRADE1, PortPinInitialMode=PORT_PIN_MODE_GPIO, PortPinInputCharacteristic=PORT_PIN_IN_PULL_UP, PortPinLevelValue=PORT_PIN_LEVEL_LOW, PortPinMode=PORT_PIN_MODE_ALL, PortPinModeChangeable=false, PortPinPadLevel=PORT_PDR_CMOS_AUTOMOTIVE_LEVEL:
            PortPin_0: PortPinId=240, PortPinSymbolicName=PORT_15_PIN_0
            PortPin_1: PortPinId=241, PortPinSymbolicName=PORT_15_PIN_1
            PortPin_2: PortPinId=242, PortPinSymbolicName=PORT_15_PIN_2
            PortPin_3: PortPinId=243, PortPinSymbolicName=PORT_15_PIN_3
            PortPin_4: PortPinId=244, PortPinSymbolicName=PORT_15_PIN_4
            PortPin_5: PortPinId=245, PortPinSymbolicName=PORT_15_PIN_5
            PortPin_6: PortPinId=246, PortPinSymbolicName=PORT_15_PIN_6
            PortPin_7: PortPinId=247, PortPinSymbolicName=PORT_15_PIN_7
            PortPin_8: PortPinId=248, PortPinSymbolicName=PORT_15_PIN_8
        PortContainer_P20: PortNumber=20, PortNumberOfPortPins=12
          12 x PortPin, all with PortPinAnalogInput=DISABLE, PortPinControllerSelect=DISABLE, PortPinDirection=PORT_PIN_IN, PortPinDirectionChangeable=false, PortPinDriverStrength=PORT_CMOS_SPEED_GRADE1, PortPinInitialMode=PORT_PIN_MODE_GPIO, PortPinLevelValue=PORT_PIN_LEVEL_LOW, PortPinMode=PORT_PIN_MODE_ALL, PortPinModeChangeable=false, PortPinPadLevel=PORT_PDR_CMOS_AUTOMOTIVE_LEVEL:
            PortPin_0: PortPinId=320, PortPinInputCharacteristic=PORT_PIN_IN_PULL_UP, PortPinSymbolicName=PORT_20_PIN_0
            PortPin_1: PortPinId=322, PortPinInputCharacteristic=PORT_PIN_IN_PULL_UP, PortPinSymbolicName=PORT_20_PIN_2
            PortPin_10: PortPinId=333, PortPinInputCharacteristic=PORT_PIN_IN_PULL_UP, PortPinSymbolicName=PORT_20_PIN_13
            PortPin_11: PortPinId=334, PortPinInputCharacteristic=PORT_PIN_IN_PULL_UP, PortPinSymbolicName=PORT_20_PIN_14
            PortPin_2: PortPinId=323, PortPinSymbolicName=PORT_20_PIN_3
            PortPin_3: PortPinId=326, PortPinInputCharacteristic=PORT_PIN_IN_PULL_UP, PortPinSymbolicName=PORT_20_PIN_6
            PortPin_4: PortPinId=327, PortPinInputCharacteristic=PORT_PIN_IN_PULL_UP, PortPinSymbolicName=PORT_20_PIN_7
            PortPin_5: PortPinId=328, PortPinInputCharacteristic=PORT_PIN_IN_PULL_UP, PortPinSymbolicName=PORT_20_PIN_8
            PortPin_6: PortPinId=329, PortPinInputCharacteristic=PORT_PIN_IN_PULL_UP, PortPinSymbolicName=PORT_20_PIN_9
            PortPin_7: PortPinId=330, PortPinInputCharacteristic=PORT_PIN_IN_PULL_UP, PortPinSymbolicName=PORT_20_PIN_10
            PortPin_8: PortPinId=331, PortPinInputCharacteristic=PORT_PIN_IN_PULL_UP, PortPinSymbolicName=PORT_20_PIN_11
            PortPin_9: PortPinId=332, PortPinInputCharacteristic=PORT_PIN_IN_PULL_UP, PortPinSymbolicName=PORT_20_PIN_12
        PortContainer_P21: PortNumber=21, PortNumberOfPortPins=6
          6 x PortPin, all with PortPinAnalogInput=DISABLE, PortPinControllerSelect=DISABLE, PortPinDirection=PORT_PIN_IN, PortPinDirectionChangeable=false, PortPinDriverStrength=PORT_CMOS_SPEED_GRADE1, PortPinInitialMode=PORT_PIN_MODE_GPIO, PortPinLevelValue=PORT_PIN_LEVEL_LOW, PortPinMode=PORT_PIN_MODE_ALL, PortPinModeChangeable=false, PortPinPadLevel=PORT_PDR_CMOS_AUTOMOTIVE_LEVEL:
            PortPin_0: PortPinId=338, PortPinInputCharacteristic=PORT_PIN_IN_PULL_UP, PortPinSymbolicName=PORT_21_PIN_2
            PortPin_1: PortPinId=339, PortPinInputCharacteristic=PORT_PIN_IN_PULL_UP, PortPinSymbolicName=PORT_21_PIN_3
            PortPin_2: PortPinId=340, PortPinInputCharacteristic=PORT_PIN_IN_PULL_UP, PortPinSymbolicName=PORT_21_PIN_4
            PortPin_3: PortPinId=341, PortPinInputCharacteristic=PORT_PIN_IN_PULL_UP, PortPinSymbolicName=PORT_21_PIN_5
            Port21Pin_6: PortPinId=342, PortPinSymbolicName=PORT_21_PIN_6
            Port21Pin_7: PortPinId=343, PortPinSymbolicName=PORT_21_PIN_7
        PortContainer_P22: PortNumber=22, PortNumberOfPortPins=5
          5 x PortPin, all with PortPinAnalogInput=DISABLE, PortPinControllerSelect=DISABLE, PortPinDirection=PORT_PIN_IN, PortPinDirectionChangeable=false, PortPinDriverStrength=PORT_CMOS_SPEED_GRADE1, PortPinInitialMode=PORT_PIN_MODE_GPIO, PortPinInputCharacteristic=PORT_PIN_IN_PULL_UP, PortPinLevelValue=PORT_PIN_LEVEL_LOW, PortPinMode=PORT_PIN_MODE_ALL, PortPinModeChangeable=false, PortPinPadLevel=PORT_PDR_CMOS_AUTOMOTIVE_LEVEL:
            PortPin_0: PortPinId=352, PortPinSymbolicName=PORT_22_PIN_0
            PortPin_1: PortPinId=353, PortPinSymbolicName=PORT_22_PIN_1
            PortPin_2: PortPinId=354, PortPinSymbolicName=PORT_22_PIN_2
            PortPin_3: PortPinId=355, PortPinSymbolicName=PORT_22_PIN_3
            PortPin_4: PortPinId=356, PortPinSymbolicName=PORT_22_PIN_4
    PortSafety: PortInitCheckApi=false, PortSafetyEnable=false
    PortGeneral:
      PortDevErrorDetect = true
      PortPBFixedAddress = false
      PortRunningInUser0Mode = false
      PortSetPinDirectionApi = false
      PortSetPinModeApi = false
      PortUserModeInitApiEnable = false
      PortUserModeRuntimeApiEnable = false
      PortVersionInfoApi = false
    CommonPublishedInformation:
      ArMajorVersion = 3
      ArMinorVersion = 2
      ArPatchVersion = 0
      ModuleId = 124
      Release = _TRICORE_TC234
      SwMajorVersion = 3
      SwMinorVersion = 1
      SwPatchVersion = 0
      VendorId = 17
package /Mcu
  module config Mcu: implementation-config-variant=VARIANT-POST-BUILD-LOADABLE, module-description=Mcu_Impl
    McuPublishedInformation
      16 x McuResetReasonConf, all with McuResetReason=0:
        MCU_CB0_RESET
        MCU_CB1_RESET
        MCU_CB3_RESET
        MCU_ESR0_RESET
        MCU_ESR1_RESET
        MCU_EVR13_RESET
        MCU_EVR33_RESET
        MCU_POWER_ON_RESET
        MCU_RESET_MULTIPLE
        MCU_RESET_UNDEFINED
        MCU_SMU_RESET
        MCU_STBYR_RESET
        MCU_STM0_RESET
        MCU_SUPPLY_WDOG_RESET
        MCU_SW_RESET
        MCU_TP_RESET
    McuGeneralConfiguration:
      McuClearColdResetApi = false
      McuDeInitApi = false
      McuDevErrorDetect = true
      McuErayPllInitDelay = 10
      McuFmPllEnable = false
      McuGetRamStateApi = false
      McuInitClock = true
      McuMainOscillatorFrequency = 20
      McuNoPll = false
      McuPBFixedAddress = false
      McuPerformResetApi = true
      McuPllInitDelay = 10
      McuResetSfrAtInit = false
      McuRunningInUser0Mode = false
      McuUserModeDeInitApiEnable = false
      McuUserModeInitApiEnable = false
      McuUserModeRuntimeApiEnable = false
      McuVersionInfoApi = false
    McuModuleConfiguration_0 (McuModuleConfiguration): McuClockSrcFailureNotification=DISABLED, McuNumberOfMcuModes=1, McuRamSectors=0, McuResetSetting=1, McuStm0ResetDisable=false
      AscLinConfiguration: AscLin0=USE_FOR_NONE, AscLin1=USE_FOR_NONE
      CcuConfiguration_0 (CcuConfiguration)
        Ccu60 (Ccu6)
          General: Ccu6ModuleUsage=UNUSED
          T12
            3 x Cc6:
              Cc60: CCChannelInputSelection=CCINA_PORT2_PIN0
              Cc61: CCChannelInputSelection=CCINA_PORT2_PIN2
              Cc62: CCChannelInputSelection=CCINA_PORT2_PIN4
            General: T12ClkSelection=0, T12PrescalerEnabled=false
          T13
            General: T13ClkSelection=0, T13PrescalerEnabled=false
        Ccu61 (Ccu6)
          General: Ccu6ModuleUsage=UNUSED
          T12
            3 x Cc6:
              Cc60: CCChannelInputSelection=CCINA_PORT0_PIN1
              Cc61: CCChannelInputSelection=CCINA_PORT0_PIN3
              Cc62: CCChannelInputSelection=CCINA_PORT0_PIN5
            General: T12ClkSelection=0, T12PrescalerEnabled=false
          T13
            General: T13ClkSelection=0, T13PrescalerEnabled=false
      DmaConfiguration_0 (DmaConfiguration)
        16 x DmaChannel:
          DmaChannel_0: ChannelId=0, ChannelUsed=USE_FOR_SPI_DRIVER
          DmaChannel_1: ChannelId=1, ChannelUsed=USE_FOR_SPI_DRIVER
          DmaChannel_{10..15}: ChannelId={10..15}, ChannelUsed=USE_FOR_NONE
          DmaChannel_{2..7}: ChannelId={2..7}, ChannelUsed=USE_FOR_SPI_DRIVER
          DmaChannel_8: ChannelId=8, ChannelUsed=USE_FOR_NONE
          DmaChannel_9: ChannelId=9, ChannelUsed=USE_FOR_NONE
      EruConfiguration_0 (EruConfiguration)
        ERU{0..7}: EruChannelUsage=UNUSED
      GtmConfiguration_0 (GtmConfiguration)
        Cmu_0 (Cmu)
          CmuConfigurableClock:
            CmuClk6SourceSelect = CMU_CLK_6_DIVIDER
            CmuClk7SourceSelect = CMU_CLK_7_DIVIDER
            CmuConfigurableClk{0..7}Div = 0
            CmuEnableConfigurableClk{0..7} = false
          CmuExternalClock:
            CmuEnableExternalClk{0..2} = false
            CmuExternalClk0Denominator = 1
            CmuExternalClk0Numerator = 1
            CmuExternalClk1Denominator = 1
            CmuExternalClk1Numerator = 1
            CmuExternalClk2Denominator = 1
            CmuExternalClk2Numerator = 1
          CmuFixedClock: CmuEnableAllFixedClocks=true, CmuFxdClkSourceSelect=GTM_GLOBAL_CLOCK
        GtmAeiInterface:
          GtmAeiIllegalModuleAddErrIntEn = false
          GtmAeiIllegalModuleAddIntEn = false
          GtmAeiInterruptMode = GTM_INTERRUPT_LEVEL_MODE
          GtmAeiTimeOutMode = OBSERVE
          GtmAeiTimeOutValue = 0
          GtmAeiTimeoutExceptionErrIntEn = false
          GtmAeiTimeoutExceptionIntEn = false
          GtmAeiUnsupportedAddressErrIntEn = false
          GtmAeiUnsupportedAddressIntEn = false
          GtmAeiUnsupportedByteEnErrIntEn = false
          GtmAeiUnsupportedByteEnIntEn = false
        GtmConnections_0 (GtmConnections)
          4 x GtmTriggerForAdc, all with GtmTrigger0Select=TRIG_0_NONE, GtmTrigger1Select=TRIG_0_NONE:
            GtmTriggerForAdc_{0..3}
          4 x GtmTtcanTrigger:
            GtmTtcanTrigger_0: GtmTriggerSelect=SEL0_TOM0_CH0
            GtmTtcanTrigger_1: GtmTriggerSelect=SEL0_TOM1_CH0
            GtmTtcanTrigger_2: GtmTriggerSelect=SEL0_TOM0_CH0
            GtmTtcanTrigger_3: GtmTriggerSelect=SEL0_TOM1_CH0
        GtmGeneral: GtmEnRstAndForceIntFunctionality=false, GtmGlobalClkDivDenominator=1, GtmGlobalClkDivNumerator=1, GtmSleepMode=GTM_SLEEP_ENABLE
        Tbu_0 (Tbu)
          3 x TbuChannel, all with TbuChannelClockSource=GTM_CONFIGURABLE_CLOCK_0, TbuChannelModeSelect=FREE_RUNNING_COUNTER_MODE, TbuChannelResolution=BITS_0_TO_23, TbuChannelUsage=USED_BY_OTHER_DRIVERS_OR_UNUSED, TbuEnableChannel=false, TbuTimebaseValue=0:
            TbuChannel_{0..2}
        Tim_0 (Tim)
          8 x TimChannel:
            TimChannel_0
              TimChannelErrorInterrupt:
                TimInterruptEnableOnCntOflErr = false
                TimInterruptEnableOnEcntOflErr = false
                TimInterruptEnableOnGlitchDetErr = false
                TimInterruptEnableOnGprxOflErr = false
                TimInterruptEnableOnNewValErr = false
                TimInterruptEnableOnToDetErr = false
              TimChannelFilterConfig:
                TimChFilterCounterFreqSelect = GTM_CONFIGURABLE_CLOCK_0
                TimChFilterModeForFallingEdge = IMMEDIATE_EDGE_PROPAGATION_MODE
                TimChFilterModeForRisingEdge = IMMEDIATE_EDGE_PROPAGATION_MODE
                TimChFilterTimeForFallingEdge = 0
                TimChFilterTimeForRisingEdge = 0
                TimChannelFilterEnable = false
              TimChannelGeneral:
                TimChannelClockSelect = GTM_CONFIGURABLE_CLOCK_0
                TimChannelCntsInputSelect = CNT_VALUE
                TimChannelCntsValue = 0
                TimChannelEcntOvflwSetting = SEL0_OVRFLOW_SIG_ON_ECNT_BITWIDTH_8
                TimChannelEcntResetSetting = SEL0_ECNT_IN_WRAP_AROUND_MODE
                TimChannelEnable = false
                TimChannelExtCaptureModeEnable = false
                TimChannelExtCaptureSrc = SEL0_NEW_VAL_IRQ
                TimChannelGpr0InputSelect = TIMEBASE_TBU_TS0
                TimChannelGpr1InputSelect = TIMEBASE_TBU_TS0
                TimChannelInputSelect = INPUT_OF_CURRENT_TIM_CHANNEL
                TimChannelModeSelect = PWM_MEASUREMENT_MODE_TPWM
                TimChannelOneShotMode = false
                TimChannelPortPinSelect = NONE_SEL0
                TimChannelSignalEdgeSelect = FALLING_EDGE
                TimChannelTbu0Ts0BitsSelect = BITS_0_TO_23
                TimChannelUsage = USED_BY_OTHER_DRIVERS_OR_UNUSED
                TimChannelValInitSignal = VAL_LOW
              TimChannelInterrupt:
                TimInterruptEnableOnCntOfl = false
                TimInterruptEnableOnEcntOfl = false
                TimInterruptEnableOnGlitchDet = false
                TimInterruptEnableOnGprxOfl = false
                TimInterruptEnableOnNewVal = false
                TimInterruptEnableOnToDet = false
                TimInterruptMode = GTM_INTERRUPT_LEVEL_MODE
                TimNotification = NULL_PTR
              TimChannelTimeoutDetection: TimChTimeoutClockSelect=GTM_CONFIGURABLE_CLOCK_0, TimChTimeoutDetectionEnable=SEL0_TIMOUT_DISABLED, TimChTimeoutDuration=0
            TimChannel_1
              TimChannelErrorInterrupt:
                TimInterruptEnableOnCntOflErr = false
                TimInterruptEnableOnEcntOflErr = false
                TimInterruptEnableOnGlitchDetErr = false
                TimInterruptEnableOnGprxOflErr = false
                TimInterruptEnableOnNewValErr = false
                TimInterruptEnableOnToDetErr = false
              TimChannelFilterConfig:
                TimChFilterCounterFreqSelect = GTM_CONFIGURABLE_CLOCK_0
                TimChFilterModeForFallingEdge = IMMEDIATE_EDGE_PROPAGATION_MODE
                TimChFilterModeForRisingEdge = IMMEDIATE_EDGE_PROPAGATION_MODE
                TimChFilterTimeForFallingEdge = 0
                TimChFilterTimeForRisingEdge = 0
                TimChannelFilterEnable = false
              TimChannelGeneral:
                TimChannelClockSelect = GTM_CONFIGURABLE_CLOCK_0
                TimChannelCntsInputSelect = CNT_VALUE
                TimChannelCntsValue = 0
                TimChannelEcntOvflwSetting = SEL0_OVRFLOW_SIG_ON_ECNT_BITWIDTH_8
                TimChannelEcntResetSetting = SEL0_ECNT_IN_WRAP_AROUND_MODE
                TimChannelEnable = false
                TimChannelExtCaptureModeEnable = false
                TimChannelExtCaptureSrc = SEL0_NEW_VAL_IRQ
                TimChannelGpr0InputSelect = TIMEBASE_TBU_TS0
                TimChannelGpr1InputSelect = TIMEBASE_TBU_TS0
                TimChannelInputSelect = INPUT_OF_CURRENT_TIM_CHANNEL
                TimChannelModeSelect = PWM_MEASUREMENT_MODE_TPWM
                TimChannelOneShotMode = false
                TimChannelPortPinSelect = NONE_SEL0
                TimChannelSignalEdgeSelect = FALLING_EDGE
                TimChannelTbu0Ts0BitsSelect = BITS_0_TO_23
                TimChannelUsage = USED_BY_OTHER_DRIVERS_OR_UNUSED
                TimChannelValInitSignal = VAL_LOW
              TimChannelInterrupt:
                TimInterruptEnableOnCntOfl = false
                TimInterruptEnableOnEcntOfl = false
                TimInterruptEnableOnGlitchDet = false
                TimInterruptEnableOnGprxOfl = false
                TimInterruptEnableOnNewVal = false
                TimInterruptEnableOnToDet = false
                TimInterruptMode = GTM_INTERRUPT_LEVEL_MODE
                TimNotification = NULL_PTR
              TimChannelTimeoutDetection: TimChTimeoutClockSelect=GTM_CONFIGURABLE_CLOCK_0, TimChTimeoutDetectionEnable=SEL0_TIMOUT_DISABLED, TimChTimeoutDuration=0
            TimChannel_2
              TimChannelErrorInterrupt:
                TimInterruptEnableOnCntOflErr = false
                TimInterruptEnableOnEcntOflErr = false
                TimInterruptEnableOnGlitchDetErr = false
                TimInterruptEnableOnGprxOflErr = false
                TimInterruptEnableOnNewValErr = false
                TimInterruptEnableOnToDetErr = false
              TimChannelFilterConfig:
                TimChFilterCounterFreqSelect = GTM_CONFIGURABLE_CLOCK_0
                TimChFilterModeForFallingEdge = IMMEDIATE_EDGE_PROPAGATION_MODE
                TimChFilterModeForRisingEdge = IMMEDIATE_EDGE_PROPAGATION_MODE
                TimChFilterTimeForFallingEdge = 0
                TimChFilterTimeForRisingEdge = 0
                TimChannelFilterEnable = false
              TimChannelGeneral:
                TimChannelClockSelect = GTM_CONFIGURABLE_CLOCK_0
                TimChannelCntsInputSelect = CNT_VALUE
                TimChannelCntsValue = 0
                TimChannelEcntOvflwSetting = SEL0_OVRFLOW_SIG_ON_ECNT_BITWIDTH_8
                TimChannelEcntResetSetting = SEL0_ECNT_IN_WRAP_AROUND_MODE
                TimChannelEnable = false
                TimChannelExtCaptureModeEnable = false
                TimChannelExtCaptureSrc = SEL0_NEW_VAL_IRQ
                TimChannelGpr0InputSelect = TIMEBASE_TBU_TS0
                TimChannelGpr1InputSelect = TIMEBASE_TBU_TS0
                TimChannelInputSelect = INPUT_OF_CURRENT_TIM_CHANNEL
                TimChannelModeSelect = PWM_MEASUREMENT_MODE_TPWM
                TimChannelOneShotMode = false
                TimChannelPortPinSelect = NONE_SEL0
                TimChannelSignalEdgeSelect = FALLING_EDGE
                TimChannelTbu0Ts0BitsSelect = BITS_0_TO_23
                TimChannelUsage = USED_BY_OTHER_DRIVERS_OR_UNUSED
                TimChannelValInitSignal = VAL_LOW
              TimChannelInterrupt:
                TimInterruptEnableOnCntOfl = false
                TimInterruptEnableOnEcntOfl = false
                TimInterruptEnableOnGlitchDet = false
                TimInterruptEnableOnGprxOfl = false
                TimInterruptEnableOnNewVal = false
                TimInterruptEnableOnToDet = false
                TimInterruptMode = GTM_INTERRUPT_LEVEL_MODE
                TimNotification = NULL_PTR
              TimChannelTimeoutDetection: TimChTimeoutClockSelect=GTM_CONFIGURABLE_CLOCK_0, TimChTimeoutDetectionEnable=SEL0_TIMOUT_DISABLED, TimChTimeoutDuration=0
            TimChannel_3
              TimChannelErrorInterrupt:
                TimInterruptEnableOnCntOflErr = false
                TimInterruptEnableOnEcntOflErr = false
                TimInterruptEnableOnGlitchDetErr = false
                TimInterruptEnableOnGprxOflErr = false
                TimInterruptEnableOnNewValErr = false
                TimInterruptEnableOnToDetErr = false
              TimChannelFilterConfig:
                TimChFilterCounterFreqSelect = GTM_CONFIGURABLE_CLOCK_0
                TimChFilterModeForFallingEdge = IMMEDIATE_EDGE_PROPAGATION_MODE
                TimChFilterModeForRisingEdge = IMMEDIATE_EDGE_PROPAGATION_MODE
                TimChFilterTimeForFallingEdge = 0
                TimChFilterTimeForRisingEdge = 0
                TimChannelFilterEnable = false
              TimChannelGeneral:
                TimChannelClockSelect = GTM_CONFIGURABLE_CLOCK_0
                TimChannelCntsInputSelect = CNT_VALUE
                TimChannelCntsValue = 0
                TimChannelEcntOvflwSetting = SEL0_OVRFLOW_SIG_ON_ECNT_BITWIDTH_8
                TimChannelEcntResetSetting = SEL0_ECNT_IN_WRAP_AROUND_MODE
                TimChannelEnable = false
                TimChannelExtCaptureModeEnable = false
                TimChannelExtCaptureSrc = SEL0_NEW_VAL_IRQ
                TimChannelGpr0InputSelect = TIMEBASE_TBU_TS0
                TimChannelGpr1InputSelect = TIMEBASE_TBU_TS0
                TimChannelInputSelect = INPUT_OF_CURRENT_TIM_CHANNEL
                TimChannelModeSelect = PWM_MEASUREMENT_MODE_TPWM
                TimChannelOneShotMode = false
                TimChannelPortPinSelect = NONE_SEL0
                TimChannelSignalEdgeSelect = FALLING_EDGE
                TimChannelTbu0Ts0BitsSelect = BITS_0_TO_23
                TimChannelUsage = USED_BY_OTHER_DRIVERS_OR_UNUSED
                TimChannelValInitSignal = VAL_LOW
              TimChannelInterrupt:
                TimInterruptEnableOnCntOfl = false
                TimInterruptEnableOnEcntOfl = false
                TimInterruptEnableOnGlitchDet = false
                TimInterruptEnableOnGprxOfl = false
                TimInterruptEnableOnNewVal = false
                TimInterruptEnableOnToDet = false
                TimInterruptMode = GTM_INTERRUPT_LEVEL_MODE
                TimNotification = NULL_PTR
              TimChannelTimeoutDetection: TimChTimeoutClockSelect=GTM_CONFIGURABLE_CLOCK_0, TimChTimeoutDetectionEnable=SEL0_TIMOUT_DISABLED, TimChTimeoutDuration=0
            TimChannel_4
              TimChannelErrorInterrupt:
                TimInterruptEnableOnCntOflErr = false
                TimInterruptEnableOnEcntOflErr = false
                TimInterruptEnableOnGlitchDetErr = false
                TimInterruptEnableOnGprxOflErr = false
                TimInterruptEnableOnNewValErr = false
                TimInterruptEnableOnToDetErr = false
              TimChannelFilterConfig:
                TimChFilterCounterFreqSelect = GTM_CONFIGURABLE_CLOCK_0
                TimChFilterModeForFallingEdge = IMMEDIATE_EDGE_PROPAGATION_MODE
                TimChFilterModeForRisingEdge = IMMEDIATE_EDGE_PROPAGATION_MODE
                TimChFilterTimeForFallingEdge = 0
                TimChFilterTimeForRisingEdge = 0
                TimChannelFilterEnable = false
              TimChannelGeneral:
                TimChannelClockSelect = GTM_CONFIGURABLE_CLOCK_0
                TimChannelCntsInputSelect = CNT_VALUE
                TimChannelCntsValue = 0
                TimChannelEcntOvflwSetting = SEL0_OVRFLOW_SIG_ON_ECNT_BITWIDTH_8
                TimChannelEcntResetSetting = SEL0_ECNT_IN_WRAP_AROUND_MODE
                TimChannelEnable = false
                TimChannelExtCaptureModeEnable = false
                TimChannelExtCaptureSrc = SEL0_NEW_VAL_IRQ
                TimChannelGpr0InputSelect = TIMEBASE_TBU_TS0
                TimChannelGpr1InputSelect = TIMEBASE_TBU_TS0
                TimChannelInputSelect = INPUT_OF_CURRENT_TIM_CHANNEL
                TimChannelModeSelect = PWM_MEASUREMENT_MODE_TPWM
                TimChannelOneShotMode = false
                TimChannelPortPinSelect = NONE_SEL0
                TimChannelSignalEdgeSelect = FALLING_EDGE
                TimChannelTbu0Ts0BitsSelect = BITS_0_TO_23
                TimChannelUsage = USED_BY_OTHER_DRIVERS_OR_UNUSED
                TimChannelValInitSignal = VAL_LOW
              TimChannelInterrupt:
                TimInterruptEnableOnCntOfl = false
                TimInterruptEnableOnEcntOfl = false
                TimInterruptEnableOnGlitchDet = false
                TimInterruptEnableOnGprxOfl = false
                TimInterruptEnableOnNewVal = false
                TimInterruptEnableOnToDet = false
                TimInterruptMode = GTM_INTERRUPT_LEVEL_MODE
                TimNotification = NULL_PTR
              TimChannelTimeoutDetection: TimChTimeoutClockSelect=GTM_CONFIGURABLE_CLOCK_0, TimChTimeoutDetectionEnable=SEL0_TIMOUT_DISABLED, TimChTimeoutDuration=0
            TimChannel_5
              TimChannelErrorInterrupt:
                TimInterruptEnableOnCntOflErr = false
                TimInterruptEnableOnEcntOflErr = false
                TimInterruptEnableOnGlitchDetErr = false
                TimInterruptEnableOnGprxOflErr = false
                TimInterruptEnableOnNewValErr = false
                TimInterruptEnableOnToDetErr = false
              TimChannelFilterConfig:
                TimChFilterCounterFreqSelect = GTM_CONFIGURABLE_CLOCK_0
                TimChFilterModeForFallingEdge = IMMEDIATE_EDGE_PROPAGATION_MODE
                TimChFilterModeForRisingEdge = IMMEDIATE_EDGE_PROPAGATION_MODE
                TimChFilterTimeForFallingEdge = 0
                TimChFilterTimeForRisingEdge = 0
                TimChannelFilterEnable = false
              TimChannelGeneral:
                TimChannelClockSelect = GTM_CONFIGURABLE_CLOCK_0
                TimChannelCntsInputSelect = CNT_VALUE
                TimChannelCntsValue = 0
                TimChannelEcntOvflwSetting = SEL0_OVRFLOW_SIG_ON_ECNT_BITWIDTH_8
                TimChannelEcntResetSetting = SEL0_ECNT_IN_WRAP_AROUND_MODE
                TimChannelEnable = false
                TimChannelExtCaptureModeEnable = false
                TimChannelExtCaptureSrc = SEL0_NEW_VAL_IRQ
                TimChannelGpr0InputSelect = TIMEBASE_TBU_TS0
                TimChannelGpr1InputSelect = TIMEBASE_TBU_TS0
                TimChannelInputSelect = INPUT_OF_CURRENT_TIM_CHANNEL
                TimChannelModeSelect = PWM_MEASUREMENT_MODE_TPWM
                TimChannelOneShotMode = false
                TimChannelPortPinSelect = NONE_SEL0
                TimChannelSignalEdgeSelect = FALLING_EDGE
                TimChannelTbu0Ts0BitsSelect = BITS_0_TO_23
                TimChannelUsage = USED_BY_OTHER_DRIVERS_OR_UNUSED
                TimChannelValInitSignal = VAL_LOW
              TimChannelInterrupt:
                TimInterruptEnableOnCntOfl = false
                TimInterruptEnableOnEcntOfl = false
                TimInterruptEnableOnGlitchDet = false
                TimInterruptEnableOnGprxOfl = false
                TimInterruptEnableOnNewVal = false
                TimInterruptEnableOnToDet = false
                TimInterruptMode = GTM_INTERRUPT_LEVEL_MODE
                TimNotification = NULL_PTR
              TimChannelTimeoutDetection: TimChTimeoutClockSelect=GTM_CONFIGURABLE_CLOCK_0, TimChTimeoutDetectionEnable=SEL0_TIMOUT_DISABLED, TimChTimeoutDuration=0
            TimChannel_6
              TimChannelErrorInterrupt:
                TimInterruptEnableOnCntOflErr = false
                TimInterruptEnableOnEcntOflErr = false
                TimInterruptEnableOnGlitchDetErr = false
                TimInterruptEnableOnGprxOflErr = false
                TimInterruptEnableOnNewValErr = false
                TimInterruptEnableOnToDetErr = false
              TimChannelFilterConfig:
                TimChFilterCounterFreqSelect = GTM_CONFIGURABLE_CLOCK_0
                TimChFilterModeForFallingEdge = IMMEDIATE_EDGE_PROPAGATION_MODE
                TimChFilterModeForRisingEdge = IMMEDIATE_EDGE_PROPAGATION_MODE
                TimChFilterTimeForFallingEdge = 0
                TimChFilterTimeForRisingEdge = 0
                TimChannelFilterEnable = false
              TimChannelGeneral:
                TimChannelClockSelect = GTM_CONFIGURABLE_CLOCK_0
                TimChannelCntsInputSelect = CNT_VALUE
                TimChannelCntsValue = 0
                TimChannelEcntOvflwSetting = SEL0_OVRFLOW_SIG_ON_ECNT_BITWIDTH_8
                TimChannelEcntResetSetting = SEL0_ECNT_IN_WRAP_AROUND_MODE
                TimChannelEnable = false
                TimChannelExtCaptureModeEnable = false
                TimChannelExtCaptureSrc = SEL0_NEW_VAL_IRQ
                TimChannelGpr0InputSelect = TIMEBASE_TBU_TS0
                TimChannelGpr1InputSelect = TIMEBASE_TBU_TS0
                TimChannelInputSelect = INPUT_OF_CURRENT_TIM_CHANNEL
                TimChannelModeSelect = PWM_MEASUREMENT_MODE_TPWM
                TimChannelOneShotMode = false
                TimChannelPortPinSelect = NONE_SEL0
                TimChannelSignalEdgeSelect = FALLING_EDGE
                TimChannelTbu0Ts0BitsSelect = BITS_0_TO_23
                TimChannelUsage = USED_BY_OTHER_DRIVERS_OR_UNUSED
                TimChannelValInitSignal = VAL_LOW
              TimChannelInterrupt:
                TimInterruptEnableOnCntOfl = false
                TimInterruptEnableOnEcntOfl = false
                TimInterruptEnableOnGlitchDet = false
                TimInterruptEnableOnGprxOfl = false
                TimInterruptEnableOnNewVal = false
                TimInterruptEnableOnToDet = false
                TimInterruptMode = GTM_INTERRUPT_LEVEL_MODE
                TimNotification = NULL_PTR
              TimChannelTimeoutDetection: TimChTimeoutClockSelect=GTM_CONFIGURABLE_CLOCK_0, TimChTimeoutDetectionEnable=SEL0_TIMOUT_DISABLED, TimChTimeoutDuration=0
            TimChannel_7
              TimChannelErrorInterrupt:
                TimInterruptEnableOnCntOflErr = false
                TimInterruptEnableOnEcntOflErr = false
                TimInterruptEnableOnGlitchDetErr = false
                TimInterruptEnableOnGprxOflErr = false
                TimInterruptEnableOnNewValErr = false
                TimInterruptEnableOnToDetErr = false
              TimChannelFilterConfig:
                TimChFilterCounterFreqSelect = GTM_CONFIGURABLE_CLOCK_0
                TimChFilterModeForFallingEdge = IMMEDIATE_EDGE_PROPAGATION_MODE
                TimChFilterModeForRisingEdge = IMMEDIATE_EDGE_PROPAGATION_MODE
                TimChFilterTimeForFallingEdge = 0
                TimChFilterTimeForRisingEdge = 0
                TimChannelFilterEnable = false
              TimChannelGeneral:
                TimChannelClockSelect = GTM_CONFIGURABLE_CLOCK_0
                TimChannelCntsInputSelect = CNT_VALUE
                TimChannelCntsValue = 0
                TimChannelEcntOvflwSetting = SEL0_OVRFLOW_SIG_ON_ECNT_BITWIDTH_8
                TimChannelEcntResetSetting = SEL0_ECNT_IN_WRAP_AROUND_MODE
                TimChannelEnable = false
                TimChannelExtCaptureModeEnable = false
                TimChannelExtCaptureSrc = SEL0_NEW_VAL_IRQ
                TimChannelGpr0InputSelect = TIMEBASE_TBU_TS0
                TimChannelGpr1InputSelect = TIMEBASE_TBU_TS0
                TimChannelInputSelect = INPUT_OF_CURRENT_TIM_CHANNEL
                TimChannelModeSelect = PWM_MEASUREMENT_MODE_TPWM
                TimChannelOneShotMode = false
                TimChannelPortPinSelect = NONE_SEL0
                TimChannelSignalEdgeSelect = FALLING_EDGE
                TimChannelTbu0Ts0BitsSelect = BITS_0_TO_23
                TimChannelUsage = USED_BY_OTHER_DRIVERS_OR_UNUSED
                TimChannelValInitSignal = VAL_LOW
              TimChannelInterrupt:
                TimInterruptEnableOnCntOfl = false
                TimInterruptEnableOnEcntOfl = false
                TimInterruptEnableOnGlitchDet = false
                TimInterruptEnableOnGprxOfl = false
                TimInterruptEnableOnNewVal = false
                TimInterruptEnableOnToDet = false
                TimInterruptMode = GTM_INTERRUPT_LEVEL_MODE
                TimNotification = NULL_PTR
              TimChannelTimeoutDetection: TimChTimeoutClockSelect=GTM_CONFIGURABLE_CLOCK_0, TimChTimeoutDetectionEnable=SEL0_TIMOUT_DISABLED, TimChTimeoutDuration=0
        Tom_0 (Tom)
          16 x TomChannel:
            TomChannel_0
              TomChannelEnable: TomChDisableOnTgcTrigger=false, TomChannelEnable=AT_START
              TomChannelInterrupt: TomIntEnableOnDutyCycleMatchCcu1=false, TomIntEnableOnPeriodMatchCcu0=false, TomInterruptMode=GTM_INTERRUPT_LEVEL_MODE, TomNotification=NULL_PTR
              TomChannelOutput:
                TomChOutputDisableOnTgcTrig = false
                TomChannelOutputControl = DONT_ENABLE_CHANNEL_OUTPUT
                TomChannelOutputSignalLevel = LOW
                TomChannelPortPinSelect = TOUT18_SELA_PORT0_PIN9
              TomChannelTimerParameters:
                TomChDCycCompareShadowValSr1 = 0
                TomChEnableForceUpdate = false
                TomChPeriodCompareShadowValSr0 = 0
                TomChResetCn0OnForceUpdate = false
                TomChUpdateEnableOnCn0Reset = false
                TomChannelBitReversalMode = false
                TomChannelClockSelect = GTM_FIXED_CLOCK_0
                TomChannelCounterCn0Reset = ON_COMPARE_MATCH_ON_CHANNEL
                TomChannelCounterValCn0 = 0
                TomChannelDutyCycleCompareValCm1 = 0
                TomChannelExtCounterCn0Reset = TRIG_ON_PREV_COMPARE_MATCH
                TomChannelExtTriggerOutput = EXT_TRIG_FROM_PREVIOUS_CHANNEL
                TomChannelOneShotMode = false
                TomChannelPeriodCompareValCm0 = 0
                TomChannelTrigOneShotMode = false
                TomChannelTriggerOutput = TRIG_FROM_PREVIOUS_CHANNEL
              TomChannelUsage: TomChannelUsage=USED_BY_OTHER_DRIVERS_OR_UNUSED
            TomChannel_1
              TomChannelEnable: TomChDisableOnTgcTrigger=false, TomChannelEnable=AT_START
              TomChannelInterrupt: TomIntEnableOnDutyCycleMatchCcu1=false, TomIntEnableOnPeriodMatchCcu0=false, TomInterruptMode=GTM_INTERRUPT_LEVEL_MODE, TomNotification=NULL_PTR
              TomChannelOutput:
                TomChOutputDisableOnTgcTrig = false
                TomChannelOutputControl = DONT_ENABLE_CHANNEL_OUTPUT
                TomChannelOutputSignalLevel = LOW
                TomChannelPortPinSelect = TOUT103_SELA_PORT10_PIN1
              TomChannelTimerParameters:
                TomChDCycCompareShadowValSr1 = 0
                TomChEnableForceUpdate = false
                TomChPeriodCompareShadowValSr0 = 0
                TomChResetCn0OnForceUpdate = false
                TomChUpdateEnableOnCn0Reset = false
                TomChannelBitReversalMode = false
                TomChannelClockSelect = GTM_FIXED_CLOCK_0
                TomChannelCounterCn0Reset = ON_COMPARE_MATCH_ON_CHANNEL
                TomChannelCounterValCn0 = 0
                TomChannelDutyCycleCompareValCm1 = 0
                TomChannelExtCounterCn0Reset = TRIG_ON_PREV_COMPARE_MATCH
                TomChannelExtTriggerOutput = EXT_TRIG_FROM_PREVIOUS_CHANNEL
                TomChannelOneShotMode = false
                TomChannelPeriodCompareValCm0 = 0
                TomChannelTrigOneShotMode = false
                TomChannelTriggerOutput = TRIG_FROM_PREVIOUS_CHANNEL
              TomChannelUsage: TomChannelUsage=USED_BY_OTHER_DRIVERS_OR_UNUSED
            TomChannel_10
              TomChannelEnable: TomChDisableOnTgcTrigger=false, TomChannelEnable=AT_START
              TomChannelInterrupt: TomIntEnableOnDutyCycleMatchCcu1=false, TomIntEnableOnPeriodMatchCcu0=false, TomInterruptMode=GTM_INTERRUPT_LEVEL_MODE, TomNotification=NULL_PTR
              TomChannelOutput:
                TomChOutputDisableOnTgcTrig = false
                TomChannelOutputControl = DONT_ENABLE_CHANNEL_OUTPUT
                TomChannelOutputSignalLevel = LOW
                TomChannelPortPinSelect = TOUT12_SELA_PORT0_PIN3
              TomChannelTimerParameters:
                TomChDCycCompareShadowValSr1 = 0
                TomChEnableForceUpdate = false
                TomChPeriodCompareShadowValSr0 = 0
                TomChResetCn0OnForceUpdate = false
                TomChUpdateEnableOnCn0Reset = false
                TomChannelBitReversalMode = false
                TomChannelClockSelect = GTM_FIXED_CLOCK_0
                TomChannelCounterCn0Reset = ON_COMPARE_MATCH_ON_CHANNEL
                TomChannelCounterValCn0 = 0
                TomChannelDutyCycleCompareValCm1 = 0
                TomChannelExtCounterCn0Reset = TRIG_ON_PREV_COMPARE_MATCH
                TomChannelExtTriggerOutput = EXT_TRIG_FROM_PREVIOUS_CHANNEL
                TomChannelOneShotMode = false
                TomChannelPeriodCompareValCm0 = 0
                TomChannelTrigOneShotMode = false
                TomChannelTriggerOutput = TRIG_FROM_PREVIOUS_CHANNEL
              TomChannelUsage: TomChannelUsage=USED_BY_OTHER_DRIVERS_OR_UNUSED
            TomChannel_11
              TomChannelEnable: TomChDisableOnTgcTrigger=false, TomChannelEnable=AT_START
              TomChannelInterrupt: TomIntEnableOnDutyCycleMatchCcu1=false, TomIntEnableOnPeriodMatchCcu0=false, TomInterruptMode=GTM_INTERRUPT_LEVEL_MODE, TomNotification=NULL_PTR
              TomChannelOutput:
                TomChOutputDisableOnTgcTrig = false
                TomChannelOutputControl = DONT_ENABLE_CHANNEL_OUTPUT
                TomChannelOutputSignalLevel = LOW
                TomChannelPortPinSelect = TOUT13_SELA_PORT0_PIN4
              TomChannelTimerParameters:
                TomChDCycCompareShadowValSr1 = 0
                TomChEnableForceUpdate = false
                TomChPeriodCompareShadowValSr0 = 0
                TomChResetCn0OnForceUpdate = false
                TomChUpdateEnableOnCn0Reset = false
                TomChannelBitReversalMode = false
                TomChannelClockSelect = GTM_FIXED_CLOCK_0
                TomChannelCounterCn0Reset = ON_COMPARE_MATCH_ON_CHANNEL
                TomChannelCounterValCn0 = 0
                TomChannelDutyCycleCompareValCm1 = 0
                TomChannelExtCounterCn0Reset = TRIG_ON_PREV_COMPARE_MATCH
                TomChannelExtTriggerOutput = EXT_TRIG_FROM_PREVIOUS_CHANNEL
                TomChannelOneShotMode = false
                TomChannelPeriodCompareValCm0 = 0
                TomChannelTrigOneShotMode = false
                TomChannelTriggerOutput = TRIG_FROM_PREVIOUS_CHANNEL
              TomChannelUsage: TomChannelUsage=USED_BY_OTHER_DRIVERS_OR_UNUSED
            TomChannel_12
              TomChannelEnable: TomChDisableOnTgcTrigger=false, TomChannelEnable=AT_START
              TomChannelInterrupt: TomIntEnableOnDutyCycleMatchCcu1=false, TomIntEnableOnPeriodMatchCcu0=false, TomInterruptMode=GTM_INTERRUPT_LEVEL_MODE, TomNotification=NULL_PTR
              TomChannelOutput:
                TomChOutputDisableOnTgcTrig = false
                TomChannelOutputControl = DONT_ENABLE_CHANNEL_OUTPUT
                TomChannelOutputSignalLevel = LOW
                TomChannelPortPinSelect = TOUT14_SELA_PORT0_PIN5
              TomChannelTimerParameters:
                TomChDCycCompareShadowValSr1 = 0
                TomChEnableForceUpdate = false
                TomChPeriodCompareShadowValSr0 = 0
                TomChResetCn0OnForceUpdate = false
                TomChUpdateEnableOnCn0Reset = false
                TomChannelBitReversalMode = false
                TomChannelClockSelect = GTM_FIXED_CLOCK_0
                TomChannelCounterCn0Reset = ON_COMPARE_MATCH_ON_CHANNEL
                TomChannelCounterValCn0 = 0
                TomChannelDutyCycleCompareValCm1 = 0
                TomChannelExtCounterCn0Reset = TRIG_ON_PREV_COMPARE_MATCH
                TomChannelExtTriggerOutput = EXT_TRIG_FROM_PREVIOUS_CHANNEL
                TomChannelOneShotMode = false
                TomChannelPeriodCompareValCm0 = 0
                TomChannelTrigOneShotMode = false
                TomChannelTriggerOutput = TRIG_FROM_PREVIOUS_CHANNEL
              TomChannelUsage: TomChannelUsage=USED_BY_OTHER_DRIVERS_OR_UNUSED
            TomChannel_13
              TomChannelEnable: TomChDisableOnTgcTrigger=false, TomChannelEnable=AT_START
              TomChannelInterrupt: TomIntEnableOnDutyCycleMatchCcu1=false, TomIntEnableOnPeriodMatchCcu0=false, TomInterruptMode=GTM_INTERRUPT_LEVEL_MODE, TomNotification=NULL_PTR
              TomChannelOutput:
                TomChOutputDisableOnTgcTrig = false
                TomChannelOutputControl = DONT_ENABLE_CHANNEL_OUTPUT
                TomChannelOutputSignalLevel = LOW
                TomChannelPortPinSelect = TOUT15_SELA_PORT0_PIN6
              TomChannelTimerParameters:
                TomChDCycCompareShadowValSr1 = 0
                TomChEnableForceUpdate = false
                TomChPeriodCompareShadowValSr0 = 0
                TomChResetCn0OnForceUpdate = false
                TomChUpdateEnableOnCn0Reset = false
                TomChannelBitReversalMode = false
                TomChannelClockSelect = GTM_FIXED_CLOCK_0
                TomChannelCounterCn0Reset = ON_COMPARE_MATCH_ON_CHANNEL
                TomChannelCounterValCn0 = 0
                TomChannelDutyCycleCompareValCm1 = 0
                TomChannelExtCounterCn0Reset = TRIG_ON_PREV_COMPARE_MATCH
                TomChannelExtTriggerOutput = EXT_TRIG_FROM_PREVIOUS_CHANNEL
                TomChannelOneShotMode = false
                TomChannelPeriodCompareValCm0 = 0
                TomChannelTrigOneShotMode = false
                TomChannelTriggerOutput = TRIG_FROM_PREVIOUS_CHANNEL
              TomChannelUsage: TomChannelUsage=USED_BY_OTHER_DRIVERS_OR_UNUSED
            TomChannel_14
              TomChannelEnable: TomChDisableOnTgcTrigger=false, TomChannelEnable=AT_START
              TomChannelInterrupt: TomIntEnableOnDutyCycleMatchCcu1=false, TomIntEnableOnPeriodMatchCcu0=false, TomInterruptMode=GTM_INTERRUPT_LEVEL_MODE, TomNotification=NULL_PTR
              TomChannelOutput:
                TomChOutputDisableOnTgcTrig = false
                TomChannelOutputControl = DONT_ENABLE_CHANNEL_OUTPUT
                TomChannelOutputSignalLevel = LOW
                TomChannelPortPinSelect = TOUT16_SELA_PORT0_PIN7
              TomChannelTimerParameters:
                TomChDCycCompareShadowValSr1 = 0
                TomChEnableForceUpdate = false
                TomChPeriodCompareShadowValSr0 = 0
                TomChResetCn0OnForceUpdate = false
                TomChUpdateEnableOnCn0Reset = false
                TomChannelBitReversalMode = false
                TomChannelClockSelect = GTM_FIXED_CLOCK_0
                TomChannelCounterCn0Reset = ON_COMPARE_MATCH_ON_CHANNEL
                TomChannelCounterValCn0 = 0
                TomChannelDutyCycleCompareValCm1 = 0
                TomChannelExtCounterCn0Reset = TRIG_ON_PREV_COMPARE_MATCH
                TomChannelExtTriggerOutput = EXT_TRIG_FROM_PREVIOUS_CHANNEL
                TomChannelOneShotMode = false
                TomChannelPeriodCompareValCm0 = 0
                TomChannelTrigOneShotMode = false
                TomChannelTriggerOutput = TRIG_FROM_PREVIOUS_CHANNEL
              TomChannelUsage: TomChannelUsage=USED_BY_OTHER_DRIVERS_OR_UNUSED
            TomChannel_15
              TomChannelEnable: TomChDisableOnTgcTrigger=false, TomChannelEnable=AT_START
              TomChannelInterrupt: TomIntEnableOnDutyCycleMatchCcu1=false, TomIntEnableOnPeriodMatchCcu0=false, TomInterruptMode=GTM_INTERRUPT_LEVEL_MODE, TomNotification=NULL_PTR
              TomChannelOutput:
                TomChOutputDisableOnTgcTrig = false
                TomChannelOutputControl = DONT_ENABLE_CHANNEL_OUTPUT
                TomChannelOutputSignalLevel = LOW
                TomChannelPortPinSelect = TOUT17_SELA_PORT0_PIN8
              TomChannelTimerParameters:
                TomChDCycCompareShadowValSr1 = 0
                TomChEnableForceUpdate = false
                TomChPeriodCompareShadowValSr0 = 0
                TomChResetCn0OnForceUpdate = false
                TomChUpdateEnableOnCn0Reset = false
                TomChannelBitReversalMode = false
                TomChannelClockSelect = GTM_FIXED_CLOCK_0
                TomChannelCounterCn0Reset = ON_COMPARE_MATCH_ON_CHANNEL
                TomChannelCounterValCn0 = 0
                TomChannelDutyCycleCompareValCm1 = 0
                TomChannelExtCounterCn0Reset = TRIG_ON_PREV_COMPARE_MATCH
                TomChannelExtTriggerOutput = EXT_TRIG_FROM_PREVIOUS_CHANNEL
                TomChannelOneShotMode = false
                TomChannelPeriodCompareValCm0 = 0
                TomChannelTrigOneShotMode = false
                TomChannelTriggerOutput = TRIG_FROM_PREVIOUS_CHANNEL
              TomChannelUsage: TomChannelUsage=USED_BY_OTHER_DRIVERS_OR_UNUSED
            TomChannel_2
              TomChannelEnable: TomChDisableOnTgcTrigger=false, TomChannelEnable=AT_START
              TomChannelInterrupt: TomIntEnableOnDutyCycleMatchCcu1=false, TomIntEnableOnPeriodMatchCcu0=false, TomInterruptMode=GTM_INTERRUPT_LEVEL_MODE, TomNotification=NULL_PTR
              TomChannelOutput:
                TomChOutputDisableOnTgcTrig = false
                TomChannelOutputControl = DONT_ENABLE_CHANNEL_OUTPUT
                TomChannelOutputSignalLevel = LOW
                TomChannelPortPinSelect = TOUT104_SELA_PORT10_PIN2
              TomChannelTimerParameters:
                TomChDCycCompareShadowValSr1 = 0
                TomChEnableForceUpdate = false
                TomChPeriodCompareShadowValSr0 = 0
                TomChResetCn0OnForceUpdate = false
                TomChUpdateEnableOnCn0Reset = false
                TomChannelBitReversalMode = false
                TomChannelClockSelect = GTM_FIXED_CLOCK_0
                TomChannelCounterCn0Reset = ON_COMPARE_MATCH_ON_CHANNEL
                TomChannelCounterValCn0 = 0
                TomChannelDutyCycleCompareValCm1 = 0
                TomChannelExtCounterCn0Reset = TRIG_ON_PREV_COMPARE_MATCH
                TomChannelExtTriggerOutput = EXT_TRIG_FROM_PREVIOUS_CHANNEL
                TomChannelOneShotMode = false
                TomChannelPeriodCompareValCm0 = 0
                TomChannelTrigOneShotMode = false
                TomChannelTriggerOutput = TRIG_FROM_PREVIOUS_CHANNEL
              TomChannelUsage: TomChannelUsage=USED_BY_OTHER_DRIVERS_OR_UNUSED
            TomChannel_3
              TomChannelEnable: TomChDisableOnTgcTrigger=false, TomChannelEnable=AT_START
              TomChannelInterrupt: TomIntEnableOnDutyCycleMatchCcu1=false, TomIntEnableOnPeriodMatchCcu0=false, TomInterruptMode=GTM_INTERRUPT_LEVEL_MODE, TomNotification=NULL_PTR
              TomChannelOutput:
                TomChOutputDisableOnTgcTrig = false
                TomChannelOutputControl = DONT_ENABLE_CHANNEL_OUTPUT
                TomChannelOutputSignalLevel = LOW
                TomChannelPortPinSelect = TOUT21_SELA_PORT0_PIN12
              TomChannelTimerParameters:
                TomChDCycCompareShadowValSr1 = 0
                TomChEnableForceUpdate = false
                TomChPeriodCompareShadowValSr0 = 0
                TomChResetCn0OnForceUpdate = false
                TomChUpdateEnableOnCn0Reset = false
                TomChannelBitReversalMode = false
                TomChannelClockSelect = GTM_FIXED_CLOCK_0
                TomChannelCounterCn0Reset = ON_COMPARE_MATCH_ON_CHANNEL
                TomChannelCounterValCn0 = 0
                TomChannelDutyCycleCompareValCm1 = 0
                TomChannelExtCounterCn0Reset = TRIG_ON_PREV_COMPARE_MATCH
                TomChannelExtTriggerOutput = EXT_TRIG_FROM_PREVIOUS_CHANNEL
                TomChannelOneShotMode = false
                TomChannelPeriodCompareValCm0 = 0
                TomChannelTrigOneShotMode = false
                TomChannelTriggerOutput = TRIG_FROM_PREVIOUS_CHANNEL
              TomChannelUsage: TomChannelUsage=USED_BY_OTHER_DRIVERS_OR_UNUSED
            TomChannel_4
              TomChannelEnable: TomChDisableOnTgcTrigger=false, TomChannelEnable=AT_START
              TomChannelInterrupt: TomIntEnableOnDutyCycleMatchCcu1=false, TomIntEnableOnPeriodMatchCcu0=false, TomInterruptMode=GTM_INTERRUPT_LEVEL_MODE, TomNotification=NULL_PTR
              TomChannelOutput:
                TomChOutputDisableOnTgcTrig = false
                TomChannelOutputControl = DONT_ENABLE_CHANNEL_OUTPUT
                TomChannelOutputSignalLevel = LOW
                TomChannelPortPinSelect = TOUT81_SELA_PORT14_PIN1
              TomChannelTimerParameters:
                TomChDCycCompareShadowValSr1 = 0
                TomChEnableForceUpdate = false
                TomChPeriodCompareShadowValSr0 = 0
                TomChResetCn0OnForceUpdate = false
                TomChUpdateEnableOnCn0Reset = false
                TomChannelBitReversalMode = false
                TomChannelClockSelect = GTM_FIXED_CLOCK_0
                TomChannelCounterCn0Reset = ON_COMPARE_MATCH_ON_CHANNEL
                TomChannelCounterValCn0 = 0
                TomChannelDutyCycleCompareValCm1 = 0
                TomChannelExtCounterCn0Reset = TRIG_ON_PREV_COMPARE_MATCH
                TomChannelExtTriggerOutput = EXT_TRIG_FROM_PREVIOUS_CHANNEL
                TomChannelOneShotMode = false
                TomChannelPeriodCompareValCm0 = 0
                TomChannelTrigOneShotMode = false
                TomChannelTriggerOutput = TRIG_FROM_PREVIOUS_CHANNEL
              TomChannelUsage: TomChannelUsage=USED_BY_OTHER_DRIVERS_OR_UNUSED
            TomChannel_5
              TomChannelEnable: TomChDisableOnTgcTrigger=false, TomChannelEnable=AT_START
              TomChannelInterrupt: TomIntEnableOnDutyCycleMatchCcu1=false, TomIntEnableOnPeriodMatchCcu0=false, TomInterruptMode=GTM_INTERRUPT_LEVEL_MODE, TomNotification=NULL_PTR
              TomChannelOutput:
                TomChOutputDisableOnTgcTrig = false
                TomChannelOutputControl = DONT_ENABLE_CHANNEL_OUTPUT
                TomChannelOutputSignalLevel = LOW
                TomChannelPortPinSelect = TOUT91_SELA_PORT13_PIN0
              TomChannelTimerParameters:
                TomChDCycCompareShadowValSr1 = 0
                TomChEnableForceUpdate = false
                TomChPeriodCompareShadowValSr0 = 0
                TomChResetCn0OnForceUpdate = false
                TomChUpdateEnableOnCn0Reset = false
                TomChannelBitReversalMode = false
                TomChannelClockSelect = GTM_FIXED_CLOCK_0
                TomChannelCounterCn0Reset = ON_COMPARE_MATCH_ON_CHANNEL
                TomChannelCounterValCn0 = 0
                TomChannelDutyCycleCompareValCm1 = 0
                TomChannelExtCounterCn0Reset = TRIG_ON_PREV_COMPARE_MATCH
                TomChannelExtTriggerOutput = EXT_TRIG_FROM_PREVIOUS_CHANNEL
                TomChannelOneShotMode = false
                TomChannelPeriodCompareValCm0 = 0
                TomChannelTrigOneShotMode = false
                TomChannelTriggerOutput = TRIG_FROM_PREVIOUS_CHANNEL
              TomChannelUsage: TomChannelUsage=USED_BY_OTHER_DRIVERS_OR_UNUSED
            TomChannel_6
              TomChannelEnable: TomChDisableOnTgcTrigger=false, TomChannelEnable=AT_START
              TomChannelInterrupt: TomIntEnableOnDutyCycleMatchCcu1=false, TomIntEnableOnPeriodMatchCcu0=false, TomInterruptMode=GTM_INTERRUPT_LEVEL_MODE, TomNotification=NULL_PTR
              TomChannelOutput:
                TomChOutputDisableOnTgcTrig = false
                TomChannelOutputControl = DONT_ENABLE_CHANNEL_OUTPUT
                TomChannelOutputSignalLevel = LOW
                TomChannelPortPinSelect = TOUT92_SELA_PORT13_PIN1
              TomChannelTimerParameters:
                TomChDCycCompareShadowValSr1 = 0
                TomChEnableForceUpdate = false
                TomChPeriodCompareShadowValSr0 = 0
                TomChResetCn0OnForceUpdate = false
                TomChUpdateEnableOnCn0Reset = false
                TomChannelBitReversalMode = false
                TomChannelClockSelect = GTM_FIXED_CLOCK_0
                TomChannelCounterCn0Reset = ON_COMPARE_MATCH_ON_CHANNEL
                TomChannelCounterValCn0 = 0
                TomChannelDutyCycleCompareValCm1 = 0
                TomChannelExtCounterCn0Reset = TRIG_ON_PREV_COMPARE_MATCH
                TomChannelExtTriggerOutput = EXT_TRIG_FROM_PREVIOUS_CHANNEL
                TomChannelOneShotMode = false
                TomChannelPeriodCompareValCm0 = 0
                TomChannelTrigOneShotMode = false
                TomChannelTriggerOutput = TRIG_FROM_PREVIOUS_CHANNEL
              TomChannelUsage: TomChannelUsage=USED_BY_OTHER_DRIVERS_OR_UNUSED
            TomChannel_7
              TomChannelEnable: TomChDisableOnTgcTrigger=false, TomChannelEnable=AT_START
              TomChannelInterrupt: TomIntEnableOnDutyCycleMatchCcu1=false, TomIntEnableOnPeriodMatchCcu0=false, TomInterruptMode=GTM_INTERRUPT_LEVEL_MODE, TomNotification=NULL_PTR
              TomChannelOutput:
                TomChOutputDisableOnTgcTrig = false
                TomChannelOutputControl = DONT_ENABLE_CHANNEL_OUTPUT
                TomChannelOutputSignalLevel = LOW
                TomChannelPortPinSelect = TOUT93_SELA_PORT13_PIN2
              TomChannelTimerParameters:
                TomChDCycCompareShadowValSr1 = 0
                TomChEnableForceUpdate = false
                TomChPeriodCompareShadowValSr0 = 0
                TomChResetCn0OnForceUpdate = false
                TomChUpdateEnableOnCn0Reset = false
                TomChannelBitReversalMode = false
                TomChannelClockSelect = GTM_FIXED_CLOCK_0
                TomChannelCounterCn0Reset = ON_COMPARE_MATCH_ON_CHANNEL
                TomChannelCounterValCn0 = 0
                TomChannelDutyCycleCompareValCm1 = 0
                TomChannelExtCounterCn0Reset = TRIG_ON_PREV_COMPARE_MATCH
                TomChannelExtTriggerOutput = EXT_TRIG_FROM_PREVIOUS_CHANNEL
                TomChannelOneShotMode = false
                TomChannelPeriodCompareValCm0 = 0
                TomChannelTrigOneShotMode = false
                TomChannelTriggerOutput = TRIG_FROM_PREVIOUS_CHANNEL
              TomChannelUsage: TomChannelUsage=USED_BY_OTHER_DRIVERS_OR_UNUSED
            TomChannel_8
              TomChannelEnable: TomChDisableOnTgcTrigger=false, TomChannelEnable=AT_START
              TomChannelInterrupt: TomIntEnableOnDutyCycleMatchCcu1=false, TomIntEnableOnPeriodMatchCcu0=false, TomInterruptMode=GTM_INTERRUPT_LEVEL_MODE, TomNotification=NULL_PTR
              TomChannelOutput:
                TomChOutputDisableOnTgcTrig = false
                TomChannelOutputControl = DONT_ENABLE_CHANNEL_OUTPUT
                TomChannelOutputSignalLevel = LOW
                TomChannelPortPinSelect = TOUT9_SELA_PORT0_PIN0
              TomChannelTimerParameters:
                TomChDCycCompareShadowValSr1 = 0
                TomChEnableForceUpdate = false
                TomChPeriodCompareShadowValSr0 = 0
                TomChResetCn0OnForceUpdate = false
                TomChUpdateEnableOnCn0Reset = false
                TomChannelBitReversalMode = false
                TomChannelClockSelect = GTM_FIXED_CLOCK_0
                TomChannelCounterCn0Reset = ON_COMPARE_MATCH_ON_CHANNEL
                TomChannelCounterValCn0 = 0
                TomChannelDutyCycleCompareValCm1 = 0
                TomChannelExtCounterCn0Reset = TRIG_ON_PREV_COMPARE_MATCH
                TomChannelExtTriggerOutput = EXT_TRIG_FROM_PREVIOUS_CHANNEL
                TomChannelOneShotMode = false
                TomChannelPeriodCompareValCm0 = 0
                TomChannelTrigOneShotMode = false
                TomChannelTriggerOutput = TRIG_FROM_PREVIOUS_CHANNEL
              TomChannelUsage: TomChannelUsage=USED_BY_OTHER_DRIVERS_OR_UNUSED
            TomChannel_9
              TomChannelEnable: TomChDisableOnTgcTrigger=false, TomChannelEnable=AT_START
              TomChannelInterrupt: TomIntEnableOnDutyCycleMatchCcu1=false, TomIntEnableOnPeriodMatchCcu0=false, TomInterruptMode=GTM_INTERRUPT_LEVEL_MODE, TomNotification=NULL_PTR
              TomChannelOutput:
                TomChOutputDisableOnTgcTrig = false
                TomChannelOutputControl = DONT_ENABLE_CHANNEL_OUTPUT
                TomChannelOutputSignalLevel = LOW
                TomChannelPortPinSelect = TOUT10_SELA_PORT0_PIN1
              TomChannelTimerParameters:
                TomChDCycCompareShadowValSr1 = 0
                TomChEnableForceUpdate = false
                TomChPeriodCompareShadowValSr0 = 0
                TomChResetCn0OnForceUpdate = false
                TomChUpdateEnableOnCn0Reset = false
                TomChannelBitReversalMode = false
                TomChannelClockSelect = GTM_FIXED_CLOCK_0
                TomChannelCounterCn0Reset = ON_COMPARE_MATCH_ON_CHANNEL
                TomChannelCounterValCn0 = 0
                TomChannelDutyCycleCompareValCm1 = 0
                TomChannelExtCounterCn0Reset = TRIG_ON_PREV_COMPARE_MATCH
                TomChannelExtTriggerOutput = EXT_TRIG_FROM_PREVIOUS_CHANNEL
                TomChannelOneShotMode = false
                TomChannelPeriodCompareValCm0 = 0
                TomChannelTrigOneShotMode = false
                TomChannelTriggerOutput = TRIG_FROM_PREVIOUS_CHANNEL
              TomChannelUsage: TomChannelUsage=USED_BY_OTHER_DRIVERS_OR_UNUSED
          TomTriggersForTgc_0 (TomTriggersForTgc)
            TomTgcInternalTriggerSelect:
              TomTgcIntTriggerFromChannel{0..7} = false
            TomTgcTriggerByTimebase: TomTgcTbuTimebaseSelect=TBU_TS0_TIMEBASE, TomTgcTimeBaseTriggerEnable=false, TomTgcTimebaseMatchValue=0
          TomTriggersForTgc_1 (TomTriggersForTgc)
            TomTgcInternalTriggerSelect:
              TomTgcIntTriggerFromChannel{0..7} = false
            TomTgcTriggerByTimebase: TomTgcTbuTimebaseSelect=TBU_TS0_TIMEBASE, TomTgcTimeBaseTriggerEnable=false, TomTgcTimebaseMatchValue=0
        Tom_1 (Tom)
          16 x TomChannel:
            TomChannel_0
              TomChannelEnable: TomChDisableOnTgcTrigger=false, TomChannelEnable=AT_START
              TomChannelInterrupt: TomIntEnableOnDutyCycleMatchCcu1=false, TomIntEnableOnPeriodMatchCcu0=false, TomInterruptMode=GTM_INTERRUPT_LEVEL_MODE, TomNotification=NULL_PTR
              TomChannelOutput:
                TomChOutputDisableOnTgcTrig = false
                TomChannelOutputControl = DONT_ENABLE_CHANNEL_OUTPUT
                TomChannelOutputSignalLevel = LOW
                TomChannelPortPinSelect = TOUT9_SELB_PORT0_PIN0
              TomChannelTimerParameters:
                TomChDCycCompareShadowValSr1 = 0
                TomChEnableForceUpdate = false
                TomChPeriodCompareShadowValSr0 = 0
                TomChResetCn0OnForceUpdate = false
                TomChUpdateEnableOnCn0Reset = false
                TomChannelBitReversalMode = false
                TomChannelClockSelect = GTM_FIXED_CLOCK_0
                TomChannelCounterCn0Reset = ON_COMPARE_MATCH_ON_CHANNEL
                TomChannelCounterValCn0 = 0
                TomChannelDutyCycleCompareValCm1 = 0
                TomChannelExtCounterCn0Reset = TRIG_ON_PREV_COMPARE_MATCH
                TomChannelExtTriggerOutput = EXT_TRIG_FROM_PREVIOUS_CHANNEL
                TomChannelOneShotMode = false
                TomChannelPeriodCompareValCm0 = 0
                TomChannelTrigOneShotMode = false
                TomChannelTriggerOutput = TRIG_FROM_PREVIOUS_CHANNEL
              TomChannelUsage: TomChannelUsage=USED_BY_OTHER_DRIVERS_OR_UNUSED
            TomChannel_1
              TomChannelEnable: TomChDisableOnTgcTrigger=false, TomChannelEnable=AT_START
              TomChannelInterrupt: TomIntEnableOnDutyCycleMatchCcu1=false, TomIntEnableOnPeriodMatchCcu0=false, TomInterruptMode=GTM_INTERRUPT_LEVEL_MODE, TomNotification=NULL_PTR
              TomChannelOutput:
                TomChOutputDisableOnTgcTrig = false
                TomChannelOutputControl = DONT_ENABLE_CHANNEL_OUTPUT
                TomChannelOutputSignalLevel = LOW
                TomChannelPortPinSelect = TOUT10_SELB_PORT0_PIN1
              TomChannelTimerParameters:
                TomChDCycCompareShadowValSr1 = 0
                TomChEnableForceUpdate = false
                TomChPeriodCompareShadowValSr0 = 0
                TomChResetCn0OnForceUpdate = false
                TomChUpdateEnableOnCn0Reset = false
                TomChannelBitReversalMode = false
                TomChannelClockSelect = GTM_FIXED_CLOCK_0
                TomChannelCounterCn0Reset = ON_COMPARE_MATCH_ON_CHANNEL
                TomChannelCounterValCn0 = 0
                TomChannelDutyCycleCompareValCm1 = 0
                TomChannelExtCounterCn0Reset = TRIG_ON_PREV_COMPARE_MATCH
                TomChannelExtTriggerOutput = EXT_TRIG_FROM_PREVIOUS_CHANNEL
                TomChannelOneShotMode = false
                TomChannelPeriodCompareValCm0 = 0
                TomChannelTrigOneShotMode = false
                TomChannelTriggerOutput = TRIG_FROM_PREVIOUS_CHANNEL
              TomChannelUsage: TomChannelUsage=USED_BY_OTHER_DRIVERS_OR_UNUSED
            TomChannel_10
              TomChannelEnable: TomChDisableOnTgcTrigger=false, TomChannelEnable=AT_START
              TomChannelInterrupt: TomIntEnableOnDutyCycleMatchCcu1=false, TomIntEnableOnPeriodMatchCcu0=false, TomInterruptMode=GTM_INTERRUPT_LEVEL_MODE, TomNotification=NULL_PTR
              TomChannelOutput:
                TomChOutputDisableOnTgcTrig = false
                TomChannelOutputControl = DONT_ENABLE_CHANNEL_OUTPUT
                TomChannelOutputSignalLevel = LOW
                TomChannelPortPinSelect = TOUT2_SELB_PORT2_PIN2
              TomChannelTimerParameters:
                TomChDCycCompareShadowValSr1 = 0
                TomChEnableForceUpdate = false
                TomChPeriodCompareShadowValSr0 = 0
                TomChResetCn0OnForceUpdate = false
                TomChUpdateEnableOnCn0Reset = false
                TomChannelBitReversalMode = false
                TomChannelClockSelect = GTM_FIXED_CLOCK_0
                TomChannelCounterCn0Reset = ON_COMPARE_MATCH_ON_CHANNEL
                TomChannelCounterValCn0 = 0
                TomChannelDutyCycleCompareValCm1 = 0
                TomChannelExtCounterCn0Reset = TRIG_ON_PREV_COMPARE_MATCH
                TomChannelExtTriggerOutput = EXT_TRIG_FROM_PREVIOUS_CHANNEL
                TomChannelOneShotMode = false
                TomChannelPeriodCompareValCm0 = 0
                TomChannelTrigOneShotMode = false
                TomChannelTriggerOutput = TRIG_FROM_PREVIOUS_CHANNEL
              TomChannelUsage: TomChannelUsage=USED_BY_OTHER_DRIVERS_OR_UNUSED
            TomChannel_11
              TomChannelEnable: TomChDisableOnTgcTrigger=false, TomChannelEnable=AT_START
              TomChannelInterrupt: TomIntEnableOnDutyCycleMatchCcu1=false, TomIntEnableOnPeriodMatchCcu0=false, TomInterruptMode=GTM_INTERRUPT_LEVEL_MODE, TomNotification=NULL_PTR
              TomChannelOutput:
                TomChOutputDisableOnTgcTrig = false
                TomChannelOutputControl = DONT_ENABLE_CHANNEL_OUTPUT
                TomChannelOutputSignalLevel = LOW
                TomChannelPortPinSelect = TOUT3_SELB_PORT2_PIN3
              TomChannelTimerParameters:
                TomChDCycCompareShadowValSr1 = 0
                TomChEnableForceUpdate = false
                TomChPeriodCompareShadowValSr0 = 0
                TomChResetCn0OnForceUpdate = false
                TomChUpdateEnableOnCn0Reset = false
                TomChannelBitReversalMode = false
                TomChannelClockSelect = GTM_FIXED_CLOCK_0
                TomChannelCounterCn0Reset = ON_COMPARE_MATCH_ON_CHANNEL
                TomChannelCounterValCn0 = 0
                TomChannelDutyCycleCompareValCm1 = 0
                TomChannelExtCounterCn0Reset = TRIG_ON_PREV_COMPARE_MATCH
                TomChannelExtTriggerOutput = EXT_TRIG_FROM_PREVIOUS_CHANNEL
                TomChannelOneShotMode = false
                TomChannelPeriodCompareValCm0 = 0
                TomChannelTrigOneShotMode = false
                TomChannelTriggerOutput = TRIG_FROM_PREVIOUS_CHANNEL
              TomChannelUsage: TomChannelUsage=USED_BY_OTHER_DRIVERS_OR_UNUSED
            TomChannel_12
              TomChannelEnable: TomChDisableOnTgcTrigger=false, TomChannelEnable=AT_START
              TomChannelInterrupt: TomIntEnableOnDutyCycleMatchCcu1=false, TomIntEnableOnPeriodMatchCcu0=false, TomInterruptMode=GTM_INTERRUPT_LEVEL_MODE, TomNotification=NULL_PTR
              TomChannelOutput:
                TomChOutputDisableOnTgcTrig = false
                TomChannelOutputControl = DONT_ENABLE_CHANNEL_OUTPUT
                TomChannelOutputSignalLevel = LOW
                TomChannelPortPinSelect = TOUT4_SELB_PORT2_PIN4
              TomChannelTimerParameters:
                TomChDCycCompareShadowValSr1 = 0
                TomChEnableForceUpdate = false
                TomChPeriodCompareShadowValSr0 = 0
                TomChResetCn0OnForceUpdate = false
                TomChUpdateEnableOnCn0Reset = false
                TomChannelBitReversalMode = false
                TomChannelClockSelect = GTM_FIXED_CLOCK_0
                TomChannelCounterCn0Reset = ON_COMPARE_MATCH_ON_CHANNEL
                TomChannelCounterValCn0 = 0
                TomChannelDutyCycleCompareValCm1 = 0
                TomChannelExtCounterCn0Reset = TRIG_ON_PREV_COMPARE_MATCH
                TomChannelExtTriggerOutput = EXT_TRIG_FROM_PREVIOUS_CHANNEL
                TomChannelOneShotMode = false
                TomChannelPeriodCompareValCm0 = 0
                TomChannelTrigOneShotMode = false
                TomChannelTriggerOutput = TRIG_FROM_PREVIOUS_CHANNEL
              TomChannelUsage: TomChannelUsage=USED_BY_OTHER_DRIVERS_OR_UNUSED
            TomChannel_13
              TomChannelEnable: TomChDisableOnTgcTrigger=false, TomChannelEnable=AT_START
              TomChannelInterrupt: TomIntEnableOnDutyCycleMatchCcu1=false, TomIntEnableOnPeriodMatchCcu0=false, TomInterruptMode=GTM_INTERRUPT_LEVEL_MODE, TomNotification=NULL_PTR
              TomChannelOutput:
                TomChOutputDisableOnTgcTrig = false
                TomChannelOutputControl = DONT_ENABLE_CHANNEL_OUTPUT
                TomChannelOutputSignalLevel = LOW
                TomChannelPortPinSelect = TOUT5_SELB_PORT2_PIN5
              TomChannelTimerParameters:
                TomChDCycCompareShadowValSr1 = 0
                TomChEnableForceUpdate = false
                TomChPeriodCompareShadowValSr0 = 0
                TomChResetCn0OnForceUpdate = false
                TomChUpdateEnableOnCn0Reset = false
                TomChannelBitReversalMode = false
                TomChannelClockSelect = GTM_FIXED_CLOCK_0
                TomChannelCounterCn0Reset = ON_COMPARE_MATCH_ON_CHANNEL
                TomChannelCounterValCn0 = 0
                TomChannelDutyCycleCompareValCm1 = 0
                TomChannelExtCounterCn0Reset = TRIG_ON_PREV_COMPARE_MATCH
                TomChannelExtTriggerOutput = EXT_TRIG_FROM_PREVIOUS_CHANNEL
                TomChannelOneShotMode = false
                TomChannelPeriodCompareValCm0 = 0
                TomChannelTrigOneShotMode = false
                TomChannelTriggerOutput = TRIG_FROM_PREVIOUS_CHANNEL
              TomChannelUsage: TomChannelUsage=USED_BY_OTHER_DRIVERS_OR_UNUSED
            TomChannel_14
              TomChannelEnable: TomChDisableOnTgcTrigger=false, TomChannelEnable=AT_START
              TomChannelInterrupt: TomIntEnableOnDutyCycleMatchCcu1=false, TomIntEnableOnPeriodMatchCcu0=false, TomInterruptMode=GTM_INTERRUPT_LEVEL_MODE, TomNotification=NULL_PTR
              TomChannelOutput:
                TomChOutputDisableOnTgcTrig = false
                TomChannelOutputControl = DONT_ENABLE_CHANNEL_OUTPUT
                TomChannelOutputSignalLevel = LOW
                TomChannelPortPinSelect = TOUT6_SELB_PORT2_PIN6
              TomChannelTimerParameters:
                TomChDCycCompareShadowValSr1 = 0
                TomChEnableForceUpdate = false
                TomChPeriodCompareShadowValSr0 = 0
                TomChResetCn0OnForceUpdate = false
                TomChUpdateEnableOnCn0Reset = false
                TomChannelBitReversalMode = false
                TomChannelClockSelect = GTM_FIXED_CLOCK_0
                TomChannelCounterCn0Reset = ON_COMPARE_MATCH_ON_CHANNEL
                TomChannelCounterValCn0 = 0
                TomChannelDutyCycleCompareValCm1 = 0
                TomChannelExtCounterCn0Reset = TRIG_ON_PREV_COMPARE_MATCH
                TomChannelExtTriggerOutput = EXT_TRIG_FROM_PREVIOUS_CHANNEL
                TomChannelOneShotMode = false
                TomChannelPeriodCompareValCm0 = 0
                TomChannelTrigOneShotMode = false
                TomChannelTriggerOutput = TRIG_FROM_PREVIOUS_CHANNEL
              TomChannelUsage: TomChannelUsage=USED_BY_OTHER_DRIVERS_OR_UNUSED
            TomChannel_15
              TomChannelEnable: TomChDisableOnTgcTrigger=false, TomChannelEnable=AT_START
              TomChannelInterrupt: TomIntEnableOnDutyCycleMatchCcu1=false, TomIntEnableOnPeriodMatchCcu0=false, TomInterruptMode=GTM_INTERRUPT_LEVEL_MODE, TomNotification=NULL_PTR
              TomChannelOutput:
                TomChOutputDisableOnTgcTrig = false
                TomChannelOutputControl = DONT_ENABLE_CHANNEL_OUTPUT
                TomChannelOutputSignalLevel = LOW
                TomChannelPortPinSelect = TOUT7_SELB_PORT2_PIN7
              TomChannelTimerParameters:
                TomChDCycCompareShadowValSr1 = 0
                TomChEnableForceUpdate = false
                TomChPeriodCompareShadowValSr0 = 0
                TomChResetCn0OnForceUpdate = false
                TomChUpdateEnableOnCn0Reset = false
                TomChannelBitReversalMode = false
                TomChannelClockSelect = GTM_FIXED_CLOCK_0
                TomChannelCounterCn0Reset = ON_COMPARE_MATCH_ON_CHANNEL
                TomChannelCounterValCn0 = 0
                TomChannelDutyCycleCompareValCm1 = 0
                TomChannelExtCounterCn0Reset = TRIG_ON_PREV_COMPARE_MATCH
                TomChannelExtTriggerOutput = EXT_TRIG_FROM_PREVIOUS_CHANNEL
                TomChannelOneShotMode = false
                TomChannelPeriodCompareValCm0 = 0
                TomChannelTrigOneShotMode = false
                TomChannelTriggerOutput = TRIG_FROM_PREVIOUS_CHANNEL
              TomChannelUsage: TomChannelUsage=USED_BY_OTHER_DRIVERS_OR_UNUSED
            TomChannel_2
              TomChannelEnable: TomChDisableOnTgcTrigger=false, TomChannelEnable=AT_START
              TomChannelInterrupt: TomIntEnableOnDutyCycleMatchCcu1=false, TomIntEnableOnPeriodMatchCcu0=false, TomInterruptMode=GTM_INTERRUPT_LEVEL_MODE, TomNotification=NULL_PTR
              TomChannelOutput:
                TomChOutputDisableOnTgcTrig = false
                TomChannelOutputControl = DONT_ENABLE_CHANNEL_OUTPUT
                TomChannelOutputSignalLevel = LOW
                TomChannelPortPinSelect = TOUT12_SELB_PORT0_PIN3
              TomChannelTimerParameters:
                TomChDCycCompareShadowValSr1 = 0
                TomChEnableForceUpdate = false
                TomChPeriodCompareShadowValSr0 = 0
                TomChResetCn0OnForceUpdate = false
                TomChUpdateEnableOnCn0Reset = false
                TomChannelBitReversalMode = false
                TomChannelClockSelect = GTM_FIXED_CLOCK_0
                TomChannelCounterCn0Reset = ON_COMPARE_MATCH_ON_CHANNEL
                TomChannelCounterValCn0 = 0
                TomChannelDutyCycleCompareValCm1 = 0
                TomChannelExtCounterCn0Reset = TRIG_ON_PREV_COMPARE_MATCH
                TomChannelExtTriggerOutput = EXT_TRIG_FROM_PREVIOUS_CHANNEL
                TomChannelOneShotMode = false
                TomChannelPeriodCompareValCm0 = 0
                TomChannelTrigOneShotMode = false
                TomChannelTriggerOutput = TRIG_FROM_PREVIOUS_CHANNEL
              TomChannelUsage: TomChannelUsage=USED_BY_OTHER_DRIVERS_OR_UNUSED
            TomChannel_3
              TomChannelEnable: TomChDisableOnTgcTrigger=false, TomChannelEnable=AT_START
              TomChannelInterrupt: TomIntEnableOnDutyCycleMatchCcu1=false, TomIntEnableOnPeriodMatchCcu0=false, TomInterruptMode=GTM_INTERRUPT_LEVEL_MODE, TomNotification=NULL_PTR
              TomChannelOutput:
                TomChOutputDisableOnTgcTrig = false
                TomChannelOutputControl = DONT_ENABLE_CHANNEL_OUTPUT
                TomChannelOutputSignalLevel = LOW
                TomChannelPortPinSelect = TOUT13_SELB_PORT0_PIN4
              TomChannelTimerParameters:
                TomChDCycCompareShadowValSr1 = 0
                TomChEnableForceUpdate = false
                TomChPeriodCompareShadowValSr0 = 0
                TomChResetCn0OnForceUpdate = false
                TomChUpdateEnableOnCn0Reset = false
                TomChannelBitReversalMode = false
                TomChannelClockSelect = GTM_FIXED_CLOCK_0
                TomChannelCounterCn0Reset = ON_COMPARE_MATCH_ON_CHANNEL
                TomChannelCounterValCn0 = 0
                TomChannelDutyCycleCompareValCm1 = 0
                TomChannelExtCounterCn0Reset = TRIG_ON_PREV_COMPARE_MATCH
                TomChannelExtTriggerOutput = EXT_TRIG_FROM_PREVIOUS_CHANNEL
                TomChannelOneShotMode = false
                TomChannelPeriodCompareValCm0 = 0
                TomChannelTrigOneShotMode = false
                TomChannelTriggerOutput = TRIG_FROM_PREVIOUS_CHANNEL
              TomChannelUsage: TomChannelUsage=USED_BY_OTHER_DRIVERS_OR_UNUSED
            TomChannel_4
              TomChannelEnable: TomChDisableOnTgcTrigger=false, TomChannelEnable=AT_START
              TomChannelInterrupt: TomIntEnableOnDutyCycleMatchCcu1=false, TomIntEnableOnPeriodMatchCcu0=false, TomInterruptMode=GTM_INTERRUPT_LEVEL_MODE, TomNotification=NULL_PTR
              TomChannelOutput:
                TomChOutputDisableOnTgcTrig = false
                TomChannelOutputControl = DONT_ENABLE_CHANNEL_OUTPUT
                TomChannelOutputSignalLevel = LOW
                TomChannelPortPinSelect = TOUT14_SELB_PORT0_PIN5
              TomChannelTimerParameters:
                TomChDCycCompareShadowValSr1 = 0
                TomChEnableForceUpdate = false
                TomChPeriodCompareShadowValSr0 = 0
                TomChResetCn0OnForceUpdate = false
                TomChUpdateEnableOnCn0Reset = false
                TomChannelBitReversalMode = false
                TomChannelClockSelect = GTM_FIXED_CLOCK_0
                TomChannelCounterCn0Reset = ON_COMPARE_MATCH_ON_CHANNEL
                TomChannelCounterValCn0 = 0
                TomChannelDutyCycleCompareValCm1 = 0
                TomChannelExtCounterCn0Reset = TRIG_ON_PREV_COMPARE_MATCH
                TomChannelExtTriggerOutput = EXT_TRIG_FROM_PREVIOUS_CHANNEL
                TomChannelOneShotMode = false
                TomChannelPeriodCompareValCm0 = 0
                TomChannelTrigOneShotMode = false
                TomChannelTriggerOutput = TRIG_FROM_PREVIOUS_CHANNEL
              TomChannelUsage: TomChannelUsage=USED_BY_OTHER_DRIVERS_OR_UNUSED
            TomChannel_5
              TomChannelEnable: TomChDisableOnTgcTrigger=false, TomChannelEnable=AT_START
              TomChannelInterrupt: TomIntEnableOnDutyCycleMatchCcu1=false, TomIntEnableOnPeriodMatchCcu0=false, TomInterruptMode=GTM_INTERRUPT_LEVEL_MODE, TomNotification=NULL_PTR
              TomChannelOutput:
                TomChOutputDisableOnTgcTrig = false
                TomChannelOutputControl = DONT_ENABLE_CHANNEL_OUTPUT
                TomChannelOutputSignalLevel = LOW
                TomChannelPortPinSelect = TOUT15_SELB_PORT0_PIN6
              TomChannelTimerParameters:
                TomChDCycCompareShadowValSr1 = 0
                TomChEnableForceUpdate = false
                TomChPeriodCompareShadowValSr0 = 0
                TomChResetCn0OnForceUpdate = false
                TomChUpdateEnableOnCn0Reset = false
                TomChannelBitReversalMode = false
                TomChannelClockSelect = GTM_FIXED_CLOCK_0
                TomChannelCounterCn0Reset = ON_COMPARE_MATCH_ON_CHANNEL
                TomChannelCounterValCn0 = 0
                TomChannelDutyCycleCompareValCm1 = 0
                TomChannelExtCounterCn0Reset = TRIG_ON_PREV_COMPARE_MATCH
                TomChannelExtTriggerOutput = EXT_TRIG_FROM_PREVIOUS_CHANNEL
                TomChannelOneShotMode = false
                TomChannelPeriodCompareValCm0 = 0
                TomChannelTrigOneShotMode = false
                TomChannelTriggerOutput = TRIG_FROM_PREVIOUS_CHANNEL
              TomChannelUsage: TomChannelUsage=USED_BY_OTHER_DRIVERS_OR_UNUSED
            TomChannel_6
              TomChannelEnable: TomChDisableOnTgcTrigger=false, TomChannelEnable=AT_START
              TomChannelInterrupt: TomIntEnableOnDutyCycleMatchCcu1=false, TomIntEnableOnPeriodMatchCcu0=false, TomInterruptMode=GTM_INTERRUPT_LEVEL_MODE, TomNotification=NULL_PTR
              TomChannelOutput:
                TomChOutputDisableOnTgcTrig = false
                TomChannelOutputControl = DONT_ENABLE_CHANNEL_OUTPUT
                TomChannelOutputSignalLevel = LOW
                TomChannelPortPinSelect = TOUT16_SELB_PORT0_PIN7
              TomChannelTimerParameters:
                TomChDCycCompareShadowValSr1 = 0
                TomChEnableForceUpdate = false
                TomChPeriodCompareShadowValSr0 = 0
                TomChResetCn0OnForceUpdate = false
                TomChUpdateEnableOnCn0Reset = false
                TomChannelBitReversalMode = false
                TomChannelClockSelect = GTM_FIXED_CLOCK_0
                TomChannelCounterCn0Reset = ON_COMPARE_MATCH_ON_CHANNEL
                TomChannelCounterValCn0 = 0
                TomChannelDutyCycleCompareValCm1 = 0
                TomChannelExtCounterCn0Reset = TRIG_ON_PREV_COMPARE_MATCH
                TomChannelExtTriggerOutput = EXT_TRIG_FROM_PREVIOUS_CHANNEL
                TomChannelOneShotMode = false
                TomChannelPeriodCompareValCm0 = 0
                TomChannelTrigOneShotMode = false
                TomChannelTriggerOutput = TRIG_FROM_PREVIOUS_CHANNEL
              TomChannelUsage: TomChannelUsage=USED_BY_OTHER_DRIVERS_OR_UNUSED
            TomChannel_7
              TomChannelEnable: TomChDisableOnTgcTrigger=false, TomChannelEnable=AT_START
              TomChannelInterrupt: TomIntEnableOnDutyCycleMatchCcu1=false, TomIntEnableOnPeriodMatchCcu0=false, TomInterruptMode=GTM_INTERRUPT_LEVEL_MODE, TomNotification=NULL_PTR
              TomChannelOutput:
                TomChOutputDisableOnTgcTrig = false
                TomChannelOutputControl = DONT_ENABLE_CHANNEL_OUTPUT
                TomChannelOutputSignalLevel = LOW
                TomChannelPortPinSelect = TOUT17_SELB_PORT0_PIN8
              TomChannelTimerParameters:
                TomChDCycCompareShadowValSr1 = 0
                TomChEnableForceUpdate = false
                TomChPeriodCompareShadowValSr0 = 0
                TomChResetCn0OnForceUpdate = false
                TomChUpdateEnableOnCn0Reset = false
                TomChannelBitReversalMode = false
                TomChannelClockSelect = GTM_FIXED_CLOCK_0
                TomChannelCounterCn0Reset = ON_COMPARE_MATCH_ON_CHANNEL
                TomChannelCounterValCn0 = 0
                TomChannelDutyCycleCompareValCm1 = 0
                TomChannelExtCounterCn0Reset = TRIG_ON_PREV_COMPARE_MATCH
                TomChannelExtTriggerOutput = EXT_TRIG_FROM_PREVIOUS_CHANNEL
                TomChannelOneShotMode = false
                TomChannelPeriodCompareValCm0 = 0
                TomChannelTrigOneShotMode = false
                TomChannelTriggerOutput = TRIG_FROM_PREVIOUS_CHANNEL
              TomChannelUsage: TomChannelUsage=USED_BY_OTHER_DRIVERS_OR_UNUSED
            TomChannel_8
              TomChannelEnable: TomChDisableOnTgcTrigger=false, TomChannelEnable=AT_START
              TomChannelInterrupt: TomIntEnableOnDutyCycleMatchCcu1=false, TomIntEnableOnPeriodMatchCcu0=false, TomInterruptMode=GTM_INTERRUPT_LEVEL_MODE, TomNotification=NULL_PTR
              TomChannelOutput:
                TomChOutputDisableOnTgcTrig = false
                TomChannelOutputControl = DONT_ENABLE_CHANNEL_OUTPUT
                TomChannelOutputSignalLevel = LOW
                TomChannelPortPinSelect = TOUT0_SELB_PORT2_PIN0
              TomChannelTimerParameters:
                TomChDCycCompareShadowValSr1 = 0
                TomChEnableForceUpdate = false
                TomChPeriodCompareShadowValSr0 = 0
                TomChResetCn0OnForceUpdate = false
                TomChUpdateEnableOnCn0Reset = false
                TomChannelBitReversalMode = false
                TomChannelClockSelect = GTM_FIXED_CLOCK_0
                TomChannelCounterCn0Reset = ON_COMPARE_MATCH_ON_CHANNEL
                TomChannelCounterValCn0 = 0
                TomChannelDutyCycleCompareValCm1 = 0
                TomChannelExtCounterCn0Reset = TRIG_ON_PREV_COMPARE_MATCH
                TomChannelExtTriggerOutput = EXT_TRIG_FROM_PREVIOUS_CHANNEL
                TomChannelOneShotMode = false
                TomChannelPeriodCompareValCm0 = 0
                TomChannelTrigOneShotMode = false
                TomChannelTriggerOutput = TRIG_FROM_PREVIOUS_CHANNEL
              TomChannelUsage: TomChannelUsage=USED_BY_OTHER_DRIVERS_OR_UNUSED
            TomChannel_9
              TomChannelEnable: TomChDisableOnTgcTrigger=false, TomChannelEnable=AT_START
              TomChannelInterrupt: TomIntEnableOnDutyCycleMatchCcu1=false, TomIntEnableOnPeriodMatchCcu0=false, TomInterruptMode=GTM_INTERRUPT_LEVEL_MODE, TomNotification=NULL_PTR
              TomChannelOutput:
                TomChOutputDisableOnTgcTrig = false
                TomChannelOutputControl = DONT_ENABLE_CHANNEL_OUTPUT
                TomChannelOutputSignalLevel = LOW
                TomChannelPortPinSelect = TOUT1_SELB_PORT2_PIN1
              TomChannelTimerParameters:
                TomChDCycCompareShadowValSr1 = 0
                TomChEnableForceUpdate = false
                TomChPeriodCompareShadowValSr0 = 0
                TomChResetCn0OnForceUpdate = false
                TomChUpdateEnableOnCn0Reset = false
                TomChannelBitReversalMode = false
                TomChannelClockSelect = GTM_FIXED_CLOCK_0
                TomChannelCounterCn0Reset = ON_COMPARE_MATCH_ON_CHANNEL
                TomChannelCounterValCn0 = 0
                TomChannelDutyCycleCompareValCm1 = 0
                TomChannelExtCounterCn0Reset = TRIG_ON_PREV_COMPARE_MATCH
                TomChannelExtTriggerOutput = EXT_TRIG_FROM_PREVIOUS_CHANNEL
                TomChannelOneShotMode = false
                TomChannelPeriodCompareValCm0 = 0
                TomChannelTrigOneShotMode = false
                TomChannelTriggerOutput = TRIG_FROM_PREVIOUS_CHANNEL
              TomChannelUsage: TomChannelUsage=USED_BY_OTHER_DRIVERS_OR_UNUSED
          TomTriggersForTgc_0 (TomTriggersForTgc)
            TomTgcInternalTriggerSelect:
              TomTgcIntTriggerFromChannel{0..7} = false
            TomTgcTriggerByTimebase: TomTgcTbuTimebaseSelect=TBU_TS0_TIMEBASE, TomTgcTimeBaseTriggerEnable=false, TomTgcTimebaseMatchValue=0
          TomTriggersForTgc_1 (TomTriggersForTgc)
            TomTgcInternalTriggerSelect:
              TomTgcIntTriggerFromChannel{0..7} = false
            TomTgcTriggerByTimebase: TomTgcTbuTimebaseSelect=TBU_TS0_TIMEBASE, TomTgcTimeBaseTriggerEnable=false, TomTgcTimebaseMatchValue=0
      McuModeSettingConf_0 (McuModeSettingConf): McuIdleReqAckSeqDisable=false, McuMode=0
        McuStandbySettingConf
      McuTriggerReset: ESR0ResetTrigger=0, ESR1ResetTrigger=0, SMUResetTrigger=0, STM0ResetTrigger=0
      McuClockSettingConfig: McuClockSettingId=0
        McuClockReferencePoint:
          McuClockSettingMode = NORMAL_MODE
          McuPllPDivider = 0
          McuPllNDivider = 29
          McuPllK1Divider = 1
          McuPllK2Divider = 4
          McuPllK3Divider = 5
          McuK2DivSteps = 2
          McuK2DivRampToPllConfDelay = 10
          McuK2DivRampToBackUpConfDelay = 10
          McuFMPllModAmp = 1.25
          McuClockReferencePointFrequency = 120000000
          McuClockReferencePoint2Frequency = 100000000
          McuSRIDivider = 1
          McuClockSRIFrequency = 120000000
          McuCPU0Divider = 0
          McuClockCPU0Frequency = 120000000
          McuSPBDivider = 2
          McuClockSPBFrequency = 60000000
          McuFSIDivider = 2
          McuClockFSIFrequency = 60000000
          McuFSI2Divider = 2
          McuClockFSI2Frequency = 60000000
          McuMAXDivider = 1
          McuClockMAXFrequency = 120000000
          McuGTMDivider = 2
          McuClockGTMFrequency = 60000000
          McuSTMDivider = 2
          McuClockSTMFrequency = 60000000
          McuBBBDivider = 2
          McuClockBBBFrequency = 60000000
          McuBAUD2Divider = 2
          McuClockBAUD2Frequency = 60000000
          McuCANDivider = 3
          McuClockCANFrequency = 40000000
          McuASCLINFDivider = 2
          McuClockASCLINFFrequency = 60000000
          McuASCLINSDivider = 8
          McuClockASCLINSFrequency = 15000000
          McuErayPllPDivider = 0
          McuErayPllNDivider = 19
          McuErayPllK2Divider = 4
          McuErayPllK3Divider = 4
          McuClockErayPllFrequency = 80000000
          McuClockErayPll2Frequency = 80000000
          McuErayDivider = 1
          McuClockErayFrequency = 80000000
    McuSafety: McuClockMonitoringEnable=true, McuGetModeApi=true, McuInitCheckApi=true, McuSafetyEnable=false
    CommonPublishedInformation:
      ArMajorVersion = 3
      ArMinorVersion = 2
      ArPatchVersion = 0
      ModuleId = 101
      Release = _TRICORE_TC234
      SwMajorVersion = 4
      SwMinorVersion = 6
      SwPatchVersion = 1
      VendorApiInfix = 
      VendorId = 17
