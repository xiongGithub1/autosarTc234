AUTOSAR XML (schema 4-3-0)
package /COM/VECTOR/CFG/WORKFLOW/SYSDESC/SYNC
  system SYSTEM: category=ECU_EXTRACT
    system mapping MAPPINGS: sender-receiver-to-signal-mapping{data-element=COMPOSITIONTYPE.Pisignal_Rx1bit_RearInteriorLightState.RearInteriorLightState, system-signal=sig_State_RearInteriorLight}
    root-software-compositions:
      root sw composition prototype COMPOSITIONTYPE: flat-map=FLATMAP, software-composition=COMPOSITIONTYPE
  composition sw component type COMPOSITIONTYPE  # UB:Derived from original system description
    require port Pisignal_Rx1bit_RearInteriorLightState: nonqueued-receiver-com-spec{data-element=RearInteriorLightState, filter=data-filter-type=ALWAYS, init-value=0}, required-interface=Pisignal_Rx1bit_RearInteriorLightState
    9 x component:
      BswM: type=BswM
      ComM: type=ComM
      Det: type=Det
      EcuM: type=EcuM
      Os_OsCore_Core0_swc: type=Os_OsCore_Core0_swc
      StartApplication: type=StartApplication
      AppCom: type=AppCom
      DemMaster_0: type=DemMaster_0
      DemSatellite_0: type=DemSatellite_0
    connect BswM.Switch_ESH_ModeSwitch -> BswM.Notification_ESH_ModeNotification
    connect EcuM.EcuM_ShutdownTarget -> StartApplication.EcuM_ShutdownTarget
    connect BswM.Provide_BswMRteModeRequestPort -> BswM.Request_ESH_PostRunRequest_0
    connect ComM.UR_USR_CHNL_f276589c -> StartApplication.UR_USR_CHNL_3c6d4e43  # UB:Derived from original system description
    delegate AppCom.Pisignal_Rx1bit_RearInteriorLightState <-> outer port Pisignal_Rx1bit_RearInteriorLightState  # UB:Derived from original system description
  end to end protection set E2EPROTECTIONSET
  port interface mapping set PORTINTERFACEMAPPINGSET
