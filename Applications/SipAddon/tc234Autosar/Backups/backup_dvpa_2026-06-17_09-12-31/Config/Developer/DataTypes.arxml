AUTOSAR XML (schema 4-3-0)
standard types defined: boolean, uint16, uint32, uint8
package /ComponentTypes/DataTypeMappingSets
  data type mapping set SignalDataTypeMappingSet: data-type-map{application-data-type=RearInteriorLiagtState, implementation-data-type=RearInteriorLightState}
package /DataType/Semantics
  compu method CM_NmUd_MyECU_16bit: phys=raw for raw 0..65535
  compu method CM_NmUd_MyECU_32bit: phys=raw for raw 0..4294967295
  compu method CM_Signal_RearInteriorLight: phys=raw for raw 0..1
  compu method CM_Signal_RearLeftDoor: phys=raw for raw 0..1
  compu method CM_Signal_RearRightDoor: phys=raw for raw 0..1
  compu method CM_Signal_Rx11bit_OnWrite: phys=raw for raw 0..2047
  compu method CM_Signal_Rx15bit_OnWrite: phys=raw for raw 0..32767
  compu method CM_Signal_Rx16bit_Cyclic: phys=raw for raw 0..65535
  compu method CM_Signal_Rx20bit_Cyclic: phys=raw for raw 0..1048575
  compu method CM_Signal_Rx8bit_Cyclic: phys=raw for raw 0..255
  compu method CM_Signal_StartAppl_RxCtrl_MyECU: phys=raw for raw 0..255
  compu method CM_Signal_StartAppl_RxData_MyECU: phys=raw for raw 0..255
  compu method CM_Signal_StartAppl_TxCtrl_MyECU: phys=raw for raw 0..255
  compu method CM_Signal_StartAppl_TxData_MyECU: phys=raw for raw 0..255
  compu method CM_Signal_Tx10bit_Cyclic: phys=raw for raw 0..1023
  compu method CM_Signal_Tx24bit_Cyclic: phys=raw for raw 0..16777215
  compu method CM_Signal_Tx24bit_OnWrite: phys=raw for raw 0..16777215
  compu method CM_Signal_Tx32bit_Cyclic: phys=raw for raw 0..4294967295
  compu method CM_Signal_Tx32bit_OnWrite: phys=raw for raw 0..4294967295
  compu method CM_Signal_Tx4bit_Cyclic: phys=raw for raw 0..15
  compu method CM_SigRx_Prof1C_CRC: phys=raw for raw 0..255
  compu method CM_SigRx_Prof1C_DataId_HiByte_LoNib: phys=raw for raw 0..15
  compu method CM_SigRx_Prof1C_Sig32Bit: phys=raw for raw 0..4294967295
  compu method CM_SigRx_Prof1C_Sig3Bit: phys=raw for raw 0..7
  compu method CM_SigRx_Prof1C_Sig4Bit: phys=raw for raw 0..15
  compu method CM_SigRx_Prof1C_SQ: phys=raw for raw 0..15
  compu method CM_SigTx_Prof1C_CRC: phys=raw for raw 0..255
  compu method CM_SigTx_Prof1C_DataId_HiByte_LoNib: phys=raw for raw 0..15
  compu method CM_SigTx_Prof1C_Sig16Bit: phys=raw for raw 0..65535
  compu method CM_SigTx_Prof1C_Sig2Bit: phys=raw for raw 0..3
  compu method CM_SigTx_Prof1C_Sig4Bit: phys=raw for raw 0..15
  compu method CM_SigTx_Prof1C_Sig8Bit: phys=raw for raw 0..255
  compu method CM_SigTx_Prof1C_SQ: phys=raw for raw 0..15
  compu method CM_sig_LampCnt: 0..255=RANGE
  compu method CM_sig_RearInteriorLight: 0..1=RANGE
  compu method CM_sig_State_RearInteriorLight: 0..1=RANGE
  compu method CM_sig_State_RearLeftDoor: 0..1=RANGE
  compu method CM_sig_State_RearRightDoor: 0..1=RANGE
  compu method CM_sig_NM_MyECU_UserData_{0..5}: 0..255=RANGE
package /Predefined_DEV/ImplementationDataTypes
  impl type Dem_UdsStatusByteType: compu {mask 1: 1=DEM_UDS_STATUS_TF, mask 2: 2=DEM_UDS_STATUS_TFTOC, mask 4: 4=DEM_UDS_STATUS_PDTC, mask 8: 8=DEM_UDS_STATUS_CDTC, mask 16: 16=DEM_UDS_STATUS_TNCSLC, mask 32: 32=DEM_UDS_STATUS_TFSLC, mask 64: 64=DEM_UDS_STATUS_TNCTOC, mask 128: 128=DEM_UDS_STATUS_WIR}, range raw 0..255, implementation-data-type=uint8
  impl type NvM_RequestResultType: compu {0=NVM_REQ_OK, 1=NVM_REQ_NOT_OK, 2=NVM_REQ_PENDING, 3=NVM_REQ_INTEGRITY_FAILED, 4=NVM_REQ_BLOCK_SKIPPED, 5=NVM_REQ_NV_INVALIDATED, 6=NVM_REQ_CANCELED, 7=NVM_REQ_REDUNDANCY_FAILED, 8=NVM_REQ_RESTORED_FROM_ROM}, implementation-data-type=uint8
  impl type NvM_ServiceIdType: compu {6=NVM_READ_BLOCK, 7=NVM_WRITE_BLOCK, 8=NVM_RESTORE_BLOCK_DEFAULTS, 9=NVM_ERASE_BLOCK, 11=NVM_INVALIDATE_NV_BLOCK, 12=NVM_READ_ALL}, implementation-data-type=uint8
package /DataTypes
  app type RearInteriorLiagtState: category=BOOLEAN, sw-calibration-access=READ-ONLY
package /DataTypes/test
  impl type RearInteriorLightState: category=VALUE, base-type=test/boolean, sw-calibration-access=READ-ONLY, type-emitter=RTE
    symbol props boolean
