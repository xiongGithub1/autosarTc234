[part 1 of 2: package /ActiveEcuC]
AUTOSAR XML (schema 4-2-1)
package /ActiveEcuC
  ecuc value collection ActiveEcuC: ecu-extract=SYSTEM, ecuc-values=[Os, EcuC, Com, Rte, ComM, CanIf, Can, Det, PduR, EcuM, CanSM, BswM, Resource, Dio, Port, Mcu, Dem, Dcm]
  module config Os: implementation-config-variant=VARIANT-PRE-COMPILE, module-description=Os_Impl
    SystemTimer (OsCounter):
      OsCounterMaxAllowedValue = 2147483647
      OsCounterMinCycle = 1
      OsCounterType = HARDWARE
      OsSecondsPerTick = 0.001
      OsCounterTicksPerBase = 60000
      OsCounterAccessingApplication = SystemApplication_OsCore_Core0
      OsDriver: OsDriverHighResolution=false, OsDriverHardwareTimerChannelRef=STM0_Ch0, OsDriverIsrRef=CounterIsr_SystemTimer
    OsOS:
      OsStackMonitoring = true
      OsStatus = STANDARD
      OsUseGetServiceId = false
      OsUseParameterAccess = false
      OsUseResScheduler = false
      OsForcibleTermination = false
      OsGenerateCalloutStubs = true
      OsGenerateMemMap = COMPLETE
      OsGenerateMemMapForNearAddressing = true
      OsGenerateMemMapForThreads = false
      OsServiceProtection = false
      OsStackUsageMeasurement = false
      OsUseXSignalAsyncApiCalls = false
      OsScalabilityClass = SC1
      OsNumberOfCores = 1
      OsMasterCore = OsCore_Core0
      OsSystemTimer = SystemTimer
      OsHooks: OsErrorHook=true, OsPostTaskHook=false, OsPreTaskHook=false, OsShutdownHook=false, OsStartupHook=false
    OSDEFAULTAPPMODE (OsAppMode)
    OS_APPMODE_ANY (OsAppMode)
    OsPublishedInformation: OsKernelVersion=7, OsPlatformName=TriCoreAurix
      TC23x (OsDerivativeInformation):
        OsMpuAlignment = 8
        OsStackAlignment = 8
        OsExceptionVectorTableAlignment = 32
        OsInterruptVectorTableAlignment = 32
        OsHardwareManuals = User Manual: tc23x_tc22x_tc21x_um_v1.1.pdf V1.1 Errata Sheet: TC22x_TC21x_AB_Errata_Sheet_v1_2_03804A.pdf V1.2 Safety Manual: AURIX Safety Manual_3.pdf V1.3 2015-09
        Core0 (OsPhysicalCore):
          OsPhysicalCoreId = 0
          OsPhysicalCoreDefaultEntrySymbol = _start_tc0
          OsPhysicalCoreType = TC1.6.1E
          OsPhysicalCoreExceptionSources = 8
          OsPhysicalCoreMasterStartAllowed = true
          OsPhysicalCorePrivelegedHwAccess = true
          OsPhysicalCoreIsAutostart = true
          OsPhysicalCoreStackProtectionUnit = OsPhysicalCore0DataMpu
          OsPhysicalCore0DataMpu (OsPhysicalCoreMpu): OsPhysicalCoreMpuId=0, OsPhysicalCoreMpuMaxRegions=15, OsPhysicalCoreMpuType=DATA
          OsPhysicalCore0CodeMpu (OsPhysicalCoreMpu): OsPhysicalCoreMpuId=1, OsPhysicalCoreMpuMaxRegions=8, OsPhysicalCoreMpuType=CODE
        STM0 (OsHardwareTimer): OsHardwareTimerSize=32, OsHardwareTimerUnit=FRT, OsHardwareTimerBaseAddress=4026531840, OsHardwareTimerId=0, OsHardwareTimerType=STM
          STM0_Ch0 (OsHardwareTimerChannel): OsHardwareTimerChannelIntSource=1168, OsHardwareTimerChannelOffset=0, OsHardwareTimerChannelId=0
          STM0_Ch1 (OsHardwareTimerChannel): OsHardwareTimerChannelIntSource=1172, OsHardwareTimerChannelOffset=1, OsHardwareTimerChannelId=1
        AURIXTC2XX_IR (OsSystemIntCtrl): OsSystemIntCtrlMaxPrios=255, OsSystemIntCtrlPrioOrder=ASC, OsSystemIntCtrlMaxSources=8192, OsSystemIntCtrlBaseAddress=4026757120
        GPT (OsHardwareTimer): OsHardwareTimerSize=16, OsHardwareTimerUnit=PIT, OsHardwareTimerBaseAddress=4026543616, OsHardwareTimerId=0, OsHardwareTimerType=PIT
          GPT_Ch0 (OsHardwareTimerChannel): OsHardwareTimerChannelIntSource=1128, OsHardwareTimerChannelOffset=0, OsHardwareTimerChannelId=0
          GPT_Ch1 (OsHardwareTimerChannel): OsHardwareTimerChannelIntSource=1140, OsHardwareTimerChannelOffset=1, OsHardwareTimerChannelId=1
        OsMemoryRegionSpecifics
          12 x OsMemoryRegionAccess:
            PS0_R: OsMemoryRegionAccessRights=R, OsMemoryRegionAccessType=PROTECTION_SET0
            PS0_W: OsMemoryRegionAccessRights=W, OsMemoryRegionAccessType=PROTECTION_SET0
            PS0_X: OsMemoryRegionAccessRights=X, OsMemoryRegionAccessType=PROTECTION_SET0
            PS1_R: OsMemoryRegionAccessRights=R, OsMemoryRegionAccessType=PROTECTION_SET1
            PS1_W: OsMemoryRegionAccessRights=W, OsMemoryRegionAccessType=PROTECTION_SET1
            PS1_X: OsMemoryRegionAccessRights=X, OsMemoryRegionAccessType=PROTECTION_SET1
            PS2_R: OsMemoryRegionAccessRights=R, OsMemoryRegionAccessType=PROTECTION_SET2
            PS2_W: OsMemoryRegionAccessRights=W, OsMemoryRegionAccessType=PROTECTION_SET2
            PS2_X: OsMemoryRegionAccessRights=X, OsMemoryRegionAccessType=PROTECTION_SET2
            PS3_R: OsMemoryRegionAccessRights=R, OsMemoryRegionAccessType=PROTECTION_SET3
            PS3_W: OsMemoryRegionAccessRights=W, OsMemoryRegionAccessType=PROTECTION_SET3
            PS3_X: OsMemoryRegionAccessRights=X, OsMemoryRegionAccessType=PROTECTION_SET3
    OsCore_Core0 (OsCore):
      OsCoreIsAutostart = true
      OsCoreIsAutosar = true
      OsCoreEntrySymbol = _start_tc0
      OsCorePhysicalCoreRef = TC23x/Core0
      OsCoreIdleTask = IdleTask_OsCore_Core0
      OsCoreSystemApplication = SystemApplication_OsCore_Core0
      OsCoreEcucCoreRef = EcucHardware/Core0
      OsCoreStacks:
        OsCoreKernelStackSize = 1024
        OsCoreStartupStackSize = 1024
        OsCoreShutdownStackSize = 1024
        OsCoreErrorStackSize = 1024
        OsCoreProtectionStackSize = 1024
        OsCoreInitStackSize = 1024
    IdleTask_OsCore_Core0 (OsTask):
      OsTaskActivation = 1
      OsTaskPriority = 4294967295
      OsTaskSchedule = FULL
      OsTaskStackSharing = false
      OsTaskStackSize = 1024
      OsTaskType = AUTO
      OsTaskAccessingApplication = SystemApplication_OsCore_Core0
      OsTaskAutostart: OsTaskAppModeRef=OS_APPMODE_ANY
    SystemApplication_OsCore_Core0 (OsApplication):
      OsTrusted = true
      OsTrustedApplicationDelayTimingViolationCall = false
      OsTrustedApplicationWithProtection = false
      OsApplicationIsPrivileged = true
      OsAppUseTrustedFunctionStubs = false
      OsAppTaskRef = IdleTask_OsCore_Core0
      OsApplicationCoreRef = EcucHardware/Core0
      OsAppIsrRef = CounterIsr_SystemTimer
      OsAppTaskRef = Default_Appl_Init_Task
      OsAppTaskRef = Default_Appl_Task
      OsAppTaskRef = Default_BSW_Async_Task
      OsAppTaskRef = Default_BSW_Sync_Task
      OsAppTaskRef = Default_Background_Task
      OsAppTaskRef = Default_Init_Task
      OsAppTaskRef = Default_RTE_Mode_switch_Task
      OsAppCounterRef = SystemTimer
      OsAppIsrRef = CanIsr_0
      OsAppAlarmRef = Os/Rte_Al_TE2_Default_BSW_Async_Task_0_10ms
      OsAppAlarmRef = Os/Rte_Al_TE2_Default_BSW_Async_Task_0_20ms
      OsAppAlarmRef = Os/Rte_Al_TE_StartApplication_StartApplication_Cyclic1000ms
      OsAppAlarmRef = Os/Rte_Al_TE_StartApplication_StartApplication_Cyclic10ms
      OsAppAlarmRef = Os/Rte_Al_TE_StartApplication_StartApplication_Cyclic1ms
      OsAppAlarmRef = Os/Rte_Al_TE_StartApplication_StartApplication_Cyclic250ms
      OsAppAlarmRef = Os/Rte_Al_TE_AppCom_RWsignal
      OsApplicationHooks: OsAppErrorHook=false, OsAppShutdownHook=false, OsAppStartupHook=false
    7 x OsTask, all with OsTaskActivation=1, OsTaskSchedule=NON, OsTaskStackSharing=false, OsTaskType=AUTO, OsTaskAccessingApplication=SystemApplication_OsCore_Core0:
      Default_Init_Task: OsTaskPriority=50, OsTaskStackSize=1024, OsTaskResourceRef=OsResource_EcuM
        OsTaskAutostart: OsTaskAppModeRef=OSDEFAULTAPPMODE
      Default_BSW_Sync_Task: OsTaskPriority=40, OsTaskStackSize=1024
      Default_BSW_Async_Task: OsTaskPriority=30, OsTaskStackSize=2048, OsTaskResourceRef=OsResource_EcuM, OsTaskEventRef=Rte_Ev_Cyclic2_Default_BSW_Async_Task_0_10ms, OsTaskEventRef=Rte_Ev_Cyclic2_Default_BSW_Async_Task_0_20ms
      Default_RTE_Mode_switch_Task: OsTaskPriority=10, OsTaskStackSize=1024
      Default_Appl_Task: OsTaskPriority=5, OsTaskStackSize=1024, OsTaskEventRef=Rte_Ev_Run_StartApplication_StartApplication_Cyclic1000ms, OsTaskEventRef=Rte_Ev_Run_StartApplication_StartApplication_Cyclic10ms, OsTaskEventRef=Rte_Ev_Run_StartApplication_StartApplication_Cyclic1ms, OsTaskEventRef=Rte_Ev_Run_StartApplication_StartApplication_Cyclic250ms, OsTaskEventRef=Rte_Ev_Run_StartApplication_StartApplication_OnDataRec_RxCtrl, OsTaskEventRef=Rte_Ev_Run_StartApplication_StartApplication_OnDataRec_RxData, OsTaskEventRef=Rte_Ev_Run_AppCom_RWsignal
      Default_Background_Task: OsTaskPriority=0, OsTaskStackSize=1024
        OsTaskAutostart: OsTaskAppModeRef=OSDEFAULTAPPMODE
      Default_Appl_Init_Task: OsTaskPriority=45, OsTaskStackSize=1024
    CanIsr_0 (OsIsr):  # Os Interrupt Service Routine PLAIN_TEXT Can transmit, receive and busoff events of controller CT_CAN_e98c47e6. This OsIsr container has been created automatically based on the driver configuration.
      OsIsrCategory = CATEGORY_2
      OsIsrInterruptType = EXTERNAL
      OsIsrInterruptSource = 2304
      OsIsrInterruptPriority = 10
      OsIsrStackSize = 1024
      OsIsrEnableNesting = false
    OsResource_EcuM (OsResource): OsResourceProperty=STANDARD, OsResourceAccessingApplication=SystemApplication_OsCore_Core0
    CounterIsr_SystemTimer (OsIsr):
      OsIsrCategory = CATEGORY_2
      OsIsrInterruptType = EXTERNAL
      OsIsrInterruptSource = 1168
      OsIsrInterruptPriority = 1
      OsIsrStackSize = 1024
      OsIsrEnableNesting = false
      OsIsrSpecialFunctionName = Os_TimerPfrtIsr
    Rte_Al_TE2_Default_BSW_Async_Task_0_10ms (OsAlarm): OsAlarmCounterRef=SystemTimer, OsAlarmAccessingApplication=SystemApplication_OsCore_Core0
      OsAlarmAction
        OsAlarmSetEvent: OsAlarmSetEventRef=Rte_Ev_Cyclic2_Default_BSW_Async_Task_0_10ms, OsAlarmSetEventTaskRef=Default_BSW_Async_Task
    Rte_Al_TE2_Default_BSW_Async_Task_0_20ms (OsAlarm): OsAlarmCounterRef=SystemTimer, OsAlarmAccessingApplication=SystemApplication_OsCore_Core0
      OsAlarmAction
        OsAlarmSetEvent: OsAlarmSetEventRef=Rte_Ev_Cyclic2_Default_BSW_Async_Task_0_20ms, OsAlarmSetEventTaskRef=Default_BSW_Async_Task
    Rte_Ev_Cyclic2_Default_BSW_Async_Task_0_10ms (OsEvent)
    Rte_Ev_Cyclic2_Default_BSW_Async_Task_0_20ms (OsEvent)
    4 x OsAlarm, all with OsAlarmCounterRef=SystemTimer, OsAlarmAccessingApplication=SystemApplication_OsCore_Core0:
      Rte_Al_TE_StartApplication_StartApplication_Cyclic1000ms
        OsAlarmAction
          OsAlarmSetEvent: OsAlarmSetEventRef=Rte_Ev_Run_StartApplication_StartApplication_Cyclic1000ms, OsAlarmSetEventTaskRef=Default_Appl_Task
      Rte_Al_TE_StartApplication_StartApplication_Cyclic10ms
        OsAlarmAction
          OsAlarmSetEvent: OsAlarmSetEventRef=Rte_Ev_Run_StartApplication_StartApplication_Cyclic10ms, OsAlarmSetEventTaskRef=Default_Appl_Task
      Rte_Al_TE_StartApplication_StartApplication_Cyclic1ms
        OsAlarmAction
          OsAlarmSetEvent: OsAlarmSetEventRef=Rte_Ev_Run_StartApplication_StartApplication_Cyclic1ms, OsAlarmSetEventTaskRef=Default_Appl_Task
      Rte_Al_TE_StartApplication_StartApplication_Cyclic250ms
        OsAlarmAction
          OsAlarmSetEvent: OsAlarmSetEventRef=Rte_Ev_Run_StartApplication_StartApplication_Cyclic250ms, OsAlarmSetEventTaskRef=Default_Appl_Task
    6 x OsEvent:
      Rte_Ev_Run_StartApplication_StartApplication_Cyclic1000ms
      Rte_Ev_Run_StartApplication_StartApplication_Cyclic10ms
      Rte_Ev_Run_StartApplication_StartApplication_Cyclic1ms
      Rte_Ev_Run_StartApplication_StartApplication_Cyclic250ms
      Rte_Ev_Run_StartApplication_StartApplication_OnDataRec_RxCtrl
      Rte_Ev_Run_StartApplication_StartApplication_OnDataRec_RxData
    Rte_Al_TE_AppCom_RWsignal (OsAlarm): OsAlarmCounterRef=SystemTimer, OsAlarmAccessingApplication=SystemApplication_OsCore_Core0
      OsAlarmAction
        OsAlarmSetEvent: OsAlarmSetEventRef=Rte_Ev_Run_AppCom_RWsignal, OsAlarmSetEventTaskRef=Default_Appl_Task
    Rte_Ev_Run_AppCom_RWsignal (OsEvent)
  module config EcuC: implementation-config-variant=VARIANT-PRE-COMPILE, module-description=EcuC_Impl
    EcucGeneral:
      CPUType = CPU32Bit
      SizeOfInt = Size32Bit
      ByteOrder = LITTLE_ENDIAN
      BitOrder = LSB_to_MSB
      AtomicBitAccessInBitfield = false
      AtomicVariableAccess = Atomic32BitAccess
      SizeOfEnum = Size8Bit
      SizeOfROMPointer = Size32Bit
      SizeOfRAMPointer = Size32Bit
      BitFieldDataType = INT
      StructAlignment = Auto
      ArrayAlignment = Align8Bit
      StructInArrayAlignment = Auto
      DummyFunction = false
      EcuCSafeBswChecks = false
      DummyStatement = true
      DummyStatementKind = None
      ConditionalGenerating = true
      EcucBswImplementationCodeType = EcuCSourceCode
      EcuCUseStdReturnTypeForRte = false
      PostbuildLoadable: AlignmentFillPattern=90, PBROMStartAddress=0, PBRAMStartAddress=0, PBROMEndAddress=0, PBRAMEndAddress=0
      BswInitialization
        27 x InitFunction:
          BswM_Init: Header=BswM.h, InitPhase=NO_INIT, ConfigType=BswM_ConfigType, ConfigPtrName=BswM_Config_Ptr, ConfigPtrClass=BSWM_INIT_DATA, ModuleRef=BswM
          BswM_InitMemory: Header=BswM.h, InitPhase=INIT_MEMORY, ModuleRef=BswM
          CanIf_InitMemory: Header=CanIf.h, InitPhase=INIT_MEMORY, ModuleRef=CanIf
          CanIf_Init: Header=CanIf.h, InitPhase=INIT_TWO_IF, ConfigType=CanIf_ConfigType, ConfigPtrName=CanIf_Config_Ptr, ConfigPtrClass=CANIF_INIT_DATA, ModuleRef=CanIf
          CanSM_Init: Header=CanSM_EcuM.h, InitPhase=INIT_TWO_SM, ConfigType=CanSM_ConfigType, ConfigPtrName=CanSM_Config_Ptr, ConfigPtrClass=CANSM_INIT_DATA, ModuleRef=CanSM
          CanSM_InitMemory: Header=CanSM_EcuM.h, InitPhase=INIT_MEMORY, ModuleRef=CanSM
          Can_InitMemory: Header=Can.h, InitPhase=INIT_MEMORY, ModuleRef=Can
          Can_Init: Header=Can.h, InitPhase=INIT_TWO_DRV, ConfigType=Can_ConfigType, ConfigPtrName=Can_Config_Ptr, ConfigPtrClass=CAN_INIT_DATA, ModuleRef=Can
          ComM_InitMemory: Header=ComM.h, InitPhase=INIT_MEMORY, ModuleRef=ComM
          ComM_Init: Header=ComM.h, InitPhase=INIT_TWO_POST_NVMREADALL, ModuleRef=ComM
          Com_InitMemory: Header=Com.h, InitPhase=INIT_MEMORY, ModuleRef=Com
          Com_Init: Header=Com.h, InitPhase=INIT_TWO_COM, ConfigType=Com_ConfigType, ConfigPtrName=Com_Config_Ptr, ConfigPtrClass=COM_INIT_DATA, ModuleRef=Com
          Det_InitMemory: Header=Det.h, InitPhase=INIT_MEMORY, ModuleRef=Det
          Det_Init: Header=Det.h, InitPhase=INIT_ZERO, ConfigType=Det_ConfigType, ConfigPtrName=Det_Config_Ptr, ConfigPtrClass=DET_INIT_DATA, ModuleRef=Det
          EcuM_Init: Header=EcuM.h, InitPhase=NO_INIT, ConfigType=EcuM_PbConfigType, ConfigPtrName=EcuM_Config_Ptr, ConfigPtrClass=ECUM_INIT_DATA, ModuleRef=EcuM
          PduR_Init: Header=PduR.h, InitPhase=INIT_TWO_COM, ConfigType=PduR_PBConfigType, ConfigPtrName=PduR_Config_Ptr, ConfigPtrClass=PDUR_INIT_DATA, ModuleRef=PduR
          PduR_InitMemory: Header=PduR.h, InitPhase=INIT_MEMORY, ModuleRef=PduR
          Rte_InitMemory: Header=Rte_Main.h, InitPhase=INIT_MEMORY, ModuleRef=Rte
          SchM_Init: Header=Rte_Main.h, InitPhase=NO_INIT, ModuleRef=Rte
          Mcu_Init: Header=Mcu.h, InitPhase=INIT_ONE_EARLY, ConfigType=Mcu_ConfigType, ConfigPtrName=Mcu_ConfigRoot, ConfigPtrClass=const, ModuleRef=Mcu
          Dio_Init: Header=Dio.h, InitPhase=INIT_ONE, ConfigType=Dio_ConfigType, ConfigPtrName=Dio_ConfigRoot, ConfigPtrClass=const, ModuleRef=Dio
          Port_Init: Header=Port.h, InitPhase=INIT_ONE_EARLY, ConfigType=Port_ConfigType, ConfigPtrName=Port_ConfigRoot, ConfigPtrClass=const, ModuleRef=Port
          Dcm_Init: Header=Dcm.h, InitPhase=INIT_TWO_POST_NVMREADALL, ConfigType=Dcm_ConfigType, ConfigPtrName=NULL_PTR, ConfigPtrClass=DCM_CONST, ModuleRef=Dcm
          Dcm_InitMemory: Header=Dcm.h, InitPhase=INIT_MEMORY, ModuleRef=Dcm
          Dem_InitMemory: Header=Dem.h, InitPhase=INIT_MEMORY, ModuleRef=Dem
          Dem_PreInit: Header=Dem.h, InitPhase=INIT_ZERO, ConfigType=Dem_ConfigType, ConfigPtrName=Dem_Config_Ptr, ConfigPtrClass=DEM_INIT_DATA, ModuleRef=Dem
          Dem_Init: Header=Dem.h, InitPhase=INIT_TWO_POST_NVMREADALL, ConfigType=Dem_ConfigType, ConfigPtrName=Dem_Config_Ptr, ConfigPtrClass=DEM_INIT_DATA, ModuleRef=Dem
    EcucHardware
      Core0 (EcucCoreDefinition): EcucCoreId=0
    EcucPduCollection: PduIdTypeEnum=UINT8, PduLengthTypeEnum=UINT16
      6 x Pdu, all with J1939Requestable=false:
        PT_msg_MyECU_Lamp_PP_msg_MyECU_Lamp_Tx_0fb271d2_5e566ad9: PduLength=8, SysTPduToFrameMappingRef=msg_MyECU_Lamp  # msg_MyECU_Lamp_oCAN00
        PT_msg_Receive_PP_msg_Receive_Rx_0fb271d2_5e566ad9: PduLength=1, SysTPduToFrameMappingRef=msg_Receive  # msg_Receive_oCAN00
        PT_msg_Transmit_PP_msg_Transmit_Tx_0fb271d2_5e566ad9: PduLength=1, SysTPduToFrameMappingRef=msg_Transmit  # msg_Transmit_oCAN00
        PT_msg_NM_MyECU_PP_msg_NM_MyECU_Tx_0fb271d2_5e566ad9: PduLength=8, SysTPduToFrameMappingRef=msg_NM_MyECU  # msg_NM_MyECU_oCAN00
        msg_NM_RearECU_4b8e7e70: PduLength=8, SysTPduToFrameMappingRef=msg_NM_RearECU  # msg_NM_RearECU_oCAN00
        NmUsrData_msg_NM_MyECU_oCAN00_3abd61be: PduLength=(unset)  # msg_NM_MyECU_oCAN00
  module config Com: implementation-config-variant=VARIANT-PRE-COMPILE, module-description=Com_Impl
    ComGeneration:
      ComOutOfBoundsWriteProtectionStrategy = NONE
      ComOutOfBoundsWriteSanitizer = false
      ComOutOfBoundsReadSanitizer = false
      ComReduceConstantData2Define = false
      ComBoolDataInArrayOfStructStrategy = BOOLEAN
      ComDeduplicateIndirectedData = true
      ComDataDeduplicationStrategy = WITH_CAST
      ComReduceBoolDataByNegationThreshold = 2
      ComReduceBoolDataByNumericalComparisonThreshold = 2
      ComReduceBoolDataByNumericalRelationThreshold = 2
      ComReduceBoolDataByNumericalOperandStrategy = WITH_ANY_VALUE
      ComReduceNumericalDataByOffsetThreshold = 2
      ComReduceNumericalDataByArraySubtractionThreshold = 2
      ComReduceDataByStreaming = false
      ComShortSymbols = false
      ComInterfacesForDeactivatedData = false
      ComReferringKeysInComments = false
    ComOptimization:
      ComTxCyclicProcessingISRLockThreshold = 1
      ComTxDeadlineMonitoringISRLockThreshold = 1
      ComTxProcessingISRLockThreshold = 1
      ComRxDeadlineMonitoringISRLockThreshold = 1
      ComRxDeferredProcessingISRLockThreshold = 1
      ComGatewayProcessingISRLockThreshold = 1
      ComGatewayDescriptionProcessingISRLockThreshold = 1
      ComIPduGroupISRLockThreshold = 1
    ComConfig: ComConfigurationId=0, ComRxDeferredNotificationCacheSize=0, ComRxImmediateNotificationCacheSize=0
      ComTimeBase: ComRxTimeBase=0.01, ComTxTimeBase=0.01, ComGwTimeBase=0.01
      msg_MyECU_Lamp_oCAN00_3abd61be (ComIPdu):
        ComIPduDirection = SEND
        ComIPduType = NORMAL
        ComIPduHandleId = 0
        ComIPduSignalProcessing = DEFERRED
        ComIPduCancellationSupport = false
        ComIPduGroupRef = MyECU_oCAN00_Tx_fcef2243
        ComIPduSignalRef = sig_LampCnt_818e1651
        ComPduIdRef = PT_msg_MyECU_Lamp_PP_msg_MyECU_Lamp_Tx_0fb271d2_5e566ad9
        ComTxIPdu: ComMinimumDelayTime=0, ComTxIPduUnusedAreasDefault=0
          ComTxModeTrue
            ComTxMode: ComTxModeMode=PERIODIC, ComTxModeTimeOffset=0, ComTxModeTimePeriod=0.1
          ComTxModeFalse
            ComTxMode: ComTxModeMode=PERIODIC, ComTxModeTimeOffset=0, ComTxModeTimePeriod=0.1
      msg_Receive_oCAN00_3abd61be (ComIPdu):
        ComIPduDirection = RECEIVE
        ComIPduType = NORMAL
        ComIPduHandleId = 0
        ComIPduSignalProcessing = DEFERRED
        ComIPduCancellationSupport = false
        ComIPduGroupRef = MyECU_oCAN00_Rx_fcef2243
        ComIPduSignalRef = sig_State_RearInteriorLight_2b456e3f
        ComIPduSignalRef = sig_State_RearLeftDoor_2b456e3f
        ComIPduSignalRef = sig_State_RearRightDoor_2b456e3f
        ComPduIdRef = PT_msg_Receive_PP_msg_Receive_Rx_0fb271d2_5e566ad9
      MyECU_oCAN00_Rx_fcef2243 (ComIPduGroup): ComIPduGroupHandleId=0
      sig_LampCnt_818e1651 (ComSignal):
        ComBitPosition = 7
        ComBitSize = 8
        ComSignalEndianness = BIG_ENDIAN
        ComSignalInitValue = 0
        ComSignalType = UINT8
        ComTransferProperty = PENDING
        ComSignalAccess = ACCESS_UNCLEAR
        ComHandleId = 0
        ComSystemTemplateSystemSignalRef = sig_LampCnt
      sig_State_RearLeftDoor_2b456e3f (ComSignal):
        ComBitPosition = 0
        ComBitSize = 1
        ComSignalEndianness = LITTLE_ENDIAN
        ComSignalInitValue = 0
        ComSignalType = BOOLEAN
        ComTimeout = 0
        ComSignalAccess = ACCESS_UNCLEAR
        ComHandleId = 1
        ComSystemTemplateSystemSignalRef = sig_State_RearLeftDoor
      msg_Transmit_oCAN00_3abd61be (ComIPdu):
        ComIPduDirection = SEND
        ComIPduType = NORMAL
        ComIPduHandleId = 2
        ComIPduSignalProcessing = DEFERRED
        ComIPduCancellationSupport = false
        ComIPduGroupRef = MyECU_oCAN00_Tx_fcef2243
        ComIPduSignalRef = sig_RearInteriorLight_0723e95e
        ComPduIdRef = PT_msg_Transmit_PP_msg_Transmit_Tx_0fb271d2_5e566ad9
        ComTxIPdu: ComMinimumDelayTime=0, ComTxIPduUnusedAreasDefault=0
          ComTxModeTrue
            ComTxMode: ComTxModeMode=PERIODIC, ComTxModeTimeOffset=0, ComTxModeTimePeriod=0.1
          ComTxModeFalse
            ComTxMode: ComTxModeMode=PERIODIC, ComTxModeTimeOffset=0, ComTxModeTimePeriod=0.1
      sig_State_RearInteriorLight_2b456e3f (ComSignal):
        ComBitPosition = 2
        ComBitSize = 1
        ComSignalEndianness = LITTLE_ENDIAN
        ComSignalInitValue = 0
        ComSignalType = BOOLEAN
        ComTimeout = 0
        ComSignalAccess = ACCESS_UNCLEAR
        ComHandleId = 0
        ComSystemTemplateSystemSignalRef = sig_State_RearInteriorLight
      MyECU_oCAN00_Tx_fcef2243 (ComIPduGroup): ComIPduGroupHandleId=1
      6 x ComSignal, all with ComSignalEndianness=LITTLE_ENDIAN, ComSignalInitValue=0, ComSignalAccess=ACCESS_UNCLEAR:
        sig_RearInteriorLight_0723e95e: ComBitPosition=0, ComBitSize=1, ComSignalType=BOOLEAN, ComTransferProperty=PENDING, ComHandleId=7, ComSystemTemplateSystemSignalRef=sig_RearInteriorLight
        sig_State_RearRightDoor_2b456e3f: ComBitPosition=1, ComBitSize=1, ComSignalType=BOOLEAN, ComTimeout=0, ComHandleId=2, ComSystemTemplateSystemSignalRef=sig_State_RearRightDoor
        sig_NM_MyECU_UserData_4_d71a6287: ComBitPosition=48, ComBitSize=8, ComSignalType=UINT8, ComTransferProperty=PENDING, ComHandleId=5, ComSystemTemplateSystemSignalRef=sig_NM_MyECU_UserData_4
        sig_NM_MyECU_UserData_1_d71a6287: ComBitPosition=24, ComBitSize=8, ComSignalType=UINT8, ComTransferProperty=PENDING, ComHandleId=2, ComSystemTemplateSystemSignalRef=sig_NM_MyECU_UserData_1
        sig_NM_MyECU_UserData_0_d71a6287: ComBitPosition=16, ComBitSize=8, ComSignalType=UINT8, ComTransferProperty=PENDING, ComHandleId=1, ComSystemTemplateSystemSignalRef=sig_NM_MyECU_UserData_0
        sig_NM_MyECU_UserData_3_d71a6287: ComBitPosition=40, ComBitSize=8, ComSignalType=UINT8, ComTransferProperty=PENDING, ComHandleId=4, ComSystemTemplateSystemSignalRef=sig_NM_MyECU_UserData_3
      msg_NM_MyECU_oCAN00_3abd61be (ComIPdu):
        ComIPduDirection = SEND
        ComIPduType = NORMAL
        ComIPduHandleId = 1
        ComIPduSignalProcessing = DEFERRED
        ComIPduCancellationSupport = false
        ComIPduSignalRef = sig_NM_MyECU_UserData_{0..5}_d71a6287
        ComPduIdRef = NmUsrData_msg_NM_MyECU_oCAN00_3abd61be
        ComTxIPdu: ComTxIPduUnusedAreasDefault=0, ComMinimumDelayTime=0
          ComTxModeTrue
            ComTxMode: ComTxModeMode=NONE
          ComTxModeFalse
            ComTxMode: ComTxModeMode=NONE
      sig_NM_MyECU_UserData_5_d71a6287 (ComSignal):
        ComBitPosition = 56
        ComBitSize = 8
        ComSignalEndianness = LITTLE_ENDIAN
        ComSignalInitValue = 0
        ComSignalType = UINT8
        ComTransferProperty = PENDING
        ComSignalAccess = ACCESS_UNCLEAR
        ComHandleId = 6
        ComSystemTemplateSystemSignalRef = sig_NM_MyECU_UserData_5
      sig_NM_MyECU_UserData_2_d71a6287 (ComSignal):
        ComBitPosition = 32
        ComBitSize = 8
        ComSignalEndianness = LITTLE_ENDIAN
        ComSignalInitValue = 0
        ComSignalType = UINT8
        ComTransferProperty = PENDING
        ComSignalAccess = ACCESS_UNCLEAR
        ComHandleId = 3
        ComSystemTemplateSystemSignalRef = sig_NM_MyECU_UserData_2
    ComGeneral:
      ComConfigurationUseDet = true
      ComEnableSignalGroupArrayApi = false
      ComRetryFailedTransmitRequests = true
      ComSupportedIPduGroups = 2
      ComVersionInfoApi = false
      ComAdvancedIPduCallouts = true
      ComOptimizedIPduGroupHandling = false
      ComMetaDataSupport = false
      ComReceiveSignalMacroAPI = false
      ComDeferredEventCacheSupport = false
      ComMainfunctionTimingDomainSupport = false
      ComDescriptionRoutingCodeGeneration = false
      ComSafeBswChecks = false
  module config Rte: implementation-config-variant=VARIANT-PRE-COMPILE, module-description=Rte_Impl
    RteInitializationBehavior: RteInitializationStrategy=RTE_INITIALIZATION_STRATEGY_AT_DATA_DECLARATION, RteSectionInitializationPolicy=INIT
    RteGeneration:
      RteGenerationMode = COMPATIBILITY_MODE
      RteIocInteractionReturnValue = RTE_IOC
      RteValueRangeCheckEnabled = false
      RteCalibrationSupport = INITIALIZED_RAM
      RteCodeVendorId = 30
      RteDevErrorDetect = true
      RteDevErrorDetectUninit = false
      RteMeasurementSupport = false
      RteOptimizationMode = MEMORY
      RteVfbTraceEnabled = false
      RteXcpEventSupport = false
    RteBswGeneral: RteSchMVersionInfoApi=false, RteUseComShadowSignalApi=false
    RteOsInteraction
      7 x RteUsedOsActivation, all with RteExpectedActivationOffset=0, RteExpectedTickDuration=0:
        Rte_Al_TE2_Default_BSW_Async_Task_0_10ms: RteActivationOsAlarmRef=Os/Rte_Al_TE2_Default_BSW_Async_Task_0_10ms, RteActivationOsTaskRef=Default_BSW_Async_Task
        Rte_Al_TE2_Default_BSW_Async_Task_0_20ms: RteActivationOsAlarmRef=Os/Rte_Al_TE2_Default_BSW_Async_Task_0_20ms, RteActivationOsTaskRef=Default_BSW_Async_Task
        Rte_Al_TE_StartApplication_StartApplication_Cyclic1000ms: RteActivationOsAlarmRef=Os/Rte_Al_TE_StartApplication_StartApplication_Cyclic1000ms, RteActivationOsTaskRef=Default_Appl_Task
        Rte_Al_TE_StartApplication_StartApplication_Cyclic10ms: RteActivationOsAlarmRef=Os/Rte_Al_TE_StartApplication_StartApplication_Cyclic10ms, RteActivationOsTaskRef=Default_Appl_Task
        Rte_Al_TE_StartApplication_StartApplication_Cyclic1ms: RteActivationOsAlarmRef=Os/Rte_Al_TE_StartApplication_StartApplication_Cyclic1ms, RteActivationOsTaskRef=Default_Appl_Task
        Rte_Al_TE_StartApplication_StartApplication_Cyclic250ms: RteActivationOsAlarmRef=Os/Rte_Al_TE_StartApplication_StartApplication_Cyclic250ms, RteActivationOsTaskRef=Default_Appl_Task
        Rte_Al_TE_AppCom_RWsignal: RteActivationOsAlarmRef=Os/Rte_Al_TE_AppCom_RWsignal, RteActivationOsTaskRef=Default_Appl_Task
    10 x RteBswModuleInstance:
      BswM: RteBswImplementationRef=BswM_Impl, RteBswModuleConfigurationRef=BswM
        BswM_MainFunctionTimingEvent0 (RteBswEventToTaskMapping):
          RteBswImmediateRestart = false
          RteBswPositionInTask = 0
          RteBswEventRef = BswM_MainFunctionTimingEvent0
          RteBswMappedToTaskRef = Default_BSW_Async_Task
          RteBswUsedOsEventRef = Rte_Ev_Cyclic2_Default_BSW_Async_Task_0_10ms
          RteBswUsedOsAlarmRef = Os/Rte_Al_TE2_Default_BSW_Async_Task_0_10ms
        BSWM_EXCLUSIVE_AREA_0 (RteBswExclusiveAreaImpl): RteExclusiveAreaImplMechanism=ALL_INTERRUPT_BLOCKING, RteBswExclusiveAreaRef=BSWM_EXCLUSIVE_AREA_0
      Can: RteBswImplementationRef=Can_Impl, RteBswModuleConfigurationRef=Can
        3 x RteBswEventToTaskMapping, all with RteBswImmediateRestart=false, RteBswMappedToTaskRef=Default_BSW_Async_Task, RteBswUsedOsEventRef=Rte_Ev_Cyclic2_Default_BSW_Async_Task_0_10ms, RteBswUsedOsAlarmRef=Os/Rte_Al_TE2_Default_BSW_Async_Task_0_10ms:
          Can_MainFunction_BusOffTimingEvent0: RteBswPositionInTask=5, RteBswEventRef=Can_MainFunction_BusOffTimingEvent0
          Can_MainFunction_WakeupTimingEvent0: RteBswPositionInTask=7, RteBswEventRef=Can_MainFunction_WakeupTimingEvent0
          Can_MainFunction_ModeTimingEvent0: RteBswPositionInTask=6, RteBswEventRef=Can_MainFunction_ModeTimingEvent0
        7 x RteBswExclusiveAreaImpl, all with RteExclusiveAreaImplMechanism=ALL_INTERRUPT_BLOCKING:
          CAN_EXCLUSIVE_AREA_{0..6}: RteBswExclusiveAreaRef=CAN_EXCLUSIVE_AREA_{0..6}
        Can_MainFunction_ReadTimingEvent0 (RteBswEventToTaskMapping): RteBswImmediateRestart=false, RteBswEventRef=Can_MainFunction_ReadTimingEvent0
      CanIf: RteBswImplementationRef=CanIf_Impl, RteBswModuleConfigurationRef=CanIf
        8 x RteBswExclusiveAreaImpl, all with RteExclusiveAreaImplMechanism=ALL_INTERRUPT_BLOCKING:
          CANIF_EXCLUSIVE_AREA_{0..7}: RteBswExclusiveAreaRef=CANIF_EXCLUSIVE_AREA_{0..7}
      CanSM: RteBswImplementationRef=CanSM_Impl, RteBswModuleConfigurationRef=CanSM
        CanSM_MainFunctionTimingEvent0 (RteBswEventToTaskMapping):
          RteBswImmediateRestart = false
          RteBswPositionInTask = 2
          RteBswEventRef = CanSM_MainFunctionTimingEvent0
          RteBswMappedToTaskRef = Default_BSW_Async_Task
          RteBswUsedOsEventRef = Rte_Ev_Cyclic2_Default_BSW_Async_Task_0_10ms
          RteBswUsedOsAlarmRef = Os/Rte_Al_TE2_Default_BSW_Async_Task_0_10ms
        6 x RteBswExclusiveAreaImpl, all with RteExclusiveAreaImplMechanism=ALL_INTERRUPT_BLOCKING:
          CANSM_EXCLUSIVE_AREA_{1..6}: RteBswExclusiveAreaRef=CANSM_EXCLUSIVE_AREA_{1..6}
      Com: RteBswImplementationRef=Com_Impl, RteBswModuleConfigurationRef=Com
        Com_MainFunctionTxTimingEvent0 (RteBswEventToTaskMapping):
          RteBswImmediateRestart = false
          RteBswPositionInTask = 10
          RteBswEventRef = Com_MainFunctionTxTimingEvent0
          RteBswMappedToTaskRef = Default_BSW_Async_Task
          RteBswUsedOsEventRef = Rte_Ev_Cyclic2_Default_BSW_Async_Task_0_10ms
          RteBswUsedOsAlarmRef = Os/Rte_Al_TE2_Default_BSW_Async_Task_0_10ms
        Com_MainFunctionRxTimingEvent0 (RteBswEventToTaskMapping):
          RteBswImmediateRestart = false
          RteBswPositionInTask = 9
          RteBswEventRef = Com_MainFunctionRxTimingEvent0
          RteBswMappedToTaskRef = Default_BSW_Async_Task
          RteBswUsedOsEventRef = Rte_Ev_Cyclic2_Default_BSW_Async_Task_0_10ms
          RteBswUsedOsAlarmRef = Os/Rte_Al_TE2_Default_BSW_Async_Task_0_10ms
        3 x RteBswExclusiveAreaImpl, all with RteExclusiveAreaImplMechanism=ALL_INTERRUPT_BLOCKING:
          COM_EXCLUSIVE_AREA_TX: RteBswExclusiveAreaRef=COM_EXCLUSIVE_AREA_TX
          COM_EXCLUSIVE_AREA_RX: RteBswExclusiveAreaRef=COM_EXCLUSIVE_AREA_RX
          COM_EXCLUSIVE_AREA_BOTH: RteBswExclusiveAreaRef=COM_EXCLUSIVE_AREA_BOTH
      ComM: RteBswImplementationRef=ComM_Impl, RteBswModuleConfigurationRef=ComM
        ComM_MainFunction_0TimingEvent0 (RteBswEventToTaskMapping):
          RteBswImmediateRestart = false
          RteBswPositionInTask = 8
          RteBswEventRef = ComM_MainFunction_0TimingEvent0
          RteBswMappedToTaskRef = Default_BSW_Async_Task
          RteBswUsedOsEventRef = Rte_Ev_Cyclic2_Default_BSW_Async_Task_0_20ms
          RteBswUsedOsAlarmRef = Os/Rte_Al_TE2_Default_BSW_Async_Task_0_20ms
        COMM_EXCLUSIVE_AREA_0 (RteBswExclusiveAreaImpl): RteExclusiveAreaImplMechanism=ALL_INTERRUPT_BLOCKING, RteBswExclusiveAreaRef=COMM_EXCLUSIVE_AREA_0
        COMM_EXCLUSIVE_AREA_1 (RteBswExclusiveAreaImpl): RteExclusiveAreaImplMechanism=ALL_INTERRUPT_BLOCKING, RteBswExclusiveAreaRef=COMM_EXCLUSIVE_AREA_1
      Det: RteBswImplementationRef=Det_Impl, RteBswModuleConfigurationRef=Det
        DET_EXCLUSIVE_AREA_0 (RteBswExclusiveAreaImpl): RteExclusiveAreaImplMechanism=ALL_INTERRUPT_BLOCKING, RteBswExclusiveAreaRef=DET_EXCLUSIVE_AREA_0
      EcuM: RteBswImplementationRef=EcuM_Impl, RteBswModuleConfigurationRef=EcuM
        EcuM_MainFunctionTimingEvent0 (RteBswEventToTaskMapping):
          RteBswImmediateRestart = false
          RteBswPositionInTask = 14
          RteBswEventRef = EcuM_MainFunctionTimingEvent0
          RteBswMappedToTaskRef = Default_BSW_Async_Task
          RteBswUsedOsEventRef = Rte_Ev_Cyclic2_Default_BSW_Async_Task_0_10ms
          RteBswUsedOsAlarmRef = Os/Rte_Al_TE2_Default_BSW_Async_Task_0_10ms
        3 x RteBswExclusiveAreaImpl, all with RteExclusiveAreaImplMechanism=ALL_INTERRUPT_BLOCKING:
          ECUM_EXCLUSIVE_AREA_{0..2}: RteBswExclusiveAreaRef=ECUM_EXCLUSIVE_AREA_{0..2}
      PduR: RteBswImplementationRef=PduR_Impl, RteBswModuleConfigurationRef=PduR
        PDUR_EXCLUSIVE_AREA_0 (RteBswExclusiveAreaImpl): RteExclusiveAreaImplMechanism=ALL_INTERRUPT_BLOCKING, RteBswExclusiveAreaRef=PDUR_EXCLUSIVE_AREA_0
      Rte: RteBswImplementationRef=Rte_Impl, RteBswModuleConfigurationRef=Rte
    4 x RteSwComponentInstance:
      ComM_EcuSwComposition: RteSoftwareComponentInstanceRef=ComM
        13 x RteEventToTaskMapping, all with RteImmediateRestart=false:
          Timer_ComM_MainFunction_0: RtePositionInTask=8, RteEventRef=Timer_ComM_MainFunction_0, RteMappedToTaskRef=Default_BSW_Async_Task, RteUsedOsEventRef=Rte_Ev_Cyclic2_Default_BSW_Async_Task_0_20ms, RteUsedOsAlarmRef=Os/Rte_Al_TE2_Default_BSW_Async_Task_0_20ms
          OpEventLimitECUToNoComMode_LimitECUToNoComMode_modeLimitation: RteEventRef=OpEventLimitECUToNoComMode_LimitECUToNoComMode_modeLimitation
          OpEventReadInhibitCounter_ReadInhibitCounter_modeLimitation: RteEventRef=OpEventReadInhibitCounter_ReadInhibitCounter_modeLimitation
          OpEventResetInhibitCounter_ResetInhibitCounter_modeLimitation: RteEventRef=OpEventResetInhibitCounter_ResetInhibitCounter_modeLimitation
          OpEventSetECUGroupClassification_SetECUGroupClassification_modeLimitation: RteEventRef=OpEventSetECUGroupClassification_SetECUGroupClassification_modeLimitation
          OpEventPreventWakeUp_PreventWakeUp_CW_CAN00_f26020e5: RteEventRef=OpEventPreventWakeUp_PreventWakeUp_CW_CAN00_f26020e5
          OpEventGetMaxComMode_GetMaxComMode_UR_USR_CHNL_f276589c: RteEventRef=OpEventGetMaxComMode_GetMaxComMode_UR_USR_CHNL_f276589c
          OpEventGetInhibitionStatus_GetInhibitionStatus_CL_CAN00_f26020e5: RteEventRef=OpEventGetInhibitionStatus_GetInhibitionStatus_CL_CAN00_f26020e5
          OpEventGetCurrentComMode_GetCurrentComMode_UR_USR_CHNL_f276589c: RteEventRef=OpEventGetCurrentComMode_GetCurrentComMode_UR_USR_CHNL_f276589c
          OpEventGetInhibitionStatus_GetInhibitionStatus_CW_CAN00_f26020e5: RteEventRef=OpEventGetInhibitionStatus_GetInhibitionStatus_CW_CAN00_f26020e5
          OpEventLimitChannelToNoComMode_LimitChannelToNoComMode_CL_CAN00_f26020e5: RteEventRef=OpEventLimitChannelToNoComMode_LimitChannelToNoComMode_CL_CAN00_f26020e5
          OpEventGetRequestedComMode_GetRequestedComMode_UR_USR_CHNL_f276589c: RteEventRef=OpEventGetRequestedComMode_GetRequestedComMode_UR_USR_CHNL_f276589c
          OpEventRequestComMode_RequestComMode_UR_USR_CHNL_f276589c: RteEventRef=OpEventRequestComMode_RequestComMode_UR_USR_CHNL_f276589c
      BswM_EcuSwComposition: RteSoftwareComponentInstanceRef=BswM
        Timer_BswM_MainFunction (RteEventToTaskMapping):
          RteImmediateRestart = false
          RtePositionInTask = 0
          RteEventRef = Timer_BswM_MainFunction
          RteMappedToTaskRef = Default_BSW_Async_Task
          RteUsedOsEventRef = Rte_Ev_Cyclic2_Default_BSW_Async_Task_0_10ms
          RteUsedOsAlarmRef = Os/Rte_Al_TE2_Default_BSW_Async_Task_0_10ms
      Det_EcuSwComposition: RteSoftwareComponentInstanceRef=Det
      EcuM_EcuSwComposition: RteSoftwareComponentInstanceRef=EcuM
        8 x RteEventToTaskMapping, all with RteImmediateRestart=false:
          Timer_EcuM_MainFunction: RtePositionInTask=14, RteEventRef=Timer_EcuM_MainFunction, RteMappedToTaskRef=Default_BSW_Async_Task, RteUsedOsEventRef=Rte_Ev_Cyclic2_Default_BSW_Async_Task_0_10ms, RteUsedOsAlarmRef=Os/Rte_Al_TE2_Default_BSW_Async_Task_0_10ms
          OpEventSelectShutdownTarget_SelectShutdownTarget_EcuM_ShutdownTarget: RteEventRef=OpEventSelectShutdownTarget_SelectShutdownTarget_EcuM_ShutdownTarget
          OpEventGetShutdownTarget_GetShutdownTarget_EcuM_ShutdownTarget: RteEventRef=OpEventGetShutdownTarget_GetShutdownTarget_EcuM_ShutdownTarget
          OpEventGetLastShutdownTarget_GetLastShutdownTarget_EcuM_ShutdownTarget: RteEventRef=OpEventGetLastShutdownTarget_GetLastShutdownTarget_EcuM_ShutdownTarget
          OpEventSelectShutdownCause_SelectShutdownCause_EcuM_ShutdownTarget: RteEventRef=OpEventSelectShutdownCause_SelectShutdownCause_EcuM_ShutdownTarget
          OpEventGetShutdownCause_GetShutdownCause_EcuM_ShutdownTarget: RteEventRef=OpEventGetShutdownCause_GetShutdownCause_EcuM_ShutdownTarget
          OpEventSelectBootTarget_SelectBootTarget_EcuM_BootTarget: RteEventRef=OpEventSelectBootTarget_SelectBootTarget_EcuM_BootTarget
          OpEventGetBootTarget_GetBootTarget_EcuM_BootTarget: RteEventRef=OpEventGetBootTarget_GetBootTarget_EcuM_BootTarget
    Mcu (RteBswModuleInstance): RteBswImplementationRef=Mcu_Impl, RteBswModuleConfigurationRef=Mcu
    Os_OsCore_Core0_swc_EcuSwComposition (RteSwComponentInstance): RteSoftwareComponentInstanceRef=Os_OsCore_Core0_swc
      OpEventGetCounterValue_GetCounterValue_OsService_SystemTimer (RteEventToTaskMapping): RteImmediateRestart=false, RteEventRef=OpEventGetCounterValue_GetCounterValue_OsService_SystemTimer
      OpEventGetElapsedValue_GetElapsedValue_OsService_SystemTimer (RteEventToTaskMapping): RteImmediateRestart=false, RteEventRef=OpEventGetElapsedValue_GetElapsedValue_OsService_SystemTimer
    Dio (RteBswModuleInstance): RteBswImplementationRef=Dio_Impl, RteBswModuleConfigurationRef=Dio
    Port (RteBswModuleInstance): RteBswImplementationRef=Port_Impl, RteBswModuleConfigurationRef=Port
    StartApplication (RteSwComponentType): RteComponentTypeRef=StartApplication, RteImplementationRef=StartApplicationImplementation
      ComponentTypeCalibration (RteComponentTypeCalibration): RteCalibrationSupportEnabled=true
    StartApplication_EcuSwComposition (RteSwComponentInstance): RteSoftwareComponentInstanceRef=StartApplication
      8 x RteEventToTaskMapping, all with RteImmediateRestart=false:
        Timer_StartApplication_Cyclic1ms: RtePositionInTask=2, RteEventRef=Timer_StartApplication_Cyclic1ms, RteMappedToTaskRef=Default_Appl_Task, RteUsedOsEventRef=Rte_Ev_Run_StartApplication_StartApplication_Cyclic1ms, RteUsedOsAlarmRef=Os/Rte_Al_TE_StartApplication_StartApplication_Cyclic1ms
        Timer_StartApplication_Cyclic10ms: RtePositionInTask=1, RteEventRef=Timer_StartApplication_Cyclic10ms, RteMappedToTaskRef=Default_Appl_Task, RteUsedOsEventRef=Rte_Ev_Run_StartApplication_StartApplication_Cyclic10ms, RteUsedOsAlarmRef=Os/Rte_Al_TE_StartApplication_StartApplication_Cyclic10ms
        Timer_StartApplication_Cyclic250ms: RtePositionInTask=3, RteEventRef=Timer_StartApplication_Cyclic250ms, RteMappedToTaskRef=Default_Appl_Task, RteUsedOsEventRef=Rte_Ev_Run_StartApplication_StartApplication_Cyclic250ms, RteUsedOsAlarmRef=Os/Rte_Al_TE_StartApplication_StartApplication_Cyclic250ms
        Timer_StartApplication_Cyclic1000ms: RtePositionInTask=0, RteEventRef=Timer_StartApplication_Cyclic1000ms, RteMappedToTaskRef=Default_Appl_Task, RteUsedOsEventRef=Rte_Ev_Run_StartApplication_StartApplication_Cyclic1000ms, RteUsedOsAlarmRef=Os/Rte_Al_TE_StartApplication_StartApplication_Cyclic1000ms
        Timer_StartApplication_Init: RtePositionInTask=0, RteEventRef=Timer_StartApplication_Init, RteMappedToTaskRef=Default_Appl_Init_Task
        OpEventStartApplication_MEM_JobFinished_JobFinished_PpNvmJobFinishedPort: RteEventRef=OpEventStartApplication_MEM_JobFinished_JobFinished_PpNvmJobFinishedPort
        DataReceivedEvent_StartApplication_OnDataRec_RxCtrl_PpRxCtrl_DeSignal_Rx16bit_Cyclic_a691adb3: RtePositionInTask=4, RteEventRef=DataReceivedEvent_StartApplication_OnDataRec_RxCtrl_PpRxCtrl_DeSignal_Rx16bit_Cyclic_a691adb3, RteMappedToTaskRef=Default_Appl_Task, RteUsedOsEventRef=Rte_Ev_Run_StartApplication_StartApplication_OnDataRec_RxCtrl
        DataReceivedEvent_StartApplication_OnDataRec_RxData_PpRxData_DeSignal_Rx15bit_OnWrite_a1df81ad: RtePositionInTask=5, RteEventRef=DataReceivedEvent_StartApplication_OnDataRec_RxData_PpRxData_DeSignal_Rx15bit_OnWrite_a1df81ad, RteMappedToTaskRef=Default_Appl_Task, RteUsedOsEventRef=Rte_Ev_Run_StartApplication_StartApplication_OnDataRec_RxData
    AppCom_EcuSwComposition (RteSwComponentInstance): RteSoftwareComponentInstanceRef=AppCom
      TMT_RWsignal (RteEventToTaskMapping):
        RteImmediateRestart = false
        RtePositionInTask = 6
        RteEventRef = TMT_RWsignal
        RteMappedToTaskRef = Default_Appl_Task
        RteUsedOsEventRef = Rte_Ev_Run_AppCom_RWsignal
        RteUsedOsAlarmRef = Os/Rte_Al_TE_AppCom_RWsignal
    AppCom (RteSwComponentType): RteComponentTypeRef=AppCom, RteImplementationRef=AppCom_Implementation
      ComponentTypeCalibration (RteComponentTypeCalibration): RteCalibrationSupportEnabled=false
    Dcm (RteBswModuleInstance): RteBswImplementationRef=Dcm_Impl, RteBswModuleConfigurationRef=Dcm
      Dcm_MainFunctionTimingEvent0 (RteBswEventToTaskMapping): RteBswImmediateRestart=false, RteBswEventRef=Dcm_MainFunctionTimingEvent0
      DCM_EXCLUSIVE_AREA_0 (RteBswExclusiveAreaImpl): RteExclusiveAreaImplMechanism=ALL_INTERRUPT_BLOCKING, RteBswExclusiveAreaRef=DCM_EXCLUSIVE_AREA_0
    Dem (RteBswModuleInstance): RteBswImplementationRef=Dem_Impl, RteBswModuleConfigurationRef=Dem
      Dem_MasterMainFunctionTimingEvent0 (RteBswEventToTaskMapping): RteBswImmediateRestart=false, RteBswEventRef=Dem_MasterMainFunctionTimingEvent0
      Dem_SatelliteMainFunctionTimingEvent0 (RteBswEventToTaskMapping): RteBswImmediateRestart=false, RteBswEventRef=Dem_SatelliteMainFunctionTimingEvent0
      4 x RteBswExclusiveAreaImpl, all with RteExclusiveAreaImplMechanism=ALL_INTERRUPT_BLOCKING:
        DEM_EXCLUSIVE_AREA_{0..3}: RteBswExclusiveAreaRef=DEM_EXCLUSIVE_AREA_{0..3}
    DemMaster_0_EcuSwComposition (RteSwComponentInstance): RteSoftwareComponentInstanceRef=DemMaster_0
      23 x RteEventToTaskMapping, all with RteImmediateRestart=false:
        Timer_Dem_MasterMainFunction: RteEventRef=Timer_Dem_MasterMainFunction
        OpEventPostRunRequested_GetPostRunRequested_DemServices: RteEventRef=OpEventPostRunRequested_GetPostRunRequested_DemServices
        OpEventGetDTCStatusAvailabilityMask_GetDTCStatusAvailabilityMask_DemServices: RteEventRef=OpEventGetDTCStatusAvailabilityMask_GetDTCStatusAvailabilityMask_DemServices
        OpEventGetIndicatorStatus_GetIndicatorStatus_IndStatus_WarningIndicator: RteEventRef=OpEventGetIndicatorStatus_GetIndicatorStatus_IndStatus_WarningIndicator
        OpEventGetEventUdsStatus_GetEventUdsStatus_GeneralEventInfo: RteEventRef=OpEventGetEventUdsStatus_GetEventUdsStatus_GeneralEventInfo
        OpEventGetEventStatus_GetEventStatus_GeneralEventInfo: RteEventRef=OpEventGetEventStatus_GetEventStatus_GeneralEventInfo
        OpEventGetEventFailed_GetEventFailed_GeneralEventInfo: RteEventRef=OpEventGetEventFailed_GetEventFailed_GeneralEventInfo
        OpEventGetEventTested_GetEventTested_GeneralEventInfo: RteEventRef=OpEventGetEventTested_GetEventTested_GeneralEventInfo
        OpEventGetDTCOfEvent_GetDTCOfEvent_GeneralEventInfo: RteEventRef=OpEventGetDTCOfEvent_GetDTCOfEvent_GeneralEventInfo
        OpEventGetFaultDetectionCounter_GetFaultDetectionCounter_GeneralEventInfo: RteEventRef=OpEventGetFaultDetectionCounter_GetFaultDetectionCounter_GeneralEventInfo
        OpEventGetEventFreezeFrameDataEx_GetEventFreezeFrameDataEx_GeneralEventInfo: RteEventRef=OpEventGetEventFreezeFrameDataEx_GetEventFreezeFrameDataEx_GeneralEventInfo
        OpEventGetEventExtendedDataRecordEx_GetEventExtendedDataRecordEx_GeneralEventInfo: RteEventRef=OpEventGetEventExtendedDataRecordEx_GetEventExtendedDataRecordEx_GeneralEventInfo
        OpEventGetEventEnableCondition_GetEventEnableCondition_GeneralEventInfo: RteEventRef=OpEventGetEventEnableCondition_GetEventEnableCondition_GeneralEventInfo
        OpEventGetDebouncingOfEvent_GetDebouncingOfEvent_GeneralEventInfo: RteEventRef=OpEventGetDebouncingOfEvent_GetDebouncingOfEvent_GeneralEventInfo
        OpEventGetMonitorStatus_GetMonitorStatus_GeneralEventInfo: RteEventRef=OpEventGetMonitorStatus_GetMonitorStatus_GeneralEventInfo
        OpEventGetOperationCycleState_GetOperationCycleState_OpCycle_IgnitionCycle: RteEventRef=OpEventGetOperationCycleState_GetOperationCycleState_OpCycle_IgnitionCycle
        OpEventGetOperationCycleState_GetOperationCycleState_OpCycle_OBDDrivingCycle: RteEventRef=OpEventGetOperationCycleState_GetOperationCycleState_OpCycle_OBDDrivingCycle
        OpEventGetOperationCycleState_GetOperationCycleState_OpCycle_PowerCycle: RteEventRef=OpEventGetOperationCycleState_GetOperationCycleState_OpCycle_PowerCycle
        OpEventGetOperationCycleState_GetOperationCycleState_OpCycle_WarmUpCycle: RteEventRef=OpEventGetOperationCycleState_GetOperationCycleState_OpCycle_WarmUpCycle
        OpEventSetOperationCycleState_SetOperationCycleState_OpCycle_IgnitionCycle: RteEventRef=OpEventSetOperationCycleState_SetOperationCycleState_OpCycle_IgnitionCycle
        OpEventSetOperationCycleState_SetOperationCycleState_OpCycle_OBDDrivingCycle: RteEventRef=OpEventSetOperationCycleState_SetOperationCycleState_OpCycle_OBDDrivingCycle
        OpEventSetOperationCycleState_SetOperationCycleState_OpCycle_PowerCycle: RteEventRef=OpEventSetOperationCycleState_SetOperationCycleState_OpCycle_PowerCycle
        OpEventSetOperationCycleState_SetOperationCycleState_OpCycle_WarmUpCycle: RteEventRef=OpEventSetOperationCycleState_SetOperationCycleState_OpCycle_WarmUpCycle
    DemSatellite_0_EcuSwComposition (RteSwComponentInstance): RteSoftwareComponentInstanceRef=DemSatellite_0
      56 x RteEventToTaskMapping, all with RteImmediateRestart=false:
        Timer_Dem_SatelliteMainFunction: RteEventRef=Timer_Dem_SatelliteMainFunction
        OpEventGetEventUdsStatus_GetEventUdsStatus_EvtInfo_DTC_0x000002: RteEventRef=OpEventGetEventUdsStatus_GetEventUdsStatus_EvtInfo_DTC_0x000002
        OpEventGetEventUdsStatus_GetEventUdsStatus_Event_DTC_0x000002: RteEventRef=OpEventGetEventUdsStatus_GetEventUdsStatus_Event_DTC_0x000002
        OpEventGetEventUdsStatus_GetEventUdsStatus_EvtInfo_DTC_0x000003: RteEventRef=OpEventGetEventUdsStatus_GetEventUdsStatus_EvtInfo_DTC_0x000003
        OpEventGetEventUdsStatus_GetEventUdsStatus_Event_DTC_0x000003: RteEventRef=OpEventGetEventUdsStatus_GetEventUdsStatus_Event_DTC_0x000003
        OpEventGetEventUdsStatus_GetEventUdsStatus_GeneralEventInfo: RteEventRef=OpEventGetEventUdsStatus_GetEventUdsStatus_GeneralEventInfo
        OpEventGetEventStatus_GetEventStatus_EvtInfo_DTC_0x000002: RteEventRef=OpEventGetEventStatus_GetEventStatus_EvtInfo_DTC_0x000002
        OpEventGetEventStatus_GetEventStatus_Event_DTC_0x000002: RteEventRef=OpEventGetEventStatus_GetEventStatus_Event_DTC_0x000002
        OpEventGetEventStatus_GetEventStatus_EvtInfo_DTC_0x000003: RteEventRef=OpEventGetEventStatus_GetEventStatus_EvtInfo_DTC_0x000003
        OpEventGetEventStatus_GetEventStatus_Event_DTC_0x000003: RteEventRef=OpEventGetEventStatus_GetEventStatus_Event_DTC_0x000003
        OpEventGetEventStatus_GetEventStatus_GeneralEventInfo: RteEventRef=OpEventGetEventStatus_GetEventStatus_GeneralEventInfo
        OpEventGetEventFailed_GetEventFailed_EvtInfo_DTC_0x000002: RteEventRef=OpEventGetEventFailed_GetEventFailed_EvtInfo_DTC_0x000002
        OpEventGetEventFailed_GetEventFailed_Event_DTC_0x000002: RteEventRef=OpEventGetEventFailed_GetEventFailed_Event_DTC_0x000002
        OpEventGetEventFailed_GetEventFailed_EvtInfo_DTC_0x000003: RteEventRef=OpEventGetEventFailed_GetEventFailed_EvtInfo_DTC_0x000003
        OpEventGetEventFailed_GetEventFailed_Event_DTC_0x000003: RteEventRef=OpEventGetEventFailed_GetEventFailed_Event_DTC_0x000003
        OpEventGetEventFailed_GetEventFailed_GeneralEventInfo: RteEventRef=OpEventGetEventFailed_GetEventFailed_GeneralEventInfo
        OpEventGetEventTested_GetEventTested_EvtInfo_DTC_0x000002: RteEventRef=OpEventGetEventTested_GetEventTested_EvtInfo_DTC_0x000002
        OpEventGetEventTested_GetEventTested_Event_DTC_0x000002: RteEventRef=OpEventGetEventTested_GetEventTested_Event_DTC_0x000002
        OpEventGetEventTested_GetEventTested_EvtInfo_DTC_0x000003: RteEventRef=OpEventGetEventTested_GetEventTested_EvtInfo_DTC_0x000003
        OpEventGetEventTested_GetEventTested_Event_DTC_0x000003: RteEventRef=OpEventGetEventTested_GetEventTested_Event_DTC_0x000003
        OpEventGetEventTested_GetEventTested_GeneralEventInfo: RteEventRef=OpEventGetEventTested_GetEventTested_GeneralEventInfo
        OpEventGetDTCOfEvent_GetDTCOfEvent_EvtInfo_DTC_0x000002: RteEventRef=OpEventGetDTCOfEvent_GetDTCOfEvent_EvtInfo_DTC_0x000002
        OpEventGetDTCOfEvent_GetDTCOfEvent_Event_DTC_0x000002: RteEventRef=OpEventGetDTCOfEvent_GetDTCOfEvent_Event_DTC_0x000002
        OpEventGetDTCOfEvent_GetDTCOfEvent_EvtInfo_DTC_0x000003: RteEventRef=OpEventGetDTCOfEvent_GetDTCOfEvent_EvtInfo_DTC_0x000003
        OpEventGetDTCOfEvent_GetDTCOfEvent_Event_DTC_0x000003: RteEventRef=OpEventGetDTCOfEvent_GetDTCOfEvent_Event_DTC_0x000003
        OpEventGetDTCOfEvent_GetDTCOfEvent_GeneralEventInfo: RteEventRef=OpEventGetDTCOfEvent_GetDTCOfEvent_GeneralEventInfo
        OpEventGetFaultDetectionCounter_GetFaultDetectionCounter_EvtInfo_DTC_0x000002: RteEventRef=OpEventGetFaultDetectionCounter_GetFaultDetectionCounter_EvtInfo_DTC_0x000002
        OpEventGetFaultDetectionCounter_GetFaultDetectionCounter_Event_DTC_0x000002: RteEventRef=OpEventGetFaultDetectionCounter_GetFaultDetectionCounter_Event_DTC_0x000002
        OpEventGetFaultDetectionCounter_GetFaultDetectionCounter_EvtInfo_DTC_0x000003: RteEventRef=OpEventGetFaultDetectionCounter_GetFaultDetectionCounter_EvtInfo_DTC_0x000003
        OpEventGetFaultDetectionCounter_GetFaultDetectionCounter_Event_DTC_0x000003: RteEventRef=OpEventGetFaultDetectionCounter_GetFaultDetectionCounter_Event_DTC_0x000003
        OpEventGetFaultDetectionCounter_GetFaultDetectionCounter_GeneralEventInfo: RteEventRef=OpEventGetFaultDetectionCounter_GetFaultDetectionCounter_GeneralEventInfo
        OpEventGetEventFreezeFrameDataEx_GetEventFreezeFrameDataEx_EvtInfo_DTC_0x000002: RteEventRef=OpEventGetEventFreezeFrameDataEx_GetEventFreezeFrameDataEx_EvtInfo_DTC_0x000002
        OpEventGetEventFreezeFrameDataEx_GetEventFreezeFrameDataEx_Event_DTC_0x000002: RteEventRef=OpEventGetEventFreezeFrameDataEx_GetEventFreezeFrameDataEx_Event_DTC_0x000002
        OpEventGetEventFreezeFrameDataEx_GetEventFreezeFrameDataEx_EvtInfo_DTC_0x000003: RteEventRef=OpEventGetEventFreezeFrameDataEx_GetEventFreezeFrameDataEx_EvtInfo_DTC_0x000003
        OpEventGetEventFreezeFrameDataEx_GetEventFreezeFrameDataEx_Event_DTC_0x000003: RteEventRef=OpEventGetEventFreezeFrameDataEx_GetEventFreezeFrameDataEx_Event_DTC_0x000003
        OpEventGetEventFreezeFrameDataEx_GetEventFreezeFrameDataEx_GeneralEventInfo: RteEventRef=OpEventGetEventFreezeFrameDataEx_GetEventFreezeFrameDataEx_GeneralEventInfo
        OpEventGetEventExtendedDataRecordEx_GetEventExtendedDataRecordEx_EvtInfo_DTC_0x000002: RteEventRef=OpEventGetEventExtendedDataRecordEx_GetEventExtendedDataRecordEx_EvtInfo_DTC_0x000002
        OpEventGetEventExtendedDataRecordEx_GetEventExtendedDataRecordEx_Event_DTC_0x000002: RteEventRef=OpEventGetEventExtendedDataRecordEx_GetEventExtendedDataRecordEx_Event_DTC_0x000002
        OpEventGetEventExtendedDataRecordEx_GetEventExtendedDataRecordEx_EvtInfo_DTC_0x000003: RteEventRef=OpEventGetEventExtendedDataRecordEx_GetEventExtendedDataRecordEx_EvtInfo_DTC_0x000003
        OpEventGetEventExtendedDataRecordEx_GetEventExtendedDataRecordEx_Event_DTC_0x000003: RteEventRef=OpEventGetEventExtendedDataRecordEx_GetEventExtendedDataRecordEx_Event_DTC_0x000003
        OpEventGetEventExtendedDataRecordEx_GetEventExtendedDataRecordEx_GeneralEventInfo: RteEventRef=OpEventGetEventExtendedDataRecordEx_GetEventExtendedDataRecordEx_GeneralEventInfo
        OpEventGetEventEnableCondition_GetEventEnableCondition_EvtInfo_DTC_0x000002: RteEventRef=OpEventGetEventEnableCondition_GetEventEnableCondition_EvtInfo_DTC_0x000002
        OpEventGetEventEnableCondition_GetEventEnableCondition_EvtInfo_DTC_0x000003: RteEventRef=OpEventGetEventEnableCondition_GetEventEnableCondition_EvtInfo_DTC_0x000003
        OpEventGetEventEnableCondition_GetEventEnableCondition_GeneralEventInfo: RteEventRef=OpEventGetEventEnableCondition_GetEventEnableCondition_GeneralEventInfo
        OpEventGetDebouncingOfEvent_GetDebouncingOfEvent_EvtInfo_DTC_0x000002: RteEventRef=OpEventGetDebouncingOfEvent_GetDebouncingOfEvent_EvtInfo_DTC_0x000002
        OpEventGetDebouncingOfEvent_GetDebouncingOfEvent_EvtInfo_DTC_0x000003: RteEventRef=OpEventGetDebouncingOfEvent_GetDebouncingOfEvent_EvtInfo_DTC_0x000003
        OpEventGetDebouncingOfEvent_GetDebouncingOfEvent_GeneralEventInfo: RteEventRef=OpEventGetDebouncingOfEvent_GetDebouncingOfEvent_GeneralEventInfo
        OpEventGetMonitorStatus_GetMonitorStatus_EvtInfo_DTC_0x000002: RteEventRef=OpEventGetMonitorStatus_GetMonitorStatus_EvtInfo_DTC_0x000002
        OpEventGetMonitorStatus_GetMonitorStatus_EvtInfo_DTC_0x000003: RteEventRef=OpEventGetMonitorStatus_GetMonitorStatus_EvtInfo_DTC_0x000003
        OpEventGetMonitorStatus_GetMonitorStatus_GeneralEventInfo: RteEventRef=OpEventGetMonitorStatus_GetMonitorStatus_GeneralEventInfo
        OpEventSetEventStatus_SetEventStatus_Event_DTC_0x000002: RteEventRef=OpEventSetEventStatus_SetEventStatus_Event_DTC_0x000002
        OpEventSetEventStatus_SetEventStatus_Event_DTC_0x000003: RteEventRef=OpEventSetEventStatus_SetEventStatus_Event_DTC_0x000003
        OpEventResetEventStatus_ResetEventStatus_Event_DTC_0x000002: RteEventRef=OpEventResetEventStatus_ResetEventStatus_Event_DTC_0x000002
        OpEventResetEventStatus_ResetEventStatus_Event_DTC_0x000003: RteEventRef=OpEventResetEventStatus_ResetEventStatus_Event_DTC_0x000003
        OpEventResetEventDebounceStatus_ResetEventDebounceStatus_Event_DTC_0x000002: RteEventRef=OpEventResetEventDebounceStatus_ResetEventDebounceStatus_Event_DTC_0x000002
        OpEventResetEventDebounceStatus_ResetEventDebounceStatus_Event_DTC_0x000003: RteEventRef=OpEventResetEventDebounceStatus_ResetEventDebounceStatus_Event_DTC_0x000003
  module config ComM: implementation-config-variant=VARIANT-PRE-COMPILE, module-description=ComM_Impl
    ComMGeneral:
      ComMPncIdCounting = COMM_PNC_ID_COUNT_FROM_NM_MESSAGE
      ComMPncSupport = false
      ComMDevErrorDetect = true
      ComMEcuGroupClassification = 3
      ComMModeLimitationEnabled = false
      ComMSynchronousWakeUp = true
      ComMTMinFullComModeDuration = 5
      ComMVersionInfoApi = false
      ComMWakeupInhibitionEnabled = false
      ComMSafeBswChecks = false
      ComMGeneration: ComMOutOfBoundsWriteSanitizer=false, ComMOutOfBoundsReadSanitizer=false
    ComMConfigSet: ComMPncEnabled=false
      CAN00_f26020e5 (ComMChannel):  # CN_CAN00
        ComMBusType = COMM_BUS_TYPE_CAN
        ComMChannelId = 0
        ComMFullCommRequestNotificationEnabled = false
        ComMMainFunctionPeriod = 0.02
        ComMNoCom = false
        ComMNoWakeup = false
        ComMNetworkManagement: ComMNmVariant=NONE, ComMPncNmRequest=false
        CHNL_f276589c (ComMUserPerChannel): ComMUserChannel=USR_CHNL_f276589c  # CN_CAN00
      USR_CHNL_f276589c (ComMUser): ComMUserIdentifier=0, ComMUserModeNotification=false  # CN_CAN00
  module config CanIf: implementation-config-variant=VARIANT-PRE-COMPILE, module-description=CanIf_Impl
    CanIfDispatchCfg:
      CanIfDispatchUserCtrlBusOffName = CanSM_ControllerBusOff
      CanIfDispatchUserCtrlBusOffUL = CAN_SM
      CanIfDispatchUserCtrlModeIndicationName = CanSM_ControllerModeIndication
      CanIfDispatchUserCtrlModeIndicationUL = CAN_SM
    Can (CanIfCtrlDrvCfg): CanIfCtrlDrvTxCancellation=false, CanIfCtrlDrvInitHohConfigRef=CanIfInitHohCfg, CanIfCtrlDrvNameRef=CanGeneral
      CT_CAN00_e98c47e6 (CanIfCtrlCfg): CanIfCtrlId=0, CanIfCtrlWakeupSupport=false, CanIfCtrlJ1939DynAddrSupport=DISABLED, CanIfCtrlCanCtrlRef=CanConfigSet/CT_CAN00_e98c47e6
    CanIfInitCfg
      CanIfInitHohCfg: CanIfInitRefCfgSet=CanConfigSet
        CN_CAN00_e98c47e6_Tx (CanIfHthCfg): CanIfHthCanCtrlIdRef=Can/CT_CAN00_e98c47e6, CanIfHthIdSymRef=CanConfigSet/CN_CAN00_e98c47e6_Tx
        CN_CAN00_e98c47e6_Rx_Std (CanIfHrhCfg): CanIfHrhSoftwareFilter=true, CanIfHrhCanCtrlIdRef=Can/CT_CAN00_e98c47e6, CanIfHrhIdSymRef=CanConfigSet/CN_CAN00_e98c47e6_Rx_Std
      msg_Transmit_oCAN00_Tx_3abd61be (CanIfTxPduCfg):
        CanIfTxPduCanId = 512
        CanIfTxPduCanIdType = STANDARD_CAN
        CanIfTxPduDlc = 1
        CanIfTxPduUserTxConfirmationName = NULL_PTR
        CanIfTxPduUserTxConfirmationUL = NONE
        CanIfTxPduId = 1
        CanIfTxPduReadNotifyStatus = false
        CanIfTxPduType = STATIC
        CanIfTxPduBufferRef = CanIfBufferCfg_0fb271d2
        CanIfTxPduRef = PT_msg_Transmit_PP_msg_Transmit_Tx_0fb271d2_5e566ad9
      msg_MyECU_Lamp_oCAN00_Tx_3abd61be (CanIfTxPduCfg):
        CanIfTxPduCanId = 1297
        CanIfTxPduCanIdType = STANDARD_CAN
        CanIfTxPduDlc = 8
        CanIfTxPduUserTxConfirmationName = NULL_PTR
        CanIfTxPduUserTxConfirmationUL = NONE
        CanIfTxPduId = 0
        CanIfTxPduReadNotifyStatus = false
        CanIfTxPduType = STATIC
        CanIfTxPduBufferRef = CanIfBufferCfg_0fb271d2
        CanIfTxPduRef = PT_msg_MyECU_Lamp_PP_msg_MyECU_Lamp_Tx_0fb271d2_5e566ad9
      CanIfBufferCfg_0fb271d2 (CanIfBufferCfg):  # CHNL
        CanIfBufferSize = 0
        CanIfTxBufferHandlingType = NONE
        CanIfTxBufferMappedTxPdus = 3
        CanIfTxBufferMaxPduLength = 8
        CanIfBufferHthRef = CanIfInitHohCfg/CN_CAN00_e98c47e6_Tx
      msg_Receive_oCAN00_Rx_3abd61be (CanIfRxPduCfg):
        CanIfRxPduCanId = 528
        CanIfRxPduCanIdType = STANDARD_CAN
        CanIfRxPduDlc = 1
        CanIfRxPduUserRxIndicationName = PduR_CanIfRxIndication
        CanIfRxPduUserRxIndicationUL = PDUR
        CanIfRxPduId = 0
        CanIfRxPduReadData = false
        CanIfRxPduReadNotifyStatus = false
        CanIfRxPduDlcCheck = true
        CanIfRxPduHrhIdRef = CanIfInitHohCfg/CN_CAN00_e98c47e6_Rx_Std
        CanIfRxPduRef = PT_msg_Receive_PP_msg_Receive_Rx_0fb271d2_5e566ad9
      msg_NM_MyECU_oCAN00_Tx_3abd61be (CanIfTxPduCfg):
        CanIfTxPduCanId = 1536
        CanIfTxPduCanIdType = STANDARD_CAN
        CanIfTxPduDlc = 8
        CanIfTxPduUserTxConfirmationName = CanNm_TxConfirmation
        CanIfTxPduUserTxConfirmationUL = CAN_NM
        CanIfTxPduId = 0
        CanIfTxPduReadNotifyStatus = false
        CanIfTxPduType = STATIC
        CanIfTxPduBufferRef = CanIfBufferCfg_0fb271d2
        CanIfTxPduRef = PT_msg_NM_MyECU_PP_msg_NM_MyECU_Tx_0fb271d2_5e566ad9
      msg_NM_RearECU_oCAN00_Rx_3abd61be (CanIfRxPduCfg):
        CanIfRxPduCanId = 1537
        CanIfRxPduCanIdType = STANDARD_CAN
        CanIfRxPduDlc = 8
        CanIfRxPduUserRxIndicationName = CanNm_RxIndication
        CanIfRxPduUserRxIndicationUL = CAN_NM
        CanIfRxPduId = 0
        CanIfRxPduReadData = false
        CanIfRxPduReadNotifyStatus = false
        CanIfRxPduDlcCheck = true
        CanIfRxPduHrhIdRef = CanIfInitHohCfg/CN_CAN00_e98c47e6_Rx_Std
        CanIfRxPduRef = msg_NM_RearECU_4b8e7e70
    CanIfPrivateCfg:
      CanIfPrivateSoftwareFilterType = LINEAR
      CanIfPrivateDlcCheck = true
      CanIfSupportTTCAN = false
      CanIfTransceiverMapping = false
      CanIfTransceiverHandling = false
      CanIfSupportExtendedIds = false
      CanIfSupportNmOsek = false
      CanIfTxBufferType = NONE
      CanIfOptimizeOneController = true
      CanIfWakeupSupport = false
      CanIfStaticFdTxBufferSupport = false
      CanIfRxSearchConsiderMsgType = false
      CanIfMultipleBasicCANTxObjects = false
      CanIfTxBufferFifoSupport = false
      CanIfSetPduReceptionModeSupport = false
      CanIfDataChecksumRxSupport = false
      CanIfDataChecksumTxSupport = false
    CanIfPublicCfg:
      CanIfPublicPnSupport = false
      CanIfPublicCancelTransmitSupport = true
      CanIfPublicDevErrorDetect = true
      CanIfPublicHandleTypeEnum = UINT8
      CanIfPublicMultipleDrvSupport = false
      CanIfPublicNumberOfCanHwUnits = 1
      CanIfPublicReadRxPduDataApi = false
      CanIfPublicReadRxPduNotifyStatusApi = false
      CanIfPublicReadTxPduNotifyStatusApi = false
      CanIfPublicSetDynamicTxIdApi = false
      CanIfPublicTxBuffering = false
      CanIfPublicTxConfirmPollingSupport = false
      CanIfPublicVersionInfoApi = false
      CanIfPublicWakeupCheckValidSupport = false
      CanIfPnWakeupTxPduFilterSupport = false
      CanIfPnTrcvHandlingSupport = false
      CanIfJ1939DynAddrSupport = DISABLED
      CanIfSafeBswChecks = false
      CanIfSetBaudrateApi = false
  module config Can: implementation-config-variant=VARIANT-PRE-COMPILE, module-description=Can_Impl
    CanConfigSet
      CT_CAN00_e98c47e6 (CanController):
        CanControllerActivation = true
        CanBusoffProcessing = INTERRUPT
        CanControllerBaseAddress = 4026630656
        CanControllerId = 0
        CanRxProcessing = INTERRUPT
        CanTxProcessing = INTERRUPT
        CanWakeupProcessing = INTERRUPT
        CanWakeupSupport = false
        CanWakeupSourceId = 0
        CanPhysicalNode = Node0
        CanIOPort = b_000
        CanInterruptPriority = 10
        CanSRC = 0
        CanChannelCanObjectStartIndex = 0
        CanNumberOfCANObj = 7
        CanSrcTos = CPU0
        CanInterruptGroupPriority = 0
        CanClockFrequency = 20000000
        CanCommonCAN = false
        CanControllerDefaultBaudrate = CanControllerBaudrateConfig
        CanControllerSystemRef = CT_CAN00
        CanWakeupSourceRef = EcuMCommonConfiguration/CAN00_f26020e5
        CanCpuClockRef = McuClockReferencePoint
        CanControllerBaudrateConfig:
          CanControllerBaudRate = 500
          CanControllerBaudRateConfigID = 0
          CanControllerPropSeg = 7
          CanControllerSeg1 = 8
          CanControllerSeg2 = 4
          CanControllerSyncJumpWidth = 1
          CanBaudrateClock = 20000
          CanBaudratePrescaler = 2
          CanBaudrateDiv8 = false
        CanFilterMask: CanFilterMaskValue=0, CanFilterCodeValue=0, IsLocked=false
      CN_CAN00_e98c47e6_Rx_Std (CanHardwareObject):
        CanHandleType = BASIC
        CanIdType = STANDARD
        CanIdValue = 0
        CanObjectType = RECEIVE
        CanObjectId = 1
        CanHwProcessing = false
        CanObjectHwSize = 2
        CanObjectHwHandle = 1
        CanMaxDataLen = 8
        CanFdPaddingValue = 0
        CanObjectMultiplexedTransmission = false
        CanControllerRef = CanConfigSet/CT_CAN00_e98c47e6
        CanFilterMaskRef = CanFilterMask
      CN_CAN00_e98c47e6_Tx (CanHardwareObject):
        CanHandleType = BASIC
        CanIdValue = 0
        CanObjectType = TRANSMIT
        CanIdType = STANDARD
        CanObjectId = 0
        CanHwProcessing = false
        CanObjectHwSize = 1
        CanObjectHwHandle = 0
        CanMaxDataLen = 8
        CanFdPaddingValue = 0
        CanObjectMultiplexedTransmission = false
        CanControllerRef = CanConfigSet/CT_CAN00_e98c47e6
    CanGeneral:
      CanIndex = 0
      CanChangeBaudrateApi = false
      CanDevErrorDetection = true
      CanHardwareCancellation = false
      CanIdenticalIdCancellation = false
      CanMainFunctionBusoffPeriod = 0.01
      CanMainFunctionModePeriod = 0.01
      CanMainFunctionWakeupPeriod = 0.01
      CanMultiplexedTransmission = false
      CanSetBaudrateApi = false
      CanTimeoutDuration = 0.01
      CanVersionInfoApi = false
      CanGenericPrecopy = false
      CanHardwareLoopCheck = true
      CanSecureTempBuffer = false
      CanRxFullCANSupport = false
      CanTxFullCANSupport = false
      CanRxBasicCANSupport = true
      CanUseNestedCANInterrupts = false
      CanHardwareCancelByAppl = false
      CanIndividualProcessing = false
      CanGenericConfirmation = false
      CanRxQueue = false
      CanSupportMixedID = false
      CanRxQueueSize = 10
      CanMultipleBasicCANObjects = false
      CanMultipleBasicCANTxObjects = false
      CanHardwareHandleType = UINT8
      CanOptimizeOneController = true
      CanInterruptCategory = CATEGORY2
      CanGetStatus = false
      CanInterruptLock = DRIVER
      CanWakeupSupport = false
      CanRamCheck = None
      CanOverrunNotification = DET
      CanReinitStart = false
      CanGenericPreTransmit = false
      CanFdSupport = NONE
      CanRuntimeMeasurementSupport = false
      CanMaxRxDataLen = 8
      CanMaxTxDataLen = 8
      CanUsePeripheralAccessApi = false
      CanEnableMultipleCanDriver = false
      CanMaxNumberOfHwCANChannels = 3
      CanMaxNumberOfHwCANChannelsR = 3
      CanMaxNumberOfHwCANObj = 128
      CanMaxNumberOfHwCANObjR = 128
      CanClockDividerMode = NORMAL
      CanClockDivider = 1
      CanBaseAddress = 4026630144
      CanBaseAddressR = 4026695680
      CanSrcAddress = 4026763520
      CanSrcAddressR = 4026763584
      CanClockSourceSelection = Fosc
      CanFreezeDisable = false
      CanMirrorModeSupport = false
      CanUseOsInterruptControl = true
      CanRxHwFiFoFullNotification = false
      CanFdIsoSupport = false
      CanFdNiso = false
      CanFdPed = false
      CanSilentModeSupport = false
      CanSafeBswChecks = false
      CanCounterRef = SystemTimer
      CanMainFunctionRWPeriods: CanMainFunctionReadPeriod=0.01
  module config Det: implementation-config-variant=VARIANT-PRE-COMPILE, module-description=Det_Impl
    DetGeneral:
      DetVersionInfoApi = false
      DetEnableDet = true
      DetExtDebugSupport = true
      DetGlobalFilterSize = 10
      DetBreakFilterSize = 0
      DetLogBufferSize = 0
      DetReportErrorRecursionLimit = 0
      DetReportRuntimeErrorRecursionLimit = 0
      DetReportTransientFaultRecursionLimit = 0
      DetDltFilterSize = 0
      DetForwardToDlt = false
    DetConfigSet
  module config PduR: implementation-config-variant=VARIANT-PRE-COMPILE, module-description=PduR_Impl
    PduRGeneral: PduRDevErrorDetect=true, PduRVersionInfoApi=false, PduRMetaDataSupport=false, PduRPduCallback=false, PduRSwitching=false, PduRSafeBswChecks=false
      PduRGeneration:
        PduROutOfBoundsWriteProtectionStrategy = NONE
        PduROutOfBoundsWriteSanitizer = false
        PduROutOfBoundsReadSanitizer = false
        PduRNumericalDataTypeMinimizationStrategy = WITH_CAST
        PduRReduceConstantData2Define = false
        PduRBoolDataInArrayOfStructStrategy = BITMASKING
        PduRDeduplicateIndirectedData = true
        PduRDataDeduplicationStrategy = WITH_CAST
        PduRReduceBoolDataByNegationThreshold = 2
        PduRReduceBoolDataByNumericalComparisonThreshold = 2
        PduRReduceBoolDataByNumericalRelationThreshold = 2
        PduRReduceBoolDataByNumericalOperandStrategy = WITH_ANY_VALUE
        PduRReduceNumericalDataByOffsetThreshold = 2
        PduRReduceNumericalDataByArraySubtractionThreshold = 2
        PduRReduceDataByStreaming = false
        PduRShortSymbols = false
        PduRInterfacesForDeactivatedData = false
        PduRReferringKeysInComments = false
    PduRRoutingTables: PduRConfigurationId=0
      PduRRoutingTable
        3 x PduRRoutingPath, all with PduRRoutingPathCommunicationType=COMMUNICATION_INTERFACE:
          Can_PT_msg_Transmit_0fb271d2  # msg_Transmit_oCAN00
            DST_Can_PT_msg_Transmit_0fb271d2 (PduRDestPdu):
              PduRDestPduHandleId = 1
              PduRDestPduDirection = TRANSMIT
              PduRDestPduRoutingType = API_FORWARDING
              PduRTransmissionConfirmation = false
              PduRDestPduDataProvision = PDUR_DIRECT
              PduRDestPduRef = PT_msg_Transmit_PP_msg_Transmit_Tx_0fb271d2_5e566ad9
              PduRDestPduPduRBswModulesRef = PduR/CanIf
            SRC_Can_PT_msg_Transmit_0fb271d2 (PduRSrcPdu):
              PduRSourcePduHandleId = 1
              PduRSrcPduDirection = TRANSMIT
              PduRSrcPduRef = PT_msg_Transmit_PP_msg_Transmit_Tx_0fb271d2_5e566ad9
              PduRSrcPduPduRBswModulesRef = PduR/Com
          Can_PT_msg_MyECU_Lamp_0fb271d2  # msg_MyECU_Lamp_oCAN00
            DST_Can_PT_msg_MyECU_Lamp_0fb271d2 (PduRDestPdu):
              PduRDestPduHandleId = 0
              PduRDestPduDirection = TRANSMIT
              PduRDestPduRoutingType = API_FORWARDING
              PduRTransmissionConfirmation = false
              PduRDestPduDataProvision = PDUR_DIRECT
              PduRDestPduRef = PT_msg_MyECU_Lamp_PP_msg_MyECU_Lamp_Tx_0fb271d2_5e566ad9
              PduRDestPduPduRBswModulesRef = PduR/CanIf
            SRC_Can_PT_msg_MyECU_Lamp_0fb271d2 (PduRSrcPdu):
              PduRSourcePduHandleId = 0
              PduRSrcPduDirection = TRANSMIT
              PduRSrcPduRef = PT_msg_MyECU_Lamp_PP_msg_MyECU_Lamp_Tx_0fb271d2_5e566ad9
              PduRSrcPduPduRBswModulesRef = PduR/Com
          Can_PT_msg_Receive_0fb271d2  # msg_Receive_oCAN00
            DST_Can_PT_msg_Receive_0fb271d2 (PduRDestPdu):
              PduRDestPduHandleId = 0
              PduRDestPduDirection = RECEIVE
              PduRDestPduRoutingType = API_FORWARDING
              PduRTransmissionConfirmation = false
              PduRDestPduRef = PT_msg_Receive_PP_msg_Receive_Rx_0fb271d2_5e566ad9
              PduRDestPduPduRBswModulesRef = PduR/Com
            SRC_Can_PT_msg_Receive_0fb271d2 (PduRSrcPdu):
              PduRSourcePduHandleId = 0
              PduRSrcPduDirection = RECEIVE
              PduRSrcPduRef = PT_msg_Receive_PP_msg_Receive_Rx_0fb271d2_5e566ad9
              PduRSrcPduPduRBswModulesRef = PduR/CanIf
    CanIf (PduRBswModules):
      PduRCancelReceive = false
      PduRCancelTransmit = false
      PduRChangeParameterRequestApi = false
      PduRCommunicationInterface = true
      PduRLowerModule = true
      PduRTransportProtocol = false
      PduRTriggertransmit = false
      PduRTxConfirmation = false
      PduRUpperModule = false
      PduRUseTag = false
      PduRBswModuleRef = CanIf
    Com (PduRBswModules):
      PduRCancelReceive = false
      PduRCancelTransmit = false
      PduRChangeParameterRequestApi = false
      PduRCommunicationInterface = true
      PduRLowerModule = false
      PduRTransportProtocol = false
      PduRTriggertransmit = false
      PduRTxConfirmation = false
      PduRUpperModule = true
      PduRUseTag = false
      PduRBswModuleRef = Com
  module config EcuM: implementation-config-variant=VARIANT-PRE-COMPILE, module-description=EcuM_Impl
    EcuMConfiguration
      EcuMFlexConfiguration: EcuMFlexModuleConfigurationRef=CanConfigSet, EcuMNormalMcuModeRef=McuModeSettingConf_0
        ECUM_CAUSE_UNKNOWN (EcuMShutdownCause): EcuMShutdownCauseId=0
        ECUM_RESET_IO (EcuMResetMode): EcuMResetModeId=2
        ECUM_RESET_MCU (EcuMResetMode): EcuMResetModeId=0
        ECUM_CAUSE_DCM (EcuMShutdownCause): EcuMShutdownCauseId=3
        ECUM_RESET_WAKEUP (EcuMResetMode): EcuMResetModeId=3
        ECUM_CAUSE_ECU_STATE (EcuMShutdownCause): EcuMShutdownCauseId=1
        ECUM_RESET_WDG (EcuMResetMode): EcuMResetModeId=1
        ECUM_CAUSE_WDGM (EcuMShutdownCause): EcuMShutdownCauseId=2
      EcuMCommonConfiguration: EcuMConfigConsistencyHash=8789373758459766242, EcuMDefaultAppMode=OSDEFAULTAPPMODE, EcuMOSResource=OsResource_EcuM
        ECUM_WKSOURCE_POWER (EcuMWakeupSource): EcuMWakeupSourceId=0, EcuMValidationTimeout=0, EcuMCheckWakeupTimeout=0, EcuMWakeupSourcePolling=false
        EcuMDriverInitListOne
          6 x EcuMDriverInitItem:
            Mcu_Init: index=0, EcuMModuleID=Mcu, EcuMModuleService=Mcu_Init, EcuMModuleHeader=Mcu.h
            Mcu_InitClock: index=10, EcuMModuleID=Code, EcuMAdditionalInitCode=Mcu_InitClock(McuConf_McuModeSettingConf_McuModeSettingConf_0)
            Mcu_GetPllStatus: index=11, EcuMModuleID=Code, EcuMAdditionalInitCode=while (Mcu_GetPllStatus() != MCU_PLL_LOCKED)
            Mcu_DistributePllClock: index=12, EcuMModuleID=Code, EcuMAdditionalInitCode=Mcu_DistributePllClock()
            Dio_Init: index=2, EcuMModuleID=Dio, EcuMModuleService=Dio_Init, EcuMModuleHeader=Dio.h
            Port_Init: index=6, EcuMModuleID=Port, EcuMModuleService=Port_Init, EcuMModuleHeader=Port.h
        3 x EcuMWakeupSource, all with EcuMValidationTimeout=0, EcuMCheckWakeupTimeout=0, EcuMWakeupSourcePolling=false:
          ECUM_WKSOURCE_INTERNAL_WDG: EcuMWakeupSourceId=3
          ECUM_WKSOURCE_INTERNAL_RESET: EcuMWakeupSourceId=2
          ECUM_WKSOURCE_RESET: EcuMWakeupSourceId=1
        EcuMDefaultShutdownTarget: EcuMDefaultState=EcuMStateOff
        EcuMDriverRestartList
        ECUM_WKSOURCE_EXTERNAL_WDG (EcuMWakeupSource): EcuMWakeupSourceId=4, EcuMValidationTimeout=0, EcuMCheckWakeupTimeout=0, EcuMWakeupSourcePolling=false
        EcuMDriverInitListZero
          10 x EcuMDriverInitItem:
            BswM_InitMemory: index=0, EcuMModuleID=BswM, EcuMModuleService=BswM_InitMemory, EcuMModuleHeader=BswM.h
            CanIf_InitMemory: index=1, EcuMModuleID=CanIf, EcuMModuleService=CanIf_InitMemory, EcuMModuleHeader=CanIf.h
            CanSM_InitMemory: index=3, EcuMModuleID=CanSM, EcuMModuleService=CanSM_InitMemory, EcuMModuleHeader=CanSM_EcuM.h
            Can_InitMemory: index=5, EcuMModuleID=Can, EcuMModuleService=Can_InitMemory, EcuMModuleHeader=Can.h
            ComM_InitMemory: index=6, EcuMModuleID=ComM, EcuMModuleService=ComM_InitMemory, EcuMModuleHeader=ComM.h
            Com_InitMemory: index=7, EcuMModuleID=Com, EcuMModuleService=Com_InitMemory, EcuMModuleHeader=Com.h
            Det_InitMemory: index=11, EcuMModuleID=Det, EcuMModuleService=Det_InitMemory, EcuMModuleHeader=Det.h
            Det_Init: index=12, EcuMModuleID=Det, EcuMModuleService=Det_Init, EcuMModuleHeader=Det.h
            PduR_InitMemory: index=14, EcuMModuleID=PduR, EcuMModuleService=PduR_InitMemory, EcuMModuleHeader=PduR.h
            Rte_InitMemory: index=15, EcuMModuleID=Rte, EcuMModuleService=Rte_InitMemory, EcuMModuleHeader=Rte_Main.h
        CAN00_f26020e5 (EcuMWakeupSource): EcuMWakeupSourceId=5, EcuMWakeupSourcePolling=false, EcuMComMChannelRef=ComMConfigSet/CAN00_f26020e5  # CN_CAN00
    EcuMGeneral:
      EcuMDevErrorDetect = true
      EcuMIncludeDem = true
      EcuMIncludeDet = true
      EcuMMainFunctionPeriod = 0.01
      EcuMVersionInfoApi = false
      EcuMDeferredBswMNotification = false
      EcuMSlaveCoreHandling = true
      EcuMEnableFixBehavior = false
      EcuMGeneration: EcuMOutOfBoundsWriteSanitizer=false, EcuMOutOfBoundsReadSanitizer=false, EcuMInterfacesForDeactivatedData=false
    EcuMFlexGeneral: EcuMAlarmClockPresent=false, EcuMResetLoopDetection=false, EcuMEnableDefBehaviour=false
  module config CanSM: implementation-config-variant=VARIANT-PRE-COMPILE, module-description=CanSM_Impl
    CanSMConfiguration: CanSMModeRequestRepetitionMax=10, CanSMModeRequestRepetitionTime=0.1
      CHNL_f276589c (CanSMManagerNetwork):
        CanSMBorCounterL1ToL2 = 5
        CanSMBorTimeL1 = 1
        CanSMBorTimeL2 = 3
        CanSMBorTimeTxEnsured = 5
        CanSMBorTxConfirmationPolling = false
        CanSMComMNetworkHandleRef = ComMConfigSet/CAN00_f26020e5
        CT_CAN00_e98c47e6 (CanSMController): CanSMControllerId=Can/CT_CAN00_e98c47e6
    CanSMGeneral: CanSMDevErrorDetect=true, CanSMMainFunctionTimePeriod=0.01, CanSMVersionInfoApi=false, CanSMBorCheckLevel=false, CanSMSetBaudrateApi=false
      CanSMGeneration: CanSMOutOfBoundsWriteSanitizer=false, CanSMOutOfBoundsReadSanitizer=false
  module config BswM: implementation-config-variant=VARIANT-PRE-COMPILE, module-description=BswM_Impl
    BswMGeneral:
      BswMCanSMEnabled = true
      BswMComMEnabled = true
      BswMDcmEnabled = true
      BswMDevErrorDetect = true
      BswMEcuMEnabled = true
      BswMEthIfEnabled = false
      BswMEthSMEnabled = false
      BswMFrSMEnabled = false
      BswMGenericRequestEnabled = true
      BswMJ1939DcmEnabled = false
      BswMJ1939NmEnabled = false
      BswMLinSMEnabled = false
      BswMLinTPEnabled = false
      BswMNmEnabled = false
      BswMNvMEnabled = false
      BswMPduREnabled = false
      BswMRuleControlEnabled = false
      BswMSdEnabled = false
      BswMVersionInfoApi = false
      BswMWdgMEnabled = false
      BswMModeCheck = true
      BswMMainFunctionPeriod = 0.01
      BswMCommonData
      BswMGeneration:
        BswMOutOfBoundsWriteSanitizer = false
        BswMOutOfBoundsReadSanitizer = false
        BswMReduceConstantData2Define = true
        BswMReduceDataByStreaming = false
        BswMBoolDataInArrayOfStructStrategy = BITMASKING
        BswMInterfacesForDeactivatedData = false
    BswMConfig
      BswMArbitration
        ESH_RunToPostRun (BswMRule):
          BswMNestedExecutionOnly = false
          BswMRuleId = 8
          BswMRuleInitState = BSWM_FALSE
          BswMRuleExpressionRef = ESH_LE_RunToPostRun
          BswMRuleTrueActionList = ESH_AL_ExitRun
        ESH_LE_RunToPostRun (BswMLogicalExpression):
          BswMLogicalOperator = BSWM_AND
          BswMArgumentRef = ESH_Cond_StateIsRun
          BswMArgumentRef = ESH_LE_AllChannelsNoCom
          BswMArgumentRef = ESH_LE_RunReleased
          BswMArgumentRef = ESH_Cond_SelfRunReqTimerExpired
          BswMArgumentRef = ESH_Cond_ModeIsRun
        ESH_Cond_StateIsRun (BswMModeCondition): BswMConditionType=BSWM_EQUALS, BswMConditionMode=ESH_State
          BswMConditionValue
            BswMBswMode: BswMBswRequestedMode=ESH_RUN
        ESH_State (BswMModeRequestPort): BswMArbitrateOnInit=true, BswMRequestProcessing=BSWM_IMMEDIATE
          BswMModeRequestSource
            BswMGenericRequest: BswMModeRequesterId=230, BswMRequestedModeMax=7
              7 x BswMGenericRequestMode:
                ESH_INIT: BswMGenericRequestModeValue=0
                ESH_RUN: BswMGenericRequestModeValue=1
                ESH_POST_RUN: BswMGenericRequestModeValue=2
                ESH_PREP_SHUTDOWN: BswMGenericRequestModeValue=3
                ESH_WAIT_FOR_NVM: BswMGenericRequestModeValue=4
                ESH_SHUTDOWN: BswMGenericRequestModeValue=5
                ESH_WAKEUP: BswMGenericRequestModeValue=6
          BswMModeInitValue
            BswMBswModeInitValue: BswMBswModeInitValueMode=ESH_INIT
        ESH_LE_AllChannelsNoCom (BswMLogicalExpression): BswMLogicalOperator=BSWM_AND, BswMArgumentRef=ESH_Cond_NoComOn_CAN00_f26020e5
        ESH_LE_RunReleased (BswMLogicalExpression): BswMLogicalOperator=BSWM_AND, BswMArgumentRef=ESH_Cond_RunRequest0IsReleased, BswMArgumentRef=ESH_Cond_RunRequest1IsReleased
        ESH_Cond_RunRequest0IsReleased (BswMModeCondition): BswMConditionType=BSWM_EQUALS, BswMConditionMode=ESH_RunRequest_0
          BswMConditionValue
            BswMModeDeclaration: BswMModeValueRef=RELEASED
        ESH_RunRequest_0 (BswMModeRequestPort): BswMArbitrateOnInit=false, BswMRequestProcessing=BSWM_DEFERRED
          BswMModeRequestSource
            BswMSwcModeRequest: BswMModeRequestDataElementPrototypeName=requestedMode, BswMSwcModeRequestModeDeclarationGroupPrototypeRef=BswM_MDGP_ESH_RunRequest
          BswMModeInitValue
            BswMSwcModeInitValue: BswMSwcModeInitValueRef=RELEASED
        ESH_Cond_RunRequest1IsReleased (BswMModeCondition): BswMConditionType=BSWM_EQUALS, BswMConditionMode=ESH_RunRequest_1
          BswMConditionValue
            BswMModeDeclaration: BswMModeValueRef=RELEASED
        ESH_RunRequest_1 (BswMModeRequestPort): BswMArbitrateOnInit=false, BswMRequestProcessing=BSWM_DEFERRED
          BswMModeRequestSource
            BswMSwcModeRequest: BswMModeRequestDataElementPrototypeName=requestedMode, BswMSwcModeRequestModeDeclarationGroupPrototypeRef=BswM_MDGP_ESH_RunRequest
          BswMModeInitValue
            BswMSwcModeInitValue: BswMSwcModeInitValueRef=RELEASED
        ESH_Cond_SelfRunReqTimerExpired (BswMModeCondition): BswMConditionType=BSWM_EQUALS, BswMConditionMode=ESH_SelfRunRequestTimer
          BswMConditionValue
            BswMBswMode: BswMBswRequestedMode=BSWM_TIMER_EXPIRED
        ESH_SelfRunRequestTimer (BswMModeRequestPort): BswMArbitrateOnInit=false, BswMRequestProcessing=BSWM_DEFERRED
          BswMModeRequestSource
            BswMTimer
          BswMModeInitValue
            BswMBswModeInitValue: BswMBswModeInitValueMode=BSWM_TIMER_STOPPED
        ESH_Cond_ModeIsRun (BswMModeCondition): BswMConditionType=BSWM_EQUALS, BswMConditionMode=ESH_ModeNotification
          BswMConditionValue
            BswMModeDeclaration: BswMModeValueRef=RUN
        ESH_ModeNotification (BswMModeRequestPort): BswMArbitrateOnInit=false, BswMRequestProcessing=BSWM_DEFERRED
          BswMModeRequestSource
            BswMSwcModeNotification: BswMSwcModeNotificationModeDeclarationGroupPrototypeRef=BswM_MDGP_ESH_Mode
          BswMModeInitValue
            BswMSwcModeInitValue: BswMSwcModeInitValueRef=STARTUP
        ESH_RunToPostRunNested (BswMRule):
          BswMNestedExecutionOnly = true
          BswMRuleId = 9
          BswMRuleInitState = BSWM_FALSE
          BswMRuleExpressionRef = ESH_LE_ComMNoPendingRequests
          BswMRuleTrueActionList = ESH_AL_RunToPostRun
        ESH_LE_ComMNoPendingRequests (BswMLogicalExpression): BswMLogicalOperator=BSWM_AND, BswMArgumentRef=ESH_Cond_ComMNoPendingRequests
        ESH_Cond_ComMNoPendingRequests (BswMModeCondition): BswMConditionType=BSWM_EQUALS, BswMConditionMode=ESH_ComMPendingRequests
          BswMConditionValue
            BswMBswMode: BswMBswRequestedMode=ESH_COMM_NO_REQUEST
        ESH_ComMPendingRequests (BswMModeRequestPort): BswMArbitrateOnInit=false, BswMRequestProcessing=BSWM_DEFERRED
          BswMModeRequestSource
            BswMGenericRequest: BswMModeRequesterId=232, BswMRequestedModeMax=2
              ESH_COMM_NO_REQUEST (BswMGenericRequestMode): BswMGenericRequestModeValue=0
              ESH_COMM_PENDING_REQUEST (BswMGenericRequestMode): BswMGenericRequestModeValue=1
          BswMModeInitValue
            BswMBswModeInitValue: BswMBswModeInitValueMode=ESH_COMM_NO_REQUEST
        ESH_WaitToShutdown (BswMRule):
          BswMNestedExecutionOnly = false
          BswMRuleId = 10
          BswMRuleInitState = BSWM_FALSE
          BswMRuleExpressionRef = ESH_LE_WaitForNvMToShutdown
          BswMRuleTrueActionList = ESH_AL_WaitForNvMToShutdown
        ESH_LE_WaitForNvMToShutdown (BswMLogicalExpression): BswMLogicalOperator=BSWM_AND, BswMArgumentRef=ESH_Cond_StateIsWaitForNvm, BswMArgumentRef=ESH_LE_NoWakeup
        ESH_Cond_StateIsWaitForNvm (BswMModeCondition): BswMConditionType=BSWM_EQUALS, BswMConditionMode=ESH_State
          BswMConditionValue
            BswMBswMode: BswMBswRequestedMode=ESH_WAIT_FOR_NVM
        ESH_LE_NoWakeup (BswMLogicalExpression): BswMLogicalOperator=BSWM_AND, BswMArgumentRef=ESH_Cond_NoValidatedWakeups, BswMArgumentRef=ESH_Cond_ComMNoPendingRequests
        ESH_Cond_NoValidatedWakeups (BswMModeCondition): BswMConditionType=BSWM_EQUALS, BswMConditionMode=ESH_EcuM_GetValidatedWakeupEvents
          BswMConditionValue
            BswMBswMode: BswMBswRequestedMode=0
        ESH_EcuM_GetValidatedWakeupEvents (BswMModeRequestPort): BswMArbitrateOnInit=false, BswMRequestProcessing=BSWM_DEFERRED
          BswMModeRequestSource
            BswMUserConditionRequest: BswMUserCondition=EcuM_GetValidatedWakeupEvents()
        ESH_WakeupToPrep (BswMRule):
          BswMNestedExecutionOnly = false
          BswMRuleId = 12
          BswMRuleInitState = BSWM_FALSE
          BswMRuleExpressionRef = ESH_LE_WakeupToPrepShutdown
          BswMRuleTrueActionList = ESH_AL_WakeupToPrep
        ESH_LE_WakeupToPrepShutdown (BswMLogicalExpression):
          BswMLogicalOperator = BSWM_AND
          BswMArgumentRef = ESH_Cond_StateIsWakeup
          BswMArgumentRef = ESH_Cond_NoPendingWakeups
          BswMArgumentRef = ESH_LE_NoWakeup
          BswMArgumentRef = ESH_Cond_ModeIsWakeup
        ESH_Cond_StateIsWakeup (BswMModeCondition): BswMConditionType=BSWM_EQUALS, BswMConditionMode=ESH_State
          BswMConditionValue
            BswMBswMode: BswMBswRequestedMode=ESH_WAKEUP
        ESH_Cond_NoPendingWakeups (BswMModeCondition): BswMConditionType=BSWM_EQUALS, BswMConditionMode=ESH_EcuM_GetPendingWakeupEvents
          BswMConditionValue
            BswMBswMode: BswMBswRequestedMode=0
        ESH_EcuM_GetPendingWakeupEvents (BswMModeRequestPort): BswMArbitrateOnInit=false, BswMRequestProcessing=BSWM_DEFERRED
          BswMModeRequestSource
            BswMUserConditionRequest: BswMUserCondition=EcuM_GetPendingWakeupEvents()
        ESH_Cond_ModeIsWakeup (BswMModeCondition): BswMConditionType=BSWM_EQUALS, BswMConditionMode=ESH_ModeNotification
          BswMConditionValue
            BswMModeDeclaration: BswMModeValueRef=WAKEUP
        ESH_WaitToWakeup (BswMRule):
          BswMNestedExecutionOnly = false
          BswMRuleId = 11
          BswMRuleInitState = BSWM_FALSE
          BswMRuleExpressionRef = ESH_LE_WaitForNvMToWakeup
          BswMRuleTrueActionList = ESH_AL_WaitForNvMWakeup
        ESH_LE_WaitForNvMToWakeup (BswMLogicalExpression): BswMLogicalOperator=BSWM_AND, BswMArgumentRef=ESH_Cond_StateIsWaitForNvm, BswMArgumentRef=ESH_LE_ValidWakeup
        ESH_LE_ValidWakeup (BswMLogicalExpression): BswMLogicalOperator=BSWM_OR, BswMArgumentRef=ESH_Cond_ValidatedWakeups, BswMArgumentRef=ESH_Cond_ComMPendingRequests
        ESH_Cond_ValidatedWakeups (BswMModeCondition): BswMConditionType=BSWM_EQUALS_NOT, BswMConditionMode=ESH_EcuM_GetValidatedWakeupEvents
          BswMConditionValue
            BswMBswMode: BswMBswRequestedMode=0
        ESH_Cond_ComMPendingRequests (BswMModeCondition): BswMConditionType=BSWM_EQUALS, BswMConditionMode=ESH_ComMPendingRequests
          BswMConditionValue
            BswMBswMode: BswMBswRequestedMode=ESH_COMM_PENDING_REQUEST
        ESH_WakeupToRun (BswMRule):
          BswMNestedExecutionOnly = false
          BswMRuleId = 13
          BswMRuleInitState = BSWM_FALSE
          BswMRuleExpressionRef = ESH_LE_WakeupToRun
          BswMRuleTrueActionList = ESH_AL_WakeupToRun
        ESH_LE_WakeupToRun (BswMLogicalExpression): BswMLogicalOperator=BSWM_AND, BswMArgumentRef=ESH_Cond_StateIsWakeup, BswMArgumentRef=ESH_LE_ValidWakeup, BswMArgumentRef=ESH_Cond_ModeIsWakeup
        ESH_InitToWakeup (BswMRule):
          BswMNestedExecutionOnly = false
          BswMRuleId = 3
          BswMRuleInitState = BSWM_FALSE
          BswMRuleExpressionRef = ESH_LE_InitToWakeup
          BswMRuleTrueActionList = ESH_AL_InitToWakeup
        ESH_LE_InitToWakeup (BswMLogicalExpression): BswMLogicalOperator=BSWM_AND, BswMArgumentRef=ESH_Cond_StateIsInit
        ESH_Cond_StateIsInit (BswMModeCondition): BswMConditionType=BSWM_EQUALS, BswMConditionMode=ESH_State
          BswMConditionValue
            BswMBswMode: BswMBswRequestedMode=ESH_INIT
        ESH_PostRunToPrepNested (BswMRule):
          BswMNestedExecutionOnly = true
          BswMRuleId = 6
          BswMRuleInitState = BSWM_FALSE
          BswMRuleExpressionRef = ESH_LE_PostRunToPrep
          BswMRuleTrueActionList = ESH_AL_PostRunToPrepShutdown
        ESH_LE_PostRunToPrep (BswMLogicalExpression): BswMLogicalOperator=BSWM_AND, BswMArgumentRef=ESH_LE_PostRunReleased
        ESH_LE_PostRunReleased (BswMLogicalExpression): BswMLogicalOperator=BSWM_AND, BswMArgumentRef=ESH_Cond_PostRunRequest0IsReleased, BswMArgumentRef=ESH_Cond_PostRunRequest1IsReleased
        ESH_Cond_PostRunRequest0IsReleased (BswMModeCondition): BswMConditionType=BSWM_EQUALS, BswMConditionMode=ESH_PostRunRequest_0
          BswMConditionValue
            BswMModeDeclaration: BswMModeValueRef=RELEASED
        ESH_PostRunRequest_0 (BswMModeRequestPort): BswMArbitrateOnInit=false, BswMRequestProcessing=BSWM_DEFERRED
          BswMModeRequestSource
            BswMSwcModeRequest: BswMModeRequestDataElementPrototypeName=requestedMode, BswMSwcModeRequestModeDeclarationGroupPrototypeRef=BswM_MDGP_ESH_RunRequest
          BswMModeInitValue
            BswMSwcModeInitValue: BswMSwcModeInitValueRef=RELEASED
        ESH_Cond_PostRunRequest1IsReleased (BswMModeCondition): BswMConditionType=BSWM_EQUALS, BswMConditionMode=ESH_PostRunRequest_1
          BswMConditionValue
            BswMModeDeclaration: BswMModeValueRef=RELEASED
        ESH_PostRunRequest_1 (BswMModeRequestPort): BswMArbitrateOnInit=false, BswMRequestProcessing=BSWM_DEFERRED
          BswMModeRequestSource
            BswMSwcModeRequest: BswMModeRequestDataElementPrototypeName=requestedMode, BswMSwcModeRequestModeDeclarationGroupPrototypeRef=BswM_MDGP_ESH_RunRequest
          BswMModeInitValue
            BswMSwcModeInitValue: BswMSwcModeInitValueRef=RELEASED
        ESH_PostRunNested (BswMRule):
          BswMNestedExecutionOnly = true
          BswMRuleId = 5
          BswMRuleInitState = BSWM_FALSE
          BswMRuleExpressionRef = ESH_LE_RunRequestsOrWakeup
          BswMRuleFalseActionList = ESH_AL_ESH_PostRunToPrepCheck
          BswMRuleTrueActionList = ESH_AL_PostRunToRun
        ESH_LE_RunRequestsOrWakeup (BswMLogicalExpression): BswMLogicalOperator=BSWM_OR, BswMArgumentRef=ESH_LE_RunRequested, BswMArgumentRef=ESH_LE_ValidWakeup
        ESH_LE_RunRequested (BswMLogicalExpression): BswMLogicalOperator=BSWM_OR, BswMArgumentRef=ESH_Cond_RunRequest0IsRequested, BswMArgumentRef=ESH_Cond_RunRequest1IsRequested
        ESH_Cond_RunRequest0IsRequested (BswMModeCondition): BswMConditionType=BSWM_EQUALS, BswMConditionMode=ESH_RunRequest_0
          BswMConditionValue
            BswMModeDeclaration: BswMModeValueRef=REQUESTED
        ESH_Cond_RunRequest1IsRequested (BswMModeCondition): BswMConditionType=BSWM_EQUALS, BswMConditionMode=ESH_RunRequest_1
          BswMConditionValue
            BswMModeDeclaration: BswMModeValueRef=REQUESTED
        ESH_PostRun (BswMRule):
          BswMNestedExecutionOnly = false
          BswMRuleId = 4
          BswMRuleInitState = BSWM_FALSE
          BswMRuleExpressionRef = ESH_LE_PostRun
          BswMRuleTrueActionList = ESH_AL_ExitPostRun
        ESH_LE_PostRun (BswMLogicalExpression): BswMLogicalOperator=BSWM_AND, BswMArgumentRef=ESH_Cond_StateIsPostRun, BswMArgumentRef=ESH_Cond_ModeIsPostRun
        ESH_Cond_StateIsPostRun (BswMModeCondition): BswMConditionType=BSWM_EQUALS, BswMConditionMode=ESH_State
          BswMConditionValue
            BswMBswMode: BswMBswRequestedMode=ESH_POST_RUN
        ESH_Cond_ModeIsPostRun (BswMModeCondition): BswMConditionType=BSWM_EQUALS, BswMConditionMode=ESH_ModeNotification
          BswMConditionValue
            BswMModeDeclaration: BswMModeValueRef=POSTRUN
        ESH_PrepToWait (BswMRule):
          BswMNestedExecutionOnly = false
          BswMRuleId = 7
          BswMRuleInitState = BSWM_FALSE
          BswMRuleExpressionRef = ESH_LE_PrepShutdownToWaitForNvM
          BswMRuleTrueActionList = ESH_AL_PrepShutdownToWaitForNvM
        ESH_LE_PrepShutdownToWaitForNvM (BswMLogicalExpression): BswMLogicalOperator=BSWM_AND, BswMArgumentRef=ESH_Cond_StateIsPrepShutdown, BswMArgumentRef=ESH_Cond_ModeIsShutdown
        ESH_Cond_StateIsPrepShutdown (BswMModeCondition): BswMConditionType=BSWM_EQUALS, BswMConditionMode=ESH_State
          BswMConditionValue
            BswMBswMode: BswMBswRequestedMode=ESH_PREP_SHUTDOWN
        ESH_Cond_ModeIsShutdown (BswMModeCondition): BswMConditionType=BSWM_EQUALS, BswMConditionMode=ESH_ModeNotification
          BswMConditionValue
            BswMModeDeclaration: BswMModeValueRef=SHUTDOWN
        CC_CAN00_f26020e5_TX (BswMRule):
          BswMNestedExecutionOnly = false
          BswMRuleId = 2
          BswMRuleInitState = BSWM_FALSE
          BswMRuleExpressionRef = CC_LE_CAN00_f26020e5_TX
          BswMRuleFalseActionList = CC_AL_CAN00_f26020e5_TX_Disable
          BswMRuleTrueActionList = CC_AL_CAN00_f26020e5_TX_EnableNoinit
        CC_LE_CAN00_f26020e5_TX (BswMLogicalExpression): BswMLogicalOperator=BSWM_AND, BswMArgumentRef=CC_Cond_CanSMIndication_CAN00_f26020e5_EQ_CANSM_BSWM_FULL_COMMUNICATION
        CC_Cond_CanSMIndication_CAN00_f26020e5_EQ_CANSM_BSWM_FULL_COMMUNICATION (BswMModeCondition): BswMConditionType=BSWM_EQUALS, BswMConditionMode=CC_CanSMIndication_CAN00_f26020e5
          BswMConditionValue
            BswMBswMode: BswMBswRequestedMode=CANSM_BSWM_FULL_COMMUNICATION
        CC_CanSMIndication_CAN00_f26020e5 (BswMModeRequestPort): BswMArbitrateOnInit=false, BswMRequestProcessing=BSWM_IMMEDIATE
          BswMModeRequestSource
            BswMCanSMIndication: BswMCanSMChannelRef=ComMConfigSet/CAN00_f26020e5
          BswMModeInitValue
            BswMBswModeInitValue: BswMBswModeInitValueMode=CANSM_BSWM_NO_COMMUNICATION
        CC_CAN00_f26020e5_RX_DM (BswMRule):
          BswMNestedExecutionOnly = false
          BswMRuleId = 1
          BswMRuleInitState = BSWM_FALSE
          BswMRuleExpressionRef = CC_LE_CAN00_f26020e5_RX_DM
          BswMRuleFalseActionList = CC_AL_CAN00_f26020e5_Disable_DM
          BswMRuleTrueActionList = CC_AL_CAN00_f26020e5_Enable_DM
        CC_LE_CAN00_f26020e5_RX_DM (BswMLogicalExpression): BswMLogicalOperator=BSWM_AND, BswMArgumentRef=CC_Cond_CanSMIndication_CAN00_f26020e5_EQ_CANSM_BSWM_FULL_COMMUNICATION
        CC_CAN00_f26020e5_RX (BswMRule):
          BswMNestedExecutionOnly = false
          BswMRuleId = 0
          BswMRuleInitState = BSWM_FALSE
          BswMRuleExpressionRef = CC_LE_CAN00_f26020e5_RX
          BswMRuleFalseActionList = CC_AL_CAN00_f26020e5_RX_Disable
          BswMRuleTrueActionList = CC_AL_CAN00_f26020e5_RX_EnableNoinit
        CC_LE_CAN00_f26020e5_RX (BswMLogicalExpression): BswMLogicalOperator=BSWM_AND, BswMArgumentRef=CC_Cond_CanSMIndication_CAN00_f26020e5_NEQ_CANSM_BSWM_NO_COMMUNICATION
        CC_Cond_CanSMIndication_CAN00_f26020e5_NEQ_CANSM_BSWM_NO_COMMUNICATION (BswMModeCondition): BswMConditionType=BSWM_EQUALS_NOT, BswMConditionMode=CC_CanSMIndication_CAN00_f26020e5
          BswMConditionValue
            BswMBswMode: BswMBswRequestedMode=CANSM_BSWM_NO_COMMUNICATION
        ESH_Cond_NoComOn_CAN00_f26020e5 (BswMModeCondition): BswMConditionType=BSWM_EQUALS, BswMConditionMode=ESH_ComMIndication_CAN00_f26020e5
          BswMConditionValue
            BswMBswMode: BswMBswRequestedMode=COMM_NO_COMMUNICATION
        ESH_ComMIndication_CAN00_f26020e5 (BswMModeRequestPort): BswMArbitrateOnInit=false, BswMRequestProcessing=BSWM_DEFERRED
          BswMModeRequestSource
            BswMComMIndication: BswMComMChannelRef=ComMConfigSet/CAN00_f26020e5
          BswMModeInitValue
            BswMBswModeInitValue: BswMBswModeInitValueMode=COMM_NO_COMMUNICATION
      BswMModeControl: BswMInitActionListRef=INIT_AL_Initialize
        ESH_AL_ExitRun (BswMActionList): BswMActionListExecution=BSWM_CONDITION
          4 x BswMActionListItem, all with BswMAbortOnFail=false:
            ESH_Action_EnterExclusiveArea: BswMActionListItemIndex=0, BswMActionListItemRef=BswMModeControl/ESH_Action_EnterExclusiveArea
            ESH_Action_ComMCheckPendingRequests: BswMActionListItemIndex=1, BswMActionListItemRef=BswMModeControl/ESH_Action_ComMCheckPendingRequests
            ESH_RunToPostRunNested: BswMActionListItemIndex=2, BswMActionListItemRef=BswMArbitration/ESH_RunToPostRunNested
            ESH_Action_ExitExclusiveArea: BswMActionListItemIndex=3, BswMActionListItemRef=BswMModeControl/ESH_Action_ExitExclusiveArea
        ESH_Action_EnterExclusiveArea (BswMAction)
          BswMAvailableActions
            BswMUserCallout: BswMUserCalloutFunction=SchM_Enter_BswM_BSWM_EXCLUSIVE_AREA_0(), BswMCreateCallout=false, BswMUserIncludeFile=SchM_BswM.h
        ESH_Action_ComMCheckPendingRequests (BswMAction)
          BswMAvailableActions
            BswMUserCallout:
              BswMUserCalloutFunction = ESH_ComM_CheckPendingRequests()
              BswMCreateCallout = true
              BswMUserCode = ComM_StateType CAN00_f26020e5 = COMM_NO_COM_NO_PENDING_REQUEST; (void)ComM_GetState(ComMConf_ComMChannel_CAN00_f26020e5, &CAN00_f26020e5); /* SBSW_BSWM_FCTCALL_LOCALVAR */ if(CAN00_f26020e5 != COMM_NO_COM_NO_PENDING_REQUEST) { BswM_RequestMode(BSWM_GENERIC_ESH_ComMPendingRequests, BSWM_GENERICVALUE_ESH_ComMPendingRequests_ESH_COMM_PENDING_REQUEST); } else { BswM_RequestMode(BSWM_GENERIC_ESH_ComMPendingRequests, BSWM_GENERICVALUE_ESH_ComMPendingRequests_ESH_COMM_NO_REQUEST); }
        ESH_AL_RunToPostRun (BswMActionList): BswMActionListExecution=BSWM_CONDITION
          5 x BswMActionListItem, all with BswMAbortOnFail=false:
            ESH_Action_EcuMClearValidatedWakeupEvents: BswMActionListItemIndex=1, BswMActionListItemRef=BswMModeControl/ESH_Action_EcuMClearValidatedWakeupEvents
            ESH_Action_OnEnterPostRun: BswMActionListItemIndex=2, BswMActionListItemRef=BswMModeControl/ESH_Action_OnEnterPostRun
            ESH_Action_SwitchPostRun: BswMActionListItemIndex=3, BswMActionListItemRef=BswMModeControl/ESH_Action_SwitchPostRun
            ESH_Action_ESH_PostRun: BswMActionListItemIndex=4, BswMActionListItemRef=BswMModeControl/ESH_Action_ESH_PostRun
            ESH_Action_ComMDisallow_CAN00_f26020e5: BswMActionListItemIndex=0, BswMActionListItemRef=BswMModeControl/ESH_Action_ComMDisallow_CAN00_f26020e5
        3 x BswMAction:
          ESH_Action_EcuMClearValidatedWakeupEvents
            BswMAvailableActions
              BswMUserCallout: BswMUserCalloutFunction=EcuM_ClearValidatedWakeupEvent(ECUM_WKSOURCE_ALL_SOURCES), BswMCreateCallout=false, BswMUserIncludeFile=EcuM.h
          ESH_Action_OnEnterPostRun
            BswMAvailableActions
              BswMUserCallout: BswMUserCalloutFunction=BswM_ESH_OnEnterPostRun(), BswMCreateCallout=true
          ESH_Action_SwitchPostRun
            BswMAvailableActions
              BswMRteSwitch: BswMSwitchedMode=POSTRUN, BswMRteSwitchPortRef=ESH_ModeSwitch
        ESH_ModeSwitch (BswMSwitchPort): BswMModeSwitchInterfaceRef=BswM_MSI_ESH_Mode
        ESH_Action_ESH_PostRun (BswMAction)
          BswMAvailableActions
            BswMGenericModeSwitch: BswMGenericRequestRef=ESH_State, BswMGenericRequestModeRef=ESH_POST_RUN
        ESH_Action_ExitExclusiveArea (BswMAction)
          BswMAvailableActions
            BswMUserCallout: BswMUserCalloutFunction=SchM_Exit_BswM_BSWM_EXCLUSIVE_AREA_0(), BswMCreateCallout=false, BswMUserIncludeFile=SchM_BswM.h
        ESH_AL_WaitForNvMToShutdown (BswMActionList): BswMActionListExecution=BSWM_CONDITION
          ESH_Action_OnEnterShutdown (BswMActionListItem): BswMAbortOnFail=false, BswMActionListItemIndex=0, BswMActionListItemRef=BswMModeControl/ESH_Action_OnEnterShutdown
          ESH_Action_EcuMGoToSelectedShutdownTarget (BswMActionListItem): BswMAbortOnFail=false, BswMActionListItemIndex=1, BswMActionListItemRef=BswMModeControl/ESH_Action_EcuMGoToSelectedShutdownTarget
        ESH_Action_OnEnterShutdown (BswMAction)
          BswMAvailableActions
            BswMUserCallout: BswMUserCalloutFunction=BswM_ESH_OnEnterShutdown(), BswMCreateCallout=true
        ESH_Action_EcuMGoToSelectedShutdownTarget (BswMAction)
          BswMAvailableActions
            BswMUserCallout: BswMUserCalloutFunction=(void)EcuM_GoToSelectedShutdownTarget(), BswMCreateCallout=false, BswMUserIncludeFile=EcuM.h
        ESH_AL_WakeupToPrep (BswMActionList): BswMActionListExecution=BSWM_CONDITION
          3 x BswMActionListItem, all with BswMAbortOnFail=false:
            ESH_Action_OnEnterPrepShutdown: BswMActionListItemIndex=0, BswMActionListItemRef=BswMModeControl/ESH_Action_OnEnterPrepShutdown
            ESH_Action_SwitchShutdown: BswMActionListItemIndex=1, BswMActionListItemRef=BswMModeControl/ESH_Action_SwitchShutdown
            ESH_Action_ESH_PrepShutdown: BswMActionListItemIndex=2, BswMActionListItemRef=BswMModeControl/ESH_Action_ESH_PrepShutdown
        3 x BswMAction:
          ESH_Action_OnEnterPrepShutdown
            BswMAvailableActions
              BswMUserCallout: BswMUserCalloutFunction=BswM_ESH_OnEnterPrepShutdown(), BswMCreateCallout=true
          ESH_Action_SwitchShutdown
            BswMAvailableActions
              BswMRteSwitch: BswMSwitchedMode=SHUTDOWN, BswMRteSwitchPortRef=ESH_ModeSwitch
          ESH_Action_ESH_PrepShutdown
            BswMAvailableActions
              BswMGenericModeSwitch: BswMGenericRequestRef=ESH_State, BswMGenericRequestModeRef=ESH_PREP_SHUTDOWN
        ESH_AL_WaitForNvMWakeup (BswMActionList): BswMActionListExecution=BSWM_CONDITION
          3 x BswMActionListItem, all with BswMAbortOnFail=false:
            ESH_Action_OnEnterWakeup: BswMActionListItemIndex=0, BswMActionListItemRef=BswMModeControl/ESH_Action_OnEnterWakeup
            ESH_Action_SwitchWakeup: BswMActionListItemIndex=1, BswMActionListItemRef=BswMModeControl/ESH_Action_SwitchWakeup
            ESH_Action_ESH_Wakeup: BswMActionListItemIndex=2, BswMActionListItemRef=BswMModeControl/ESH_Action_ESH_Wakeup
        3 x BswMAction:
          ESH_Action_OnEnterWakeup
            BswMAvailableActions
              BswMUserCallout: BswMUserCalloutFunction=BswM_ESH_OnEnterWakeup(), BswMCreateCallout=true
          ESH_Action_SwitchWakeup
            BswMAvailableActions
              BswMRteSwitch: BswMSwitchedMode=WAKEUP, BswMRteSwitchPortRef=ESH_ModeSwitch
          ESH_Action_ESH_Wakeup
            BswMAvailableActions
              BswMGenericModeSwitch: BswMGenericRequestRef=ESH_State, BswMGenericRequestModeRef=ESH_WAKEUP
        ESH_AL_WakeupToRun (BswMActionList): BswMActionListExecution=BSWM_CONDITION
          6 x BswMActionListItem, all with BswMAbortOnFail=false:
            ESH_Action_SelfRunRequestTimer_Start: BswMActionListItemIndex=1, BswMActionListItemRef=BswMModeControl/ESH_Action_SelfRunRequestTimer_Start
            ESH_Action_OnEnterRun: BswMActionListItemIndex=2, BswMActionListItemRef=BswMModeControl/ESH_Action_OnEnterRun
            ESH_Action_SwitchRun: BswMActionListItemIndex=3, BswMActionListItemRef=BswMModeControl/ESH_Action_SwitchRun
            ESH_Action_ESH_Run: BswMActionListItemIndex=4, BswMActionListItemRef=BswMModeControl/ESH_Action_ESH_Run
            RTE_REQUEST_BswMRteModeRequestPort_REQUESTED: BswMActionListItemIndex=5, BswMActionListItemRef=BswMModeControl/RTE_REQUEST_BswMRteModeRequestPort_REQUESTED
            ESH_Action_ComMAllow_CAN00_f26020e5: BswMActionListItemIndex=0, BswMActionListItemRef=BswMModeControl/ESH_Action_ComMAllow_CAN00_f26020e5
        4 x BswMAction:
          ESH_Action_SelfRunRequestTimer_Start
            BswMAvailableActions
              BswMTimerControl: BswMTimerAction=BSWM_TIMER_START, BswMTimerValue=0.1, BswMTimerRef=ESH_SelfRunRequestTimer
          ESH_Action_OnEnterRun
            BswMAvailableActions
              BswMUserCallout: BswMUserCalloutFunction=BswM_ESH_OnEnterRun(), BswMCreateCallout=true
          ESH_Action_SwitchRun
            BswMAvailableActions
              BswMRteSwitch: BswMSwitchedMode=RUN, BswMRteSwitchPortRef=ESH_ModeSwitch
          ESH_Action_ESH_Run
            BswMAvailableActions
              BswMGenericModeSwitch: BswMGenericRequestRef=ESH_State, BswMGenericRequestModeRef=ESH_RUN
        6 x BswMActionList, all with BswMActionListExecution=BSWM_CONDITION:
          ESH_AL_InitToWakeup
            3 x BswMActionListItem, all with BswMAbortOnFail=false:
              ESH_Action_OnEnterWakeup: BswMActionListItemIndex=0, BswMActionListItemRef=BswMModeControl/ESH_Action_OnEnterWakeup
              ESH_Action_SwitchWakeup: BswMActionListItemIndex=1, BswMActionListItemRef=BswMModeControl/ESH_Action_SwitchWakeup
              ESH_Action_ESH_Wakeup: BswMActionListItemIndex=2, BswMActionListItemRef=BswMModeControl/ESH_Action_ESH_Wakeup
          ESH_AL_PostRunToPrepShutdown
            3 x BswMActionListItem, all with BswMAbortOnFail=false:
              ESH_Action_OnEnterPrepShutdown: BswMActionListItemIndex=0, BswMActionListItemRef=BswMModeControl/ESH_Action_OnEnterPrepShutdown
              ESH_Action_SwitchShutdown: BswMActionListItemIndex=1, BswMActionListItemRef=BswMModeControl/ESH_Action_SwitchShutdown
              ESH_Action_ESH_PrepShutdown: BswMActionListItemIndex=2, BswMActionListItemRef=BswMModeControl/ESH_Action_ESH_PrepShutdown
          ESH_AL_ESH_PostRunToPrepCheck
            ESH_PostRunToPrepNested (BswMActionListItem): BswMAbortOnFail=false, BswMActionListItemIndex=0, BswMActionListItemRef=BswMArbitration/ESH_PostRunToPrepNested
          ESH_AL_PostRunToRun
            5 x BswMActionListItem, all with BswMAbortOnFail=false:
              ESH_Action_SelfRunRequestTimer_Start: BswMActionListItemIndex=1, BswMActionListItemRef=BswMModeControl/ESH_Action_SelfRunRequestTimer_Start
              ESH_Action_OnEnterRun: BswMActionListItemIndex=2, BswMActionListItemRef=BswMModeControl/ESH_Action_OnEnterRun
              ESH_Action_SwitchRun: BswMActionListItemIndex=3, BswMActionListItemRef=BswMModeControl/ESH_Action_SwitchRun
              ESH_Action_ESH_Run: BswMActionListItemIndex=4, BswMActionListItemRef=BswMModeControl/ESH_Action_ESH_Run
              ESH_Action_ComMAllow_CAN00_f26020e5: BswMActionListItemIndex=0, BswMActionListItemRef=BswMModeControl/ESH_Action_ComMAllow_CAN00_f26020e5
          ESH_AL_ExitPostRun
            4 x BswMActionListItem, all with BswMAbortOnFail=false:
              ESH_Action_EnterExclusiveArea: BswMActionListItemIndex=0, BswMActionListItemRef=BswMModeControl/ESH_Action_EnterExclusiveArea
              ESH_Action_ComMCheckPendingRequests: BswMActionListItemIndex=1, BswMActionListItemRef=BswMModeControl/ESH_Action_ComMCheckPendingRequests
              ESH_PostRunNested: BswMActionListItemIndex=2, BswMActionListItemRef=BswMArbitration/ESH_PostRunNested
              ESH_Action_ExitExclusiveArea: BswMActionListItemIndex=3, BswMActionListItemRef=BswMModeControl/ESH_Action_ExitExclusiveArea
          ESH_AL_PrepShutdownToWaitForNvM
            3 x BswMActionListItem, all with BswMAbortOnFail=false:
              ESH_Action_ComMCheckPendingRequests: BswMActionListItemIndex=0, BswMActionListItemRef=BswMModeControl/ESH_Action_ComMCheckPendingRequests
              ESH_Action_OnEnterWaitForNvm: BswMActionListItemIndex=1, BswMActionListItemRef=BswMModeControl/ESH_Action_OnEnterWaitForNvm
              ESH_Action_ESH_WaitForNvm: BswMActionListItemIndex=2, BswMActionListItemRef=BswMModeControl/ESH_Action_ESH_WaitForNvm
        ESH_Action_OnEnterWaitForNvm (BswMAction)
          BswMAvailableActions
            BswMUserCallout: BswMUserCalloutFunction=BswM_ESH_OnEnterWaitForNvm(), BswMCreateCallout=true
        ESH_Action_ESH_WaitForNvm (BswMAction)
          BswMAvailableActions
            BswMGenericModeSwitch: BswMGenericRequestRef=ESH_State, BswMGenericRequestModeRef=ESH_WAIT_FOR_NVM
        INIT_AL_Initialize (BswMActionList): BswMActionListExecution=BSWM_CONDITION
          7 x BswMActionListItem, all with BswMAbortOnFail=false:
            INIT_Action_Can_Init: BswMActionListItemIndex=0, BswMActionListItemRef=BswMModeControl/INIT_Action_Can_Init
            INIT_Action_CanIf_Init: BswMActionListItemIndex=1, BswMActionListItemRef=BswMModeControl/INIT_Action_CanIf_Init
            INIT_Action_EnableInterrupts: BswMActionListItemIndex=5, BswMActionListItemRef=BswMModeControl/INIT_Action_EnableInterrupts
            INIT_Action_RteStart: BswMActionListItemIndex=6, BswMActionListItemRef=BswMModeControl/INIT_Action_RteStart
            INIT_Action_Com_Init: BswMActionListItemIndex=2, BswMActionListItemRef=BswMModeControl/INIT_Action_Com_Init
            INIT_Action_PduR_Init: BswMActionListItemIndex=3, BswMActionListItemRef=BswMModeControl/INIT_Action_PduR_Init
            INIT_Action_CanSM_Init: BswMActionListItemIndex=4, BswMActionListItemRef=BswMModeControl/INIT_Action_CanSM_Init
        4 x BswMAction:
          INIT_Action_Can_Init
            BswMAvailableActions
              BswMUserCallout: BswMUserCalloutFunction=Can_Init(Can_Config_Ptr), BswMCreateCallout=false, BswMUserIncludeFile=Can.h
          INIT_Action_CanIf_Init
            BswMAvailableActions
              BswMUserCallout: BswMUserCalloutFunction=CanIf_Init(CanIf_Config_Ptr), BswMCreateCallout=false, BswMUserIncludeFile=CanIf.h
          INIT_Action_EnableInterrupts
            BswMAvailableActions
              BswMUserCallout: BswMUserCalloutFunction=BswM_AL_SetProgrammableInterrupts(), BswMCreateCallout=true
          INIT_Action_RteStart
            BswMAvailableActions
              BswMUserCallout: BswMUserCalloutFunction=(void)Rte_Start(), BswMCreateCallout=false, BswMUserIncludeFile=Rte_Main.h
        BswMRteModeRequestPort: BswMRteModeInitValue=REQUESTED, BswMRteModeRequestPortInterfaceRef=BswM.Request_ESH_RunRequest_0.requestedMode
        RTE_REQUEST_BswMRteModeRequestPort_REQUESTED (BswMAction)
          BswMAvailableActions
            BswMRteModeRequest: BswMRequestedMode=REQUESTED, BswMRteModeRequestPortRef=BswMRteModeRequestPort
        CC_AL_CAN00_f26020e5_TX_Disable (BswMActionList): BswMActionListExecution=BSWM_TRIGGER
          CC_DisablePDUGroup_MyECU_oCAN00_Tx_fcef2243 (BswMActionListItem): BswMAbortOnFail=false, BswMActionListItemIndex=0, BswMActionListItemRef=BswMModeControl/CC_DisablePDUGroup_MyECU_oCAN00_Tx_fcef2243
        CC_DisablePDUGroup_MyECU_oCAN00_Tx_fcef2243 (BswMAction)
          BswMAvailableActions
            BswMPduGroupSwitch: BswMPduGroupSwitchReinit=false, BswMDisabledPduGroupRef=MyECU_oCAN00_Tx_fcef2243
        CC_AL_CAN00_f26020e5_TX_EnableNoinit (BswMActionList): BswMActionListExecution=BSWM_TRIGGER
          CC_EnablePDUGroup_MyECU_oCAN00_Tx_fcef2243 (BswMActionListItem): BswMAbortOnFail=false, BswMActionListItemIndex=0, BswMActionListItemRef=BswMModeControl/CC_EnablePDUGroup_MyECU_oCAN00_Tx_fcef2243
        CC_EnablePDUGroup_MyECU_oCAN00_Tx_fcef2243 (BswMAction)
          BswMAvailableActions
            BswMPduGroupSwitch: BswMPduGroupSwitchReinit=false, BswMEnabledPduGroupRef=MyECU_oCAN00_Tx_fcef2243
        CC_AL_CAN00_f26020e5_Disable_DM (BswMActionList): BswMActionListExecution=BSWM_TRIGGER
          CC_DisableDM_MyECU_oCAN00_Rx_fcef2243 (BswMActionListItem): BswMAbortOnFail=false, BswMActionListItemIndex=0, BswMActionListItemRef=BswMModeControl/CC_DisableDM_MyECU_oCAN00_Rx_fcef2243
        CC_DisableDM_MyECU_oCAN00_Rx_fcef2243 (BswMAction)
          BswMAvailableActions
            BswMDeadlineMonitoringControl: BswMDisabledDMPduGroupRef=MyECU_oCAN00_Rx_fcef2243
        CC_AL_CAN00_f26020e5_Enable_DM (BswMActionList): BswMActionListExecution=BSWM_TRIGGER
          CC_EnableDM_MyECU_oCAN00_Rx_fcef2243 (BswMActionListItem): BswMAbortOnFail=false, BswMActionListItemIndex=0, BswMActionListItemRef=BswMModeControl/CC_EnableDM_MyECU_oCAN00_Rx_fcef2243
        CC_EnableDM_MyECU_oCAN00_Rx_fcef2243 (BswMAction)
          BswMAvailableActions
            BswMDeadlineMonitoringControl: BswMEnabledDMPduGroupRef=MyECU_oCAN00_Rx_fcef2243
        CC_AL_CAN00_f26020e5_RX_Disable (BswMActionList): BswMActionListExecution=BSWM_TRIGGER
          CC_DisablePDUGroup_MyECU_oCAN00_Rx_fcef2243 (BswMActionListItem): BswMAbortOnFail=false, BswMActionListItemIndex=0, BswMActionListItemRef=BswMModeControl/CC_DisablePDUGroup_MyECU_oCAN00_Rx_fcef2243
        CC_DisablePDUGroup_MyECU_oCAN00_Rx_fcef2243 (BswMAction)
          BswMAvailableActions
            BswMPduGroupSwitch: BswMPduGroupSwitchReinit=false, BswMDisabledPduGroupRef=MyECU_oCAN00_Rx_fcef2243
        CC_AL_CAN00_f26020e5_RX_EnableNoinit (BswMActionList): BswMActionListExecution=BSWM_TRIGGER
          CC_EnablePDUGroup_MyECU_oCAN00_Rx_fcef2243 (BswMActionListItem): BswMAbortOnFail=false, BswMActionListItemIndex=0, BswMActionListItemRef=BswMModeControl/CC_EnablePDUGroup_MyECU_oCAN00_Rx_fcef2243
        6 x BswMAction:
          CC_EnablePDUGroup_MyECU_oCAN00_Rx_fcef2243
            BswMAvailableActions
              BswMPduGroupSwitch: BswMPduGroupSwitchReinit=false, BswMEnabledPduGroupRef=MyECU_oCAN00_Rx_fcef2243
          ESH_Action_ComMDisallow_CAN00_f26020e5
            BswMAvailableActions
              BswMComMAllowCom: BswMComAllowed=false, BswMComMAllowChannelRef=ComMConfigSet/CAN00_f26020e5
          ESH_Action_ComMAllow_CAN00_f26020e5
            BswMAvailableActions
              BswMComMAllowCom: BswMComAllowed=true, BswMComMAllowChannelRef=ComMConfigSet/CAN00_f26020e5
          INIT_Action_Com_Init
            BswMAvailableActions
              BswMUserCallout: BswMUserCalloutFunction=Com_Init(Com_Config_Ptr), BswMCreateCallout=false, BswMUserIncludeFile=Com.h
          INIT_Action_PduR_Init
            BswMAvailableActions
              BswMUserCallout: BswMUserCalloutFunction=PduR_Init(PduR_Config_Ptr), BswMCreateCallout=false, BswMUserIncludeFile=PduR.h
          INIT_Action_CanSM_Init
            BswMAvailableActions
              BswMUserCallout: BswMUserCalloutFunction=CanSM_Init(CanSM_Config_Ptr), BswMCreateCallout=false, BswMUserIncludeFile=CanSM_EcuM.h
      ESH_Mode (BswMRteModeDclGroup): BswMInitMode=STARTUP
        5 x BswMRteMode:
          STARTUP: BswMModePhysicalValue=0
          RUN: BswMModePhysicalValue=1
          POSTRUN: BswMModePhysicalValue=2
          WAKEUP: BswMModePhysicalValue=3
          SHUTDOWN: BswMModePhysicalValue=4
      ESH_RunRequest (BswMRteModeDclGroup): BswMInitMode=RELEASED
        RELEASED (BswMRteMode): BswMModePhysicalValue=0
        REQUESTED (BswMRteMode): BswMModePhysicalValue=1
      BswMDataTypeMappingSets: BswMDataTypeMappingSetRef=BswMMappingSet
  module config Dem: implementation-config-variant=VARIANT-PRE-COMPILE, module-description=Dem_Impl
    DemConfigSet
      DTCClass_DTC_0x000003 (DemDTCClass): DemDTCSeverity=DEM_DTC_SEV_NO_SEVERITY, DemUdsDTC=3, DemImmediateNvStorage=false
      DTC_0x000002 (DemEventParameter):
        DemEventKind = DEM_EVENT_KIND_SWC
        DemMaxNumberFreezeFrameRecords = 1
        DemEventTimeSeries = DEM_TIMESERIES_SNAPSHOT_NONE
        DemEventAvailable = true
        DemEventId = 1
        DemEventAvailableInVariant = true
        DemEventLatchTestFailed = false
        DemDTCClassRef = DTCClass_DTC_0x000002
        DemExtendedDataClassRef = ExtendedDataClass_83dcefb7
        DemFreezeFrameClassRef = FreezeFrameClass_d65a1577
        DemEventClass:
          DemAgingAllowed = false
          DemAgingCycleCounterThreshold = 100
          DemEventDestination = DEM_DTC_ORIGIN_PRIMARY_MEMORY
          DemEventPriority = 2
          DemEventFailureCycleCounterThreshold = 0
          DemConsiderPtoStatus = false
          DemFFPrestorageSupported = false
          DemAgingCycleRef = IgnitionCycle
          DemOperationCycleRef = PowerCycle
          DemDebounceAlgorithmClass
            DemDebounceCounterBased:
              DemDebounceCounterDecrementStepSize = 1
              DemDebounceCounterIncrementStepSize = 1
              DemDebounceCounterJumpDown = false
              DemDebounceCounterJumpUp = true
              DemDebounceBehavior = DEM_DEBOUNCE_FREEZE
              DemDebounceCounterFailedThreshold = 127
              DemDebounceCounterJumpDownValue = 0
              DemDebounceCounterJumpUpValue = 0
              DemDebounceCounterPassedThreshold = -128
              DemDebounceCounterStorage = false
              DemDebounceContinuous = false
          IndicatorAttribute_WarningIndicator (DemIndicatorAttribute):
            DemIndicatorFailureCycleSource = DEM_FAILURE_CYCLE_EVENT
            DemIndicatorBehaviour = DEM_INDICATOR_CONTINUOUS
            DemIndicatorHealingCycleCounterThreshold = 3
            DemIndicatorHealingCycleRef = PowerCycle
            DemIndicatorRef = WarningIndicator
        DemCallbackInitMForE
      DTC_0x000003 (DemEventParameter):
        DemEventKind = DEM_EVENT_KIND_SWC
        DemMaxNumberFreezeFrameRecords = 1
        DemEventTimeSeries = DEM_TIMESERIES_SNAPSHOT_NONE
        DemEventAvailable = true
        DemEventId = 2
        DemEventAvailableInVariant = true
        DemEventLatchTestFailed = false
        DemDTCClassRef = DTCClass_DTC_0x000003
        DemExtendedDataClassRef = ExtendedDataClass_83dcefb7
        DemFreezeFrameClassRef = FreezeFrameClass_5440cf4a
        DemEventClass:
          DemAgingAllowed = true
          DemAgingCycleCounterThreshold = 40
          DemEventDestination = DEM_DTC_ORIGIN_PRIMARY_MEMORY
          DemEventPriority = 1
          DemEventFailureCycleCounterThreshold = 2
          DemConsiderPtoStatus = false
          DemFFPrestorageSupported = false
          DemAgingCycleRef = WarmUpCycle
          DemOperationCycleRef = OBDDrivingCycle
          DemDebounceAlgorithmClass
            DemDebounceCounterBased:
              DemDebounceCounterDecrementStepSize = 1
              DemDebounceCounterIncrementStepSize = 1
              DemDebounceCounterJumpDown = false
              DemDebounceCounterJumpUp = true
              DemDebounceBehavior = DEM_DEBOUNCE_FREEZE
              DemDebounceCounterFailedThreshold = 127
              DemDebounceCounterJumpDownValue = 0
              DemDebounceCounterJumpUpValue = 0
              DemDebounceCounterPassedThreshold = -128
              DemDebounceCounterStorage = false
              DemDebounceContinuous = false
          IndicatorAttribute_WarningIndicator (DemIndicatorAttribute):
            DemIndicatorFailureCycleSource = DEM_FAILURE_CYCLE_EVENT
            DemIndicatorBehaviour = DEM_INDICATOR_CONTINUOUS
            DemIndicatorHealingCycleCounterThreshold = 3
            DemIndicatorHealingCycleRef = OBDDrivingCycle
            DemIndicatorRef = WarningIndicator
      DTCClass_DTC_0x000002 (DemDTCClass): DemDTCSeverity=DEM_DTC_SEV_NO_SEVERITY, DemUdsDTC=2, DemImmediateNvStorage=false
    DemGeneral:
      DemAgingCycleCounterProcessing = DEM_PROCESS_AGINGCTR_INTERN
      DemDebounceCounterBasedSupport = true
      DemDtcStatusAvailabilityMask = 255
      DemMaxNumberEventEntryMirror = 0
      DemPTOSupport = false
      DemTypeOfFreezeFrameRecordNumeration = DEM_FF_RECNUM_CALCULATED
      DemGeneralInterfaceSupport = false
      DemDataElementDefaultEndianness = LITTLE_ENDIAN
      DemAgingRequieresTestedCycle = false
      DemTriggerMonitorInitBeforeClearOk = true
      DemExtendedDataCapture = DEM_TRIGGER_EVENT_MEMORY_STORAGE
      DemFreezeFrameCapture = DEM_TRIGGER_EVENT_MEMORY_STORAGE
      DemOperationCycleProcessing = DEM_PROCESS_OPCYC_STATE
      DemMaxNumberTimeSeriesSnapshots = 0
      DemAvailabilitySupport = DEM_NO_AVAILABILITY
      DemAvailabilityStorage = false
      DemBswErrorBufferSize = 0
      DemClearDTCBehavior = DEM_CLRRESP_VOLATILE
      DemClearDTCLimitation = DEM_ALL_SUPPORTED_DTCS
      DemDebounceTimeBasedSupport = false
      DemDevErrorDetect = true
      DemEnableConditionSupport = false
      DemEventCombinationSupport = DEM_EVCOMB_DISABLED
      DemEventDisplacementStrategy = DEM_DISPLACEMENT_LEGACY_403
      DemEventMemoryEntryStorageTrigger = DEM_STORAGE_ON_TEST_FAILED
      DemMaxNumberEventEntryOBDFreezeFrame = 0
      DemMaxNumberEventEntryPermanent = 0
      DemMaxNumberEventEntryPrimary = 8
      DemMaxNumberEventEntrySecondary = 0
      DemMaxNumberPrestoredFF = 0
      DemOBDSupport = DEM_OBD_NO_OBD_SUPPORT
      DemOccurrenceCounterProcessing = DEM_PROCESS_OCCCTR_TF
      DemOperationCycleStatusStorage = false
      DemResetConfirmedBitOnOverflow = true
      DemStatusBitHandlingTestFailedSinceLastClear = DEM_STATUS_BIT_NORMAL
      DemStatusBitStorageTestFailed = true
      DemStorageConditionSupport = false
      DemSuppressionSupport = DEM_NO_SUPPRESSION
      DemTaskTime = 0.01
      DemTriggerDcmReports = false
      DemTriggerDltReports = false
      DemTriggerFiMReports = false
      DemTriggerMonitorInitForEnableConditions = false
      DemTypeOfDTCSupported = DEM_DTC_TRANSLATION_ISO14229_1
      DemVersionInfoApi = false
      DemBswApiVersion = DEM_BSW_API_4_XX_XX
      DemBswApiVersionNvM = DEM_BSW_API_4_XX_XX
      DemBswApiVersionFiM = DEM_BSW_API_4_XX_XX
      DemAgingAfterHealing = DEM_AGING_WHILE_HEALING
      DemAgingBehavior = DEM_AGING_TYPE_1
      DemAgingCounterBehavior = DEM_AGING_COUNT_ALWAYS
      DemAgingCounterReporting = DEM_AGING_NORMAL_REPORTING
      DemAgingRetainEnvironmentalData = false
      DemCompiledPostbuildCrc = 3545464305
      DemCompiledPostbuildCrcMode = DEM_POSTBUILD_CRC_AUTOMATIC
      DemEventDisplacementFallbackStrategy = DEM_FALLBACK_DISCARD_NEW_EVENT
      DemGeneralDiagnosticInfoSupport = true
      DemJ1939Support = false
      DemNvSynchronizeSupport = false
      DemPendingDtcProcessing = DEM_PROCESS_PDTC_STOREDONLY
      DemResetDebounceBehavior = DEM_RESET_DEBOUNCE_ON_DISABLE_ENABLE_CONDITIONS
      DemResetTestFailedOnOperationCycleStart = false
      DemRetryStorageSupport = false
      DemSafeBswChecks = false
      DemUseMemcopyMacros = false
      DemUseRte = true
      DemUserControlledWirBehavior = DEM_DISABLED_DURING_CONTROLDTCSETTING
      DemUserDefinedCompareAndSwap = false
      DemWarningIndicatorRequestedProcessing = DEM_PROCESS_WIR_STOREDONLY
      OccurrenceCounter (DemExtendedDataRecordClass): DemExtendedDataRecordNumber=1, DemDataClassRef=OccurrenceCounter_Occurrence_Counter
      DemPostbuild: DemEventAvailableDefaultSupport=true, DemMaxSizeFreezeFrame=10, DemMaxNumberDtr=0
      WarmUpCycle (DemOperationCycle): DemOperationCycleType=DEM_OPCYC_WARMUP, DemOperationCycleAutomaticEnd=false, DemOperationCycleAutostart=false
      IgnitionCycle (DemOperationCycle): DemOperationCycleType=DEM_OPCYC_IGNITION, DemOperationCycleAutomaticEnd=false, DemOperationCycleAutostart=false
      OccurrenceCounter_Occurrence_Counter (DemDataClass): DemDataElementDataSize=1, DemDataElementInternalData=DEM_OCCCTR, DemDataElementUsePort=USE_DATA_INTERNAL, DemDataElementStoreNonVolatile=true
      ExtendedDataClass_83dcefb7 (DemExtendedDataClass): DemExtendedDataRecordClassRef=OccurrenceCounter
      DID_0xF412 (DemDidClass): DemDidIdentifier=62482, DemDidDataClassRef=PID_0x12_DID_Data
      PID_0x12_DID_Data (DemDataClass):
        DemDataElementDataSize = 2
        DemDataElementDataType = UINT16
        DemDataElementEndianness = BIG_ENDIAN
        DemDataElementUsePort = USE_DATA_CLIENT_SERVER_PORT
        DemDataElementStoreNonVolatile = true
      DID_0xF413 (DemDidClass): DemDidIdentifier=62483, DemDidDataClassRef=PID_0x13_DID_Data
      DemEventMemorySet
      DID_0x1_DID_Data_GlobalTime (DemDataClass):
        DemDataElementDataSize = 6
        DemDataElementDataType = UINT8_N
        DemDataElementEndianness = opaque
        DemDataElementUsePort = USE_DATA_CLIENT_SERVER_PORT
        DemDataElementStoreNonVolatile = true
      FreezeFrameClass_d65a1577 (DemFreezeFrameClass): DemDidClassRef=DemGeneral/Example_ReadOnlyDID
      OBDDrivingCycle (DemOperationCycle): DemOperationCycleType=DEM_OPCYC_OBD_DCY, DemOperationCycleAutomaticEnd=false, DemOperationCycleAutostart=false
      Example_ReadOnlyDID (DemDidClass): DemDidIdentifier=1, DemDidDataClassRef=DID_0x1_DID_Data_GlobalTime
      WarningIndicator (DemIndicator): DemIndicatorID=0
      FreezeFrameClass_5440cf4a (DemFreezeFrameClass): DemDidClassRef=DemGeneral/Example_ReadOnlyDID, DemDidClassRef=DemGeneral/DID_0xF412, DemDidClassRef=DemGeneral/DID_0xF413
      PowerCycle (DemOperationCycle): DemOperationCycleType=DEM_OPCYC_POWER, DemOperationCycleAutomaticEnd=false, DemOperationCycleAutostart=false
      PID_0x13_DID_Data (DemDataClass):
        DemDataElementDataSize = 2
        DemDataElementDataType = UINT16
        DemDataElementEndianness = BIG_ENDIAN
        DemDataElementUsePort = USE_DATA_CLIENT_SERVER_PORT
        DemDataElementStoreNonVolatile = true
  module config Dcm: implementation-config-variant=VARIANT-PRE-COMPILE, module-description=Dcm_Impl
    DcmConfigSet
      DcmDsl
        DcmDslProtocol
        DcmDslDiagResp: DcmDslDiagRespMaxNumRespPend=0, DcmDslDiagRespOnSecondDeclinedRequest=false, DcmDslDiagRespMaxNumOfDeclinedRequests=3
      DcmGeneral:
        DcmDevErrorDetect = true
        DcmRequestManufacturerNotificationEnabled = false
        DcmRequestSupplierNotificationEnabled = false
        DcmRespondAllRequest = true
        DcmTaskTime = 0.01
        DcmVersionInfoApi = false
        DcmDspDataDefaultEndianness = LITTLE_ENDIAN
        DcmSafeBswChecks = false
        DcmSupportedIDCalculationSuppressionEnabled = false
        DcmDtrDataProvisionViaDemEnabled = true
        DcmForeignDiagnosticRequestDetectionEnabled = false
        DcmSuppressResponseOnCanTpFuncMixedAddrRequests = false
      DcmDsd
        DcmDsdServiceTable
          16 x DcmDsdService:
            ClearDiagInfo: DcmDsdSidTabServiceId=20, DcmDsdSidTabSubfuncAvail=false
            EcuReset: DcmDsdSidTabServiceId=17, DcmDsdSidTabSubfuncAvail=true
              Hard (DcmDsdSubService): DcmDsdSubServiceId=1
            ControlDtcSetting: DcmDsdSidTabServiceId=133, DcmDsdSidTabSubfuncAvail=true
              Disable (DcmDsdSubService): DcmDsdSubServiceId=2
              Enable (DcmDsdSubService): DcmDsdSubServiceId=1
            WriteDataById: DcmDsdSidTabServiceId=46, DcmDsdSidTabSubfuncAvail=false
            ReadDataById: DcmDsdSidTabServiceId=34, DcmDsdSidTabSubfuncAvail=false
            SecurityAccess: DcmDsdSidTabServiceId=39, DcmDsdSidTabSubfuncAvail=true, DcmDsdSidTabSessionLevelRef=DcmDspSession/Programming, DcmDsdSidTabSessionLevelRef=DcmDspSession/Extended
              4 x DcmDsdSubService, all with DcmDsdSubServiceSessionLevelRef=DcmDspSession/Programming, DcmDsdSubServiceSessionLevelRef=DcmDspSession/Extended:
                SeedLevel1_Request: DcmDsdSubServiceId=1
                sendKey_Send: DcmDsdSubServiceId=4
                requestSeed_Request: DcmDsdSubServiceId=3
                KeyLevel1_Send: DcmDsdSubServiceId=2
            ReadMemoryByAddress: DcmDsdSidTabServiceId=35, DcmDsdSidTabSubfuncAvail=false
            ReadDtcInfo: DcmDsdSidTabServiceId=25, DcmDsdSidTabSubfuncAvail=true
              12 x DcmDsdSubService:
                RNODTCBSMR: DcmDsdSubServiceId=7
                RDTCFDC: DcmDsdSubServiceId=20
                RFCDTC: DcmDsdSubServiceId=12
                RDTCEDRBDN: DcmDsdSubServiceId=6
                RDTCSSI: DcmDsdSubServiceId=3
                RSUPDTC: DcmDsdSubServiceId=10
                RDTCBSM: DcmDsdSubServiceId=2
                RDTCBSMR: DcmDsdSubServiceId=8
                RNODTCBSM: DcmDsdSubServiceId=1
                RDTCSSBDTC: DcmDsdSubServiceId=4
                RMRTFDTC: DcmDsdSubServiceId=13
                RSIODTC: DcmDsdSubServiceId=9
            TesterPresent: DcmDsdSidTabServiceId=62, DcmDsdSidTabSubfuncAvail=true
              TesterPresent (DcmDsdSubService): DcmDsdSubServiceId=0
            WriteMemoryByAddress: DcmDsdSidTabServiceId=61, DcmDsdSidTabSubfuncAvail=false
            DynamicallyDefineDataId: DcmDsdSidTabServiceId=44, DcmDsdSidTabSubfuncAvail=true
              3 x DcmDsdSubService:
                DynDefByAddr: DcmDsdSubServiceId=2
                DynDefById: DcmDsdSubServiceId=1
                DynDefClr: DcmDsdSubServiceId=3
            CommunicationControl: DcmDsdSidTabServiceId=40, DcmDsdSidTabSubfuncAvail=true, DcmDsdSidTabSessionLevelRef=DcmDspSession/Programming, DcmDsdSidTabSessionLevelRef=DcmDspSession/Extended
              4 x DcmDsdSubService, all with DcmDsdSubServiceSessionLevelRef=DcmDspSession/Programming, DcmDsdSubServiceSessionLevelRef=DcmDspSession/Extended:
                DisableRxAndEnableTx: DcmDsdSubServiceId=2
                EnableRxAndDisableTx: DcmDsdSubServiceId=1
                DisableRxAndTx: DcmDsdSubServiceId=3
                EnableRxAndTx: DcmDsdSubServiceId=0
            RoutineControl: DcmDsdSidTabServiceId=49, DcmDsdSidTabSubfuncAvail=true, DcmDsdSidTabSessionLevelRef=DcmDspSession/Programming, DcmDsdSidTabSessionLevelRef=DcmDspSession/Extended
            IoControlById: DcmDsdSidTabServiceId=47, DcmDsdSidTabSubfuncAvail=false, DcmDsdSidTabSessionLevelRef=DcmDspSession/Extended
            ReadDataByPeriodicId: DcmDsdSidTabServiceId=42, DcmDsdSidTabSubfuncAvail=false, DcmDsdSidTabSessionLevelRef=DcmDspSession/Programming, DcmDsdSidTabSessionLevelRef=DcmDspSession/Extended
            DiagSessionControl: DcmDsdSidTabServiceId=16, DcmDsdSidTabSubfuncAvail=true
              3 x DcmDsdSubService:
                Programming: DcmDsdSubServiceId=2
                Default: DcmDsdSubServiceId=1
                Extended: DcmDsdSubServiceId=3
      DcmDsp: DcmDspMaxDidToRead=5, DcmDspMaxPeriodicDidToRead=5, DcmDspReadDIDReportsNODIByte=false
        DidInfo_Hardware_Version (DcmDspDidInfo)
          DcmDspDidAccess
            DcmDspDidWrite
            DcmDspDidRead
        DataInfo_SerialNumber_SerialNumber (DcmDspDataInfo): DcmDspDataFixedLength=true
        DevelopmentData (DcmDspDid): DcmDspDidIdentifier=256, DcmDspDidUsed=true, DcmDspDidUsePort=USE_DATA_ELEMENT_SPECIFIC_INTERFACES, DcmDspDidInfoRef=DidInfo_DevelopmentData
          5 x DcmDspDidSignal:
            TransportLayerVersion: DcmDspDidDataPos=64, DcmDspDidDataRef=DevelopmentData_TransportLayerVersion
            CanDriverVersion: DcmDspDidDataPos=16, DcmDspDidDataRef=DevelopmentData_CanDriverVersion
            DiagnosticModuleVersion: DcmDspDidDataPos=48, DcmDspDidDataRef=DevelopmentData_DiagnosticModuleVersion
            NmVersion: DcmDspDidDataPos=32, DcmDspDidDataRef=DevelopmentData_NmVersion
            OperatingSystemVersion: DcmDspDidDataPos=0, DcmDspDidDataRef=DevelopmentData_OperatingSystemVersion
        RoutineInfo_CheckProgrammingPreconditions (DcmDspRoutineInfo)
          DcmDspRoutineAuthorization: DcmDspRoutineSessionRef=DcmDspSession/Programming, DcmDspRoutineSessionRef=DcmDspSession/Extended
        3 x DcmDspDid, all with DcmDspDidUsed=true, DcmDspDidUsePort=USE_DATA_ELEMENT_SPECIFIC_INTERFACES:
          PeriodicDataSample: DcmDspDidIdentifier=61953, DcmDspDidInfoRef=DidInfo_PeriodicDataSample
            DataRecord (DcmDspDidSignal): DcmDspDidDataPos=0, DcmDspDidDataRef=PeriodicDataSample_DataRecord
          Boot_Software: DcmDspDidIdentifier=61824, DcmDspDidInfoRef=DidInfo_Boot_Software
            NumberOfModules (DcmDspDidSignal): DcmDspDidDataPos=0, DcmDspDidDataRef=Boot_Software_NumberOfModules
            Boot_Software_Identification (DcmDspDidSignal): DcmDspDidDataPos=8, DcmDspDidDataRef=Boot_Software_Boot_Software_Identification
          SampleIoControl: DcmDspDidIdentifier=3, DcmDspDidInfoRef=DidInfo_SampleIoControl
            DID_Data (DcmDspDidSignal): DcmDspDidDataPos=0, DcmDspDidDataRef=SampleIoControl_DID_Data
        SampleRoutineControl (DcmDspRoutine):
          DcmDspRequestResultsRoutineSupported = true
          DcmDspStopRoutineSupported = true
          DcmDspRoutineIdentifier = 256
          DcmDspRoutineFixedLength = false
          DcmDspRoutineUsePort = true
          DcmDspRoutineUsed = true
          DcmDspRoutineInfoRef = RoutineInfo_SampleRoutineControl
        DidInfo_DataDiagnosticIdentifier_DID (DcmDspDidInfo)
          DcmDspDidAccess
            DcmDspDidWrite
            DcmDspDidRead
        3 x DcmDspDataInfo, all with DcmDspDataFixedLength=true:
          DataInfo_DID_0xF413_DID_Data
          DataInfo_DevelopmentData_OperatingSystemVersion
          DataInfo_DID_0xF410_DID_Data
        Spare_Part_Number (DcmDspDid): DcmDspDidIdentifier=61831, DcmDspDidUsed=true, DcmDspDidUsePort=USE_DATA_ELEMENT_SPECIFIC_INTERFACES, DcmDspDidInfoRef=DidInfo_Spare_Part_Number
          Spare_Part_Number (DcmDspDidSignal): DcmDspDidDataPos=0, DcmDspDidDataRef=Spare_Part_Number_Spare_Part_Number
        DidInfo_DID_0xF413 (DcmDspDidInfo)
          DcmDspDidAccess
            DcmDspDidRead
        DidInfo_DID_0xF412 (DcmDspDidInfo)
          DcmDspDidAccess
            DcmDspDidRead
        DataInfo_DevelopmentData_TransportLayerVersion (DcmDspDataInfo): DcmDspDataFixedLength=true
        SampleDynamicallyDefinedNonPeriodicDID (DcmDspDid):
          DcmDspDidIdentifier = 62208
          DcmDspDidUsed = true
          DcmDspDidUsePort = USE_DATA_ELEMENT_SPECIFIC_INTERFACES
          DcmDspDidInfoRef = DidInfo_SampleDynamicallyDefinedNonPeriodicDID
        RoutineInfo_ForceBootMode (DcmDspRoutineInfo)
          DcmDspRoutineAuthorization: DcmDspRoutineSessionRef=DcmDspSession/Programming, DcmDspRoutineSessionRef=DcmDspSession/Extended
        Vehicle_Identification (DcmDspDid):
          DcmDspDidIdentifier = 61840
          DcmDspDidUsed = true
          DcmDspDidUsePort = USE_DATA_ELEMENT_SPECIFIC_INTERFACES
          DcmDspDidInfoRef = DidInfo_Vehicle_Identification
          VIN (DcmDspDidSignal): DcmDspDidDataPos=0, DcmDspDidDataRef=Vehicle_Identification_VIN
        Vehicle_Identification_VIN (DcmDspData): DcmDspDataSize=136, DcmDspDataType=UINT8_N, DcmDspDataUsePort=USE_DATA_ASYNCH_CLIENT_SERVER, DcmDspDataInfoRef=DataInfo_Vehicle_Identification_VIN
        DidInfo_DID_0xF410 (DcmDspDidInfo)
          DcmDspDidAccess
            DcmDspDidRead
        DataInfo_PeriodicDataSample_DataRecord (DcmDspDataInfo): DcmDspDataFixedLength=true
        DidInfo_SampleDynamicallyDefinedNonPeriodicDID (DcmDspDidInfo): DcmDspDidDynamicallyDefined=true
          DcmDspDidAccess
            DcmDspDidDefine: DcmDspDDDidMaxElements=5
            DcmDspDidRead
        3 x DcmDspDataInfo, all with DcmDspDataFixedLength=true:
          DataInfo_DevelopmentData_DiagnosticModuleVersion
          DataInfo_Example_ReadWriteData_GlobalTime
          DataInfo_Hardware_Version_Hardware_Version_Number
        Hardware_Version (DcmDspDid): DcmDspDidIdentifier=61843, DcmDspDidUsed=true, DcmDspDidUsePort=USE_DATA_ELEMENT_SPECIFIC_INTERFACES, DcmDspDidInfoRef=DidInfo_Hardware_Version
          Hardware_Version_Number (DcmDspDidSignal): DcmDspDidDataPos=0, DcmDspDidDataRef=Hardware_Version_Hardware_Version_Number
        DataInfo_SampleIoControl_DID_Data (DcmDspDataInfo): DcmDspDataFixedLength=true
        DidInfo_Example_ReadOnlyDID (DcmDspDidInfo)
          DcmDspDidAccess
            DcmDspDidRead
        DataInfo_Spare_Part_Number_Spare_Part_Number (DcmDspDataInfo): DcmDspDataFixedLength=true
        SampleIoControl_DID_Data (DcmDspData):
          DcmDspDataConditionCheckReadFncUsed = false
          DcmDspDataSize = 32
          DcmDspDataType = UINT32
          DcmDspDataUsePort = USE_DATA_ASYNCH_CLIENT_SERVER
          DcmDspDataInfoRef = DataInfo_SampleIoControl_DID_Data
        DcmDspSecurity
          3 x DcmDspSecurityRow, all with DcmDspSecurityDelayTimeOnBoot=0, DcmDspSecurityAttemptCounterEnabled=false, DcmDspSecurityUsePort=USE_ASYNCH_CLIENT_SERVER:
            UnlockedL1: DcmDspSecurityDelayTime=10, DcmDspSecurityKeySize=4, DcmDspSecurityLevel=1, DcmDspSecurityNumAttDelay=3, DcmDspSecuritySeedSize=4
            Level_3: DcmDspSecurityDelayTime=10, DcmDspSecurityKeySize=2, DcmDspSecurityLevel=2, DcmDspSecurityNumAttDelay=3, DcmDspSecuritySeedSize=2
            Locked: DcmDspSecurityLevel=0, DcmDspSecurityDelayTime=0, DcmDspSecurityKeySize=4, DcmDspSecurityNumAttDelay=0, DcmDspSecuritySeedSize=4
        DID_0xF412 (DcmDspDid): DcmDspDidIdentifier=62482, DcmDspDidUsed=true, DcmDspDidUsePort=USE_DATA_ELEMENT_SPECIFIC_INTERFACES, DcmDspDidInfoRef=DidInfo_DID_0xF412
          DID_Data (DcmDspDidSignal): DcmDspDidDataPos=0, DcmDspDidDataRef=DID_0xF412_DID_Data
        DID_0xF413 (DcmDspDid): DcmDspDidIdentifier=62483, DcmDspDidUsed=true, DcmDspDidUsePort=USE_DATA_ELEMENT_SPECIFIC_INTERFACES, DcmDspDidInfoRef=DidInfo_DID_0xF413
          DID_Data (DcmDspDidSignal): DcmDspDidDataPos=0, DcmDspDidDataRef=DID_0xF413_DID_Data
        DcmDspControlDTCSetting: DcmSupportDTCSettingControlOptionRecord=true
        DidInfo_PeriodicDataSample (DcmDspDidInfo)
          DcmDspDidAccess
            DcmDspDidRead: DcmDspDidReadSessionRef=DcmDspSession/Programming, DcmDspDidReadSessionRef=DcmDspSession/Extended
        3 x DcmDspDid, all with DcmDspDidUsed=true, DcmDspDidUsePort=USE_DATA_ELEMENT_SPECIFIC_INTERFACES:
          DID_0xF410: DcmDspDidIdentifier=62480, DcmDspDidInfoRef=DidInfo_DID_0xF410
            DID_Data (DcmDspDidSignal): DcmDspDidDataPos=0, DcmDspDidDataRef=DID_0xF410_DID_Data
          EcuIdentification: DcmDspDidIdentifier=61833, DcmDspDidInfoRef=DidInfo_EcuIdentification
            Part_Number (DcmDspDidSignal): DcmDspDidDataPos=0, DcmDspDidDataRef=EcuIdentification_Part_Number
          Example_ReadOnlyDID: DcmDspDidIdentifier=1, DcmDspDidInfoRef=DidInfo_Example_ReadOnlyDID
            DID_Data_GlobalTime (DcmDspDidSignal): DcmDspDidDataPos=0, DcmDspDidDataRef=Example_ReadOnlyDID_DID_Data_GlobalTime
        PeriodicDataSample_DataRecord (DcmDspData):
          DcmDspDataSize = 16
          DcmDspDataType = UINT16
          DcmDspDataUsePort = USE_DATA_ASYNCH_CLIENT_SERVER
          DcmDspDataInfoRef = DataInfo_PeriodicDataSample_DataRecord
        SerialNumber (DcmDspDid): DcmDspDidIdentifier=61836, DcmDspDidUsed=true, DcmDspDidUsePort=USE_DATA_ELEMENT_SPECIFIC_INTERFACES, DcmDspDidInfoRef=DidInfo_SerialNumber
          SerialNumber (DcmDspDidSignal): DcmDspDidDataPos=0, DcmDspDidDataRef=SerialNumber_SerialNumber
        DataInfo_Vehicle_Identification_VIN (DcmDspDataInfo): DcmDspDataFixedLength=true
        CheckProgrammingPreconditions (DcmDspRoutine):
          DcmDspRequestResultsRoutineSupported = false
          DcmDspStopRoutineSupported = false
          DcmDspRoutineIdentifier = 515
          DcmDspRoutineFixedLength = false
          DcmDspRoutineUsePort = true
          DcmDspRoutineUsed = true
          DcmDspRoutineInfoRef = RoutineInfo_CheckProgrammingPreconditions
        DevelopmentData_DiagnosticModuleVersion (DcmDspData):
          DcmDspDataSize = 16
          DcmDspDataType = UINT16
          DcmDspDataUsePort = USE_DATA_ASYNCH_CLIENT_SERVER
          DcmDspDataInfoRef = DataInfo_DevelopmentData_DiagnosticModuleVersion
        DataInfo_DevelopmentData_CanDriverVersion (DcmDspDataInfo): DcmDspDataFixedLength=true
        Example_ReadOnlyDID_DID_Data_GlobalTime (DcmDspData):
          DcmDspDataSize = 48
          DcmDspDataType = UINT8_N
          DcmDspDataUsePort = USE_DATA_ASYNCH_CLIENT_SERVER
          DcmDspDataInfoRef = DataInfo_Example_ReadOnlyDID_DID_Data_GlobalTime
        Example_WriteOnlyDID (DcmDspDid): DcmDspDidIdentifier=4, DcmDspDidUsed=true, DcmDspDidUsePort=USE_DATA_ELEMENT_SPECIFIC_INTERFACES, DcmDspDidInfoRef=DidInfo_Example_WriteOnlyDID
          DID_DataObject (DcmDspDidSignal): DcmDspDidDataPos=0, DcmDspDidDataRef=Example_WriteOnlyDID_DID_DataObject
        DID_0xF410_DID_Data (DcmDspData): DcmDspDataSize=16, DcmDspDataType=UINT16, DcmDspDataUsePort=USE_DATA_ASYNCH_CLIENT_SERVER, DcmDspDataInfoRef=DataInfo_DID_0xF410_DID_Data
        DidInfo_SerialNumber (DcmDspDidInfo)
          DcmDspDidAccess
            DcmDspDidWrite
            DcmDspDidRead
        DataInfo_Example_WriteOnlyDID_DID_DataObject (DcmDspDataInfo): DcmDspDataFixedLength=true
        RoutineInfo_SampleRoutineControl_StartOnly (DcmDspRoutineInfo)
          DcmDspRoutineRequestResOut
            Out_Result (DcmDspRoutineRequestResOutSignal): DcmDspRoutineSignalLength=32, DcmDspRoutineSignalType=UINT32, DcmDspRoutineSignalEndianness=BIG_ENDIAN, DcmDspRoutineSignalPos=0
          DcmDspStartRoutineIn
            In_Option1 (DcmDspStartRoutineInSignal): DcmDspRoutineSignalLength=24, DcmDspRoutineSignalType=UINT8, DcmDspRoutineSignalEndianness=opaque, DcmDspRoutineSignalPos=0
          DcmDspRoutineAuthorization: DcmDspRoutineSessionRef=DcmDspSession/Programming, DcmDspRoutineSessionRef=DcmDspSession/Extended
        Example_ReadWriteData (DcmDspDid): DcmDspDidIdentifier=2, DcmDspDidUsed=true, DcmDspDidUsePort=USE_DATA_ELEMENT_SPECIFIC_INTERFACES, DcmDspDidInfoRef=DidInfo_Example_ReadWriteData
          GlobalTime (DcmDspDidSignal): DcmDspDidDataPos=0, DcmDspDidDataRef=Example_ReadWriteData_GlobalTime
        DataInfo_EcuIdentification_Part_Number (DcmDspDataInfo): DcmDspDataFixedLength=true
        3 x DcmDspData, all with DcmDspDataUsePort=USE_DATA_ASYNCH_CLIENT_SERVER:
          EcuIdentification_Part_Number: DcmDspDataSize=104, DcmDspDataType=UINT8_N, DcmDspDataInfoRef=DataInfo_EcuIdentification_Part_Number
          Spare_Part_Number_Spare_Part_Number: DcmDspDataSize=32, DcmDspDataType=UINT32, DcmDspDataInfoRef=DataInfo_Spare_Part_Number_Spare_Part_Number
          Example_WriteOnlyDID_DID_DataObject: DcmDspDataSize=8, DcmDspDataType=UINT8, DcmDspDataInfoRef=DataInfo_Example_WriteOnlyDID_DID_DataObject
        DidInfo_DevelopmentData (DcmDspDidInfo)
          DcmDspDidAccess
            DcmDspDidWrite
            DcmDspDidRead
        DidInfo_Spare_Part_Number (DcmDspDidInfo)
          DcmDspDidAccess
            DcmDspDidWrite
            DcmDspDidRead
        DID_0xF413_DID_Data (DcmDspData): DcmDspDataSize=16, DcmDspDataType=UINT16, DcmDspDataUsePort=USE_DATA_ASYNCH_CLIENT_SERVER, DcmDspDataInfoRef=DataInfo_DID_0xF413_DID_Data
        DataInfo_DevelopmentData_NmVersion (DcmDspDataInfo): DcmDspDataFixedLength=true
        DataInfo_Boot_Software_Boot_Software_Identification (DcmDspDataInfo): DcmDspDataFixedLength=true
        3 x DcmDspDidInfo:
          DidInfo_Boot_Software
            DcmDspDidAccess
              DcmDspDidWrite
              DcmDspDidRead
          DidInfo_Example_WriteOnlyDID
            DcmDspDidAccess
              DcmDspDidWrite
          DidInfo_SampleIoControl
            DcmDspDidAccess
              DcmDspDidControl:
                DcmDspDidFreezeCurrentState = true
                DcmDspDidResetToDefault = true
                DcmDspDidReturnControlToEcu = true
                DcmDspDidShortTermAdjustment = true
                DcmDspDidControlMask = DCM_CONTROLMASK_INTERNAL
                DcmDspDidControlSessionRef = DcmDspSession/Extended
              DcmDspDidRead
        SerialNumber_SerialNumber (DcmDspData): DcmDspDataSize=32, DcmDspDataType=UINT32, DcmDspDataUsePort=USE_DATA_ASYNCH_CLIENT_SERVER, DcmDspDataInfoRef=DataInfo_SerialNumber_SerialNumber
        DataInfo_DataDiagnosticIdentifier_DID_DataDiagnosticIdentifier (DcmDspDataInfo): DcmDspDataFixedLength=true
        DataInfo_Boot_Software_NumberOfModules (DcmDspDataInfo): DcmDspDataFixedLength=true
        DidInfo_Example_ReadWriteData (DcmDspDidInfo)
          DcmDspDidAccess
            DcmDspDidWrite
            DcmDspDidRead
        DataDiagnosticIdentifier_DID_DataDiagnosticIdentifier (DcmDspData):
          DcmDspDataSize = 16
          DcmDspDataType = UINT16
          DcmDspDataUsePort = USE_DATA_ASYNCH_CLIENT_SERVER
          DcmDspDataInfoRef = DataInfo_DataDiagnosticIdentifier_DID_DataDiagnosticIdentifier
        ComControl (DcmDspComControl)
          DspComContolAllChannel (DcmDspComControlAllChannel): DcmDspAllComMChannelRef=(unset)
        Boot_Software_Boot_Software_Identification (DcmDspData):
          DcmDspDataSize = 32
          DcmDspDataType = UINT32
          DcmDspDataUsePort = USE_DATA_ASYNCH_CLIENT_SERVER
          DcmDspDataInfoRef = DataInfo_Boot_Software_Boot_Software_Identification
        DataInfo_Example_ReadOnlyDID_DID_Data_GlobalTime (DcmDspDataInfo): DcmDspDataFixedLength=true
        DataDiagnosticIdentifier_DID (DcmDspDid):
          DcmDspDidIdentifier = 257
          DcmDspDidUsed = true
          DcmDspDidUsePort = USE_DATA_ELEMENT_SPECIFIC_INTERFACES
          DcmDspDidInfoRef = DidInfo_DataDiagnosticIdentifier_DID
          DataDiagnosticIdentifier (DcmDspDidSignal): DcmDspDidDataPos=0, DcmDspDidDataRef=DataDiagnosticIdentifier_DID_DataDiagnosticIdentifier
        DidInfo_Vehicle_Identification (DcmDspDidInfo)
          DcmDspDidAccess
            DcmDspDidWrite
            DcmDspDidRead
        DataInfo_DID_0xF412_DID_Data (DcmDspDataInfo): DcmDspDataFixedLength=true
        Example_ReadWriteData_GlobalTime (DcmDspData):
          DcmDspDataSize = 32
          DcmDspDataType = UINT32
          DcmDspDataUsePort = USE_DATA_ASYNCH_CLIENT_SERVER
          DcmDspDataInfoRef = DataInfo_Example_ReadWriteData_GlobalTime
        Hardware_Version_Hardware_Version_Number (DcmDspData):
          DcmDspDataSize = 32
          DcmDspDataType = UINT32
          DcmDspDataUsePort = USE_DATA_ASYNCH_CLIENT_SERVER
          DcmDspDataInfoRef = DataInfo_Hardware_Version_Hardware_Version_Number
        DidInfo_EcuIdentification (DcmDspDidInfo)
          DcmDspDidAccess
            DcmDspDidWrite
            DcmDspDidRead
        5 x DcmDspData, all with DcmDspDataSize=16, DcmDspDataType=UINT16, DcmDspDataUsePort=USE_DATA_ASYNCH_CLIENT_SERVER:
          DevelopmentData_NmVersion: DcmDspDataInfoRef=DataInfo_DevelopmentData_NmVersion
          DevelopmentData_OperatingSystemVersion: DcmDspDataInfoRef=DataInfo_DevelopmentData_OperatingSystemVersion
          DevelopmentData_TransportLayerVersion: DcmDspDataInfoRef=DataInfo_DevelopmentData_TransportLayerVersion
          DevelopmentData_CanDriverVersion: DcmDspDataInfoRef=DataInfo_DevelopmentData_CanDriverVersion
          DID_0xF412_DID_Data: DcmDspDataInfoRef=DataInfo_DID_0xF412_DID_Data
        RoutineInfo_SampleRoutineControl (DcmDspRoutineInfo)
          DcmDspRoutineRequestResOut
            Out_Result (DcmDspRoutineRequestResOutSignal): DcmDspRoutineSignalLength=16, DcmDspRoutineSignalType=UINT16, DcmDspRoutineSignalEndianness=BIG_ENDIAN, DcmDspRoutineSignalPos=0
          DcmDspStartRoutineIn
            In_Option0 (DcmDspStartRoutineInSignal): DcmDspRoutineSignalLength=8, DcmDspRoutineSignalType=UINT8, DcmDspRoutineSignalPos=0
          DcmDspRoutineAuthorization: DcmDspRoutineSessionRef=DcmDspSession/Programming, DcmDspRoutineSessionRef=DcmDspSession/Extended
          DcmDspRoutineStopOut
            Out_StopState (DcmDspRoutineStopOutSignal): DcmDspRoutineSignalLength=32, DcmDspRoutineSignalType=UINT32, DcmDspRoutineSignalEndianness=BIG_ENDIAN, DcmDspRoutineSignalPos=0
          DcmDspStartRoutineOut
            Out_InitState (DcmDspStartRoutineOutSignal): DcmDspRoutineSignalLength=32, DcmDspRoutineSignalType=UINT32, DcmDspRoutineSignalEndianness=BIG_ENDIAN, DcmDspRoutineSignalPos=0
        DcmDspSession
          3 x DcmDspSessionRow, all with DcmDspSessionP2ServerMax=0.05, DcmDspSessionP2StarServerMax=5, DcmDspSessionForBoot=DCM_NO_BOOT:
            Default: DcmDspSessionLevel=1
            Programming: DcmDspSessionLevel=2
            Extended: DcmDspSessionLevel=3
        Boot_Software_NumberOfModules (DcmDspData): DcmDspDataSize=8, DcmDspDataType=UINT8, DcmDspDataUsePort=USE_DATA_ASYNCH_CLIENT_SERVER, DcmDspDataInfoRef=DataInfo_Boot_Software_NumberOfModules
        SampleRoutineControl_StartOnly (DcmDspRoutine):
          DcmDspRequestResultsRoutineSupported = true
          DcmDspStopRoutineSupported = false
          DcmDspRoutineIdentifier = 260
          DcmDspRoutineFixedLength = false
          DcmDspRoutineUsePort = true
          DcmDspRoutineUsed = true
          DcmDspRoutineInfoRef = RoutineInfo_SampleRoutineControl_StartOnly
        ForceBootMode (DcmDspRoutine):
          DcmDspRequestResultsRoutineSupported = false
          DcmDspStopRoutineSupported = false
          DcmDspRoutineIdentifier = 62744
          DcmDspRoutineFixedLength = false
          DcmDspRoutineUsePort = true
          DcmDspRoutineUsed = true
          DcmDspRoutineInfoRef = RoutineInfo_ForceBootMode
      DcmPageBufferCfg: DcmPagedBufferEnabled=true
