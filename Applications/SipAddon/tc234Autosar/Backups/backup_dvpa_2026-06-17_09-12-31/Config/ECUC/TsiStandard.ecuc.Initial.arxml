AUTOSAR XML (schema 4-2-1)
package /InitialEcuC
  ecuc value collection InitialEcuC: ecuc-values=[Can, CanIf, CanSM, Com, ComM, Dcm, Dem, EcuC, EcuM, PduR]
  module config Can
    CanConfigSet
      CT_CAN00_e98c47e6 (CanController):
        CanControllerActivation = true
        CanControllerDefaultBaudrate = CanControllerBaudrateConfig
        CanControllerSystemRef = CT_CAN00
        CanWakeupSourceRef = EcuMCommonConfiguration/CAN00_f26020e5
        CanControllerBaudrateConfig
      CN_CAN00_e98c47e6_Rx_Std (CanHardwareObject): CanHandleType=BASIC, CanIdType=STANDARD, CanIdValue=0, CanObjectType=RECEIVE, CanControllerRef=CanConfigSet/CT_CAN00_e98c47e6
      CN_CAN00_e98c47e6_Tx (CanHardwareObject): CanHandleType=BASIC, CanIdValue=0, CanObjectType=TRANSMIT, CanControllerRef=CanConfigSet/CT_CAN00_e98c47e6
    CanGeneral: CanIndex=0
  module config CanIf
    Can (CanIfCtrlDrvCfg): CanIfCtrlDrvInitHohConfigRef=CanIfInitHohCfg, CanIfCtrlDrvNameRef=CanGeneral
      CT_CAN00_e98c47e6 (CanIfCtrlCfg): CanIfCtrlCanCtrlRef=CanConfigSet/CT_CAN00_e98c47e6
    CanIfInitCfg
      CanIfBufferCfg_0fb271d2 (CanIfBufferCfg): CanIfBufferSize=0, CanIfBufferHthRef=CanIfInitHohCfg/CN_CAN00_e98c47e6_Tx  # CHNL
      CanIfInitHohCfg: CanIfInitRefCfgSet=CanConfigSet
        CN_CAN00_e98c47e6_Rx_Std (CanIfHrhCfg): CanIfHrhCanCtrlIdRef=Can/CT_CAN00_e98c47e6, CanIfHrhIdSymRef=CanConfigSet/CN_CAN00_e98c47e6_Rx_Std
        CN_CAN00_e98c47e6_Tx (CanIfHthCfg): CanIfHthCanCtrlIdRef=Can/CT_CAN00_e98c47e6, CanIfHthIdSymRef=CanConfigSet/CN_CAN00_e98c47e6_Tx
      msg_NM_RearECU_oCAN00_Rx_3abd61be (CanIfRxPduCfg):
        CanIfRxPduCanId = 1537
        CanIfRxPduCanIdType = STANDARD_CAN
        CanIfRxPduDlc = 8
        CanIfRxPduUserRxIndicationName = CanNm_RxIndication
        CanIfRxPduUserRxIndicationUL = CAN_NM
        CanIfRxPduHrhIdRef = CanIfInitHohCfg/CN_CAN00_e98c47e6_Rx_Std
        CanIfRxPduRef = msg_NM_RearECU_4b8e7e70
      msg_Receive_oCAN00_Rx_3abd61be (CanIfRxPduCfg):
        CanIfRxPduCanId = 528
        CanIfRxPduCanIdType = STANDARD_CAN
        CanIfRxPduDlc = 1
        CanIfRxPduUserRxIndicationName = PduR_CanIfRxIndication
        CanIfRxPduUserRxIndicationUL = PDUR
        CanIfRxPduHrhIdRef = CanIfInitHohCfg/CN_CAN00_e98c47e6_Rx_Std
        CanIfRxPduRef = PT_msg_Receive_PP_msg_Receive_Rx_0fb271d2_5e566ad9
      3 x CanIfTxPduCfg, all with CanIfTxPduCanIdType=STANDARD_CAN, CanIfTxPduBufferRef=CanIfBufferCfg_0fb271d2:
        msg_MyECU_Lamp_oCAN00_Tx_3abd61be: CanIfTxPduCanId=1297, CanIfTxPduDlc=8, CanIfTxPduUserTxConfirmationName=PduR_CanIfTxConfirmation, CanIfTxPduUserTxConfirmationUL=PDUR, CanIfTxPduRef=PT_msg_MyECU_Lamp_PP_msg_MyECU_Lamp_Tx_0fb271d2_5e566ad9
        msg_NM_MyECU_oCAN00_Tx_3abd61be: CanIfTxPduCanId=1536, CanIfTxPduDlc=8, CanIfTxPduUserTxConfirmationName=CanNm_TxConfirmation, CanIfTxPduUserTxConfirmationUL=CAN_NM, CanIfTxPduRef=PT_msg_NM_MyECU_PP_msg_NM_MyECU_Tx_0fb271d2_5e566ad9
        msg_Transmit_oCAN00_Tx_3abd61be: CanIfTxPduCanId=512, CanIfTxPduDlc=1, CanIfTxPduUserTxConfirmationName=PduR_CanIfTxConfirmation, CanIfTxPduUserTxConfirmationUL=PDUR, CanIfTxPduRef=PT_msg_Transmit_PP_msg_Transmit_Tx_0fb271d2_5e566ad9
    CanIfPrivateCfg: CanIfPrivateSoftwareFilterType=LINEAR
    CanIfPublicCfg: CanIfPublicPnSupport=false
  module config CanSM
    CanSMConfiguration
      CHNL_f276589c (CanSMManagerNetwork): CanSMComMNetworkHandleRef=ComMConfigSet/CAN00_f26020e5
        CT_CAN00_e98c47e6 (CanSMController): CanSMControllerId=Can/CT_CAN00_e98c47e6
  module config Com
    ComConfig
      4 x ComIPdu, all with ComIPduType=NORMAL:
        msg_MyECU_Lamp_oCAN00_3abd61be: ComIPduDirection=SEND, ComIPduGroupRef=MyECU_oCAN00_Tx_fcef2243, ComIPduSignalRef=sig_LampCnt_818e1651, ComPduIdRef=PT_msg_MyECU_Lamp_PP_msg_MyECU_Lamp_Tx_0fb271d2_5e566ad9
          ComTxIPdu: ComMinimumDelayTime=0, ComTxIPduUnusedAreasDefault=0
            ComTxModeFalse
              ComTxMode: ComTxModeMode=PERIODIC, ComTxModeTimeOffset=0, ComTxModeTimePeriod=0.1
            ComTxModeTrue
              ComTxMode: ComTxModeMode=PERIODIC, ComTxModeTimeOffset=0, ComTxModeTimePeriod=0.1
        msg_NM_MyECU_oCAN00_3abd61be: ComIPduDirection=SEND, ComIPduSignalRef=sig_NM_MyECU_UserData_0_d71a6287, ComIPduSignalRef=sig_NM_MyECU_UserData_1_d71a6287, ComIPduSignalRef=sig_NM_MyECU_UserData_2_d71a6287, ComIPduSignalRef=sig_NM_MyECU_UserData_3_d71a6287, ComIPduSignalRef=sig_NM_MyECU_UserData_4_d71a6287, ComIPduSignalRef=sig_NM_MyECU_UserData_5_d71a6287, ComPduIdRef=NmUsrData_msg_NM_MyECU_oCAN00_3abd61be
          ComTxIPdu: ComTxIPduUnusedAreasDefault=0
        msg_Receive_oCAN00_3abd61be: ComIPduDirection=RECEIVE, ComIPduGroupRef=MyECU_oCAN00_Rx_fcef2243, ComIPduSignalRef=sig_State_RearInteriorLight_2b456e3f, ComIPduSignalRef=sig_State_RearLeftDoor_2b456e3f, ComIPduSignalRef=sig_State_RearRightDoor_2b456e3f, ComPduIdRef=PT_msg_Receive_PP_msg_Receive_Rx_0fb271d2_5e566ad9
        msg_Transmit_oCAN00_3abd61be: ComIPduDirection=SEND, ComIPduGroupRef=MyECU_oCAN00_Tx_fcef2243, ComIPduSignalRef=sig_RearInteriorLight_0723e95e, ComPduIdRef=PT_msg_Transmit_PP_msg_Transmit_Tx_0fb271d2_5e566ad9
          ComTxIPdu: ComMinimumDelayTime=0, ComTxIPduUnusedAreasDefault=0
            ComTxModeFalse
              ComTxMode: ComTxModeMode=PERIODIC, ComTxModeTimeOffset=0, ComTxModeTimePeriod=0.1
            ComTxModeTrue
              ComTxMode: ComTxModeMode=PERIODIC, ComTxModeTimeOffset=0, ComTxModeTimePeriod=0.1
      MyECU_oCAN00_Rx_fcef2243 (ComIPduGroup)
      MyECU_oCAN00_Tx_fcef2243 (ComIPduGroup)
      11 x ComSignal, all with ComSignalInitValue=0:
        sig_LampCnt_818e1651: ComBitPosition=7, ComBitSize=8, ComSignalEndianness=BIG_ENDIAN, ComSignalType=UINT8, ComTransferProperty=PENDING, ComSystemTemplateSystemSignalRef=sig_LampCnt
        sig_NM_MyECU_UserData_0_d71a6287: ComBitPosition=16, ComBitSize=8, ComSignalEndianness=LITTLE_ENDIAN, ComSignalType=UINT8, ComTransferProperty=PENDING, ComSystemTemplateSystemSignalRef=sig_NM_MyECU_UserData_0
        sig_NM_MyECU_UserData_1_d71a6287: ComBitPosition=24, ComBitSize=8, ComSignalEndianness=LITTLE_ENDIAN, ComSignalType=UINT8, ComTransferProperty=PENDING, ComSystemTemplateSystemSignalRef=sig_NM_MyECU_UserData_1
        sig_NM_MyECU_UserData_2_d71a6287: ComBitPosition=32, ComBitSize=8, ComSignalEndianness=LITTLE_ENDIAN, ComSignalType=UINT8, ComTransferProperty=PENDING, ComSystemTemplateSystemSignalRef=sig_NM_MyECU_UserData_2
        sig_NM_MyECU_UserData_3_d71a6287: ComBitPosition=40, ComBitSize=8, ComSignalEndianness=LITTLE_ENDIAN, ComSignalType=UINT8, ComTransferProperty=PENDING, ComSystemTemplateSystemSignalRef=sig_NM_MyECU_UserData_3
        sig_NM_MyECU_UserData_4_d71a6287: ComBitPosition=48, ComBitSize=8, ComSignalEndianness=LITTLE_ENDIAN, ComSignalType=UINT8, ComTransferProperty=PENDING, ComSystemTemplateSystemSignalRef=sig_NM_MyECU_UserData_4
        sig_NM_MyECU_UserData_5_d71a6287: ComBitPosition=56, ComBitSize=8, ComSignalEndianness=LITTLE_ENDIAN, ComSignalType=UINT8, ComTransferProperty=PENDING, ComSystemTemplateSystemSignalRef=sig_NM_MyECU_UserData_5
        sig_RearInteriorLight_0723e95e: ComBitPosition=0, ComBitSize=1, ComSignalEndianness=LITTLE_ENDIAN, ComSignalType=BOOLEAN, ComTransferProperty=PENDING, ComSystemTemplateSystemSignalRef=sig_RearInteriorLight
        sig_State_RearInteriorLight_2b456e3f: ComBitPosition=2, ComBitSize=1, ComSignalEndianness=LITTLE_ENDIAN, ComSignalType=BOOLEAN, ComTimeout=0, ComSystemTemplateSystemSignalRef=sig_State_RearInteriorLight
        sig_State_RearLeftDoor_2b456e3f: ComBitPosition=0, ComBitSize=1, ComSignalEndianness=LITTLE_ENDIAN, ComSignalType=BOOLEAN, ComTimeout=0, ComSystemTemplateSystemSignalRef=sig_State_RearLeftDoor
        sig_State_RearRightDoor_2b456e3f: ComBitPosition=1, ComBitSize=1, ComSignalEndianness=LITTLE_ENDIAN, ComSignalType=BOOLEAN, ComTimeout=0, ComSystemTemplateSystemSignalRef=sig_State_RearRightDoor
    ComGeneral
  module config ComM
    ComMConfigSet: ComMPncEnabled=false
      CAN00_f26020e5 (ComMChannel): ComMBusType=COMM_BUS_TYPE_CAN, ComMChannelId=0  # CN_CAN00
        ComMNetworkManagement: ComMNmVariant=NONE
        CHNL_f276589c (ComMUserPerChannel): ComMUserChannel=USR_CHNL_f276589c  # CN_CAN00
      USR_CHNL_f276589c (ComMUser): ComMUserIdentifier=0  # CN_CAN00
    ComMGeneral: ComMPncIdCounting=COMM_PNC_ID_COUNT_FROM_NM_MESSAGE, ComMPncSupport=false
  module config Dcm
    DcmConfigSet  # Diagnostics Data Import
      DcmDsp: DcmDspMaxDidToRead=5, DcmDspMaxPeriodicDidToRead=5  # Diagnostics Data Import
        ComControl (DcmDspComControl)  # Diagnostics Data Import
          DspComContolAllChannel (DcmDspComControlAllChannel)  # Diagnostics Data Import
        DcmDspSession  # Diagnostics Data Import
          3 x DcmDspSessionRow, all with DcmDspSessionP2ServerMax=0.05, DcmDspSessionP2StarServerMax=5:
            Extended: DcmDspSessionLevel=3  # Diagnostics Data Import
            Programming: DcmDspSessionLevel=2  # Diagnostics Data Import
            Default: DcmDspSessionLevel=1  # Diagnostics Data Import
        DcmDspSecurity  # Diagnostics Data Import
          3 x DcmDspSecurityRow:
            Level_3: DcmDspSecurityDelayTime=10, DcmDspSecurityDelayTimeOnBoot=0, DcmDspSecurityKeySize=2, DcmDspSecurityLevel=2, DcmDspSecurityNumAttDelay=3, DcmDspSecuritySeedSize=2  # Diagnostics Data Import
            UnlockedL1: DcmDspSecurityDelayTime=10, DcmDspSecurityDelayTimeOnBoot=0, DcmDspSecurityKeySize=4, DcmDspSecurityLevel=1, DcmDspSecurityNumAttDelay=3, DcmDspSecuritySeedSize=4  # Diagnostics Data Import
            Locked: DcmDspSecurityLevel=0  # Diagnostics Data Import
        4 x DcmDspRoutineInfo:
          RoutineInfo_ForceBootMode  # Diagnostics Data Import
            DcmDspRoutineAuthorization: DcmDspRoutineSessionRef=DcmDspSession/Programming, DcmDspRoutineSessionRef=DcmDspSession/Extended  # Diagnostics Data Import
          RoutineInfo_CheckProgrammingPreconditions  # Diagnostics Data Import
            DcmDspRoutineAuthorization: DcmDspRoutineSessionRef=DcmDspSession/Programming, DcmDspRoutineSessionRef=DcmDspSession/Extended  # Diagnostics Data Import
          RoutineInfo_SampleRoutineControl_StartOnly  # Diagnostics Data Import
            DcmDspRoutineRequestResOut  # Diagnostics Data Import
              Out_Result (DcmDspRoutineRequestResOutSignal): DcmDspRoutineSignalLength=32, DcmDspRoutineSignalType=UINT32, DcmDspRoutineSignalEndianness=BIG_ENDIAN, DcmDspRoutineSignalPos=0  # Diagnostics Data Import
            DcmDspStartRoutineIn  # Diagnostics Data Import
              In_Option1 (DcmDspStartRoutineInSignal): DcmDspRoutineSignalLength=24, DcmDspRoutineSignalType=UINT8, DcmDspRoutineSignalEndianness=opaque, DcmDspRoutineSignalPos=0  # Diagnostics Data Import
            DcmDspRoutineAuthorization: DcmDspRoutineSessionRef=DcmDspSession/Programming, DcmDspRoutineSessionRef=DcmDspSession/Extended  # Diagnostics Data Import
          RoutineInfo_SampleRoutineControl  # Diagnostics Data Import
            DcmDspRoutineRequestResOut  # Diagnostics Data Import
              Out_Result (DcmDspRoutineRequestResOutSignal): DcmDspRoutineSignalLength=16, DcmDspRoutineSignalType=UINT16, DcmDspRoutineSignalEndianness=BIG_ENDIAN, DcmDspRoutineSignalPos=0  # Diagnostics Data Import
            DcmDspRoutineStopOut  # Diagnostics Data Import
              Out_StopState (DcmDspRoutineStopOutSignal): DcmDspRoutineSignalLength=32, DcmDspRoutineSignalType=UINT32, DcmDspRoutineSignalEndianness=BIG_ENDIAN, DcmDspRoutineSignalPos=0  # Diagnostics Data Import
            DcmDspStartRoutineOut  # Diagnostics Data Import
              Out_InitState (DcmDspStartRoutineOutSignal): DcmDspRoutineSignalLength=32, DcmDspRoutineSignalType=UINT32, DcmDspRoutineSignalEndianness=BIG_ENDIAN, DcmDspRoutineSignalPos=0  # Diagnostics Data Import
            DcmDspStartRoutineIn  # Diagnostics Data Import
              In_Option0 (DcmDspStartRoutineInSignal): DcmDspRoutineSignalLength=8, DcmDspRoutineSignalType=UINT8, DcmDspRoutineSignalPos=0  # Diagnostics Data Import
            DcmDspRoutineAuthorization: DcmDspRoutineSessionRef=DcmDspSession/Programming, DcmDspRoutineSessionRef=DcmDspSession/Extended  # Diagnostics Data Import
        4 x DcmDspRoutine:
          ForceBootMode: DcmDspRequestResultsRoutineSupported=false, DcmDspStopRoutineSupported=false, DcmDspRoutineIdentifier=62744, DcmDspRoutineInfoRef=RoutineInfo_ForceBootMode  # Diagnostics Data Import
          CheckProgrammingPreconditions: DcmDspRequestResultsRoutineSupported=false, DcmDspStopRoutineSupported=false, DcmDspRoutineIdentifier=515, DcmDspRoutineInfoRef=RoutineInfo_CheckProgrammingPreconditions  # Diagnostics Data Import
          SampleRoutineControl_StartOnly: DcmDspRequestResultsRoutineSupported=true, DcmDspStopRoutineSupported=false, DcmDspRoutineIdentifier=260, DcmDspRoutineInfoRef=RoutineInfo_SampleRoutineControl_StartOnly  # Diagnostics Data Import
          SampleRoutineControl: DcmDspRequestResultsRoutineSupported=true, DcmDspStopRoutineSupported=true, DcmDspRoutineIdentifier=256, DcmDspRoutineInfoRef=RoutineInfo_SampleRoutineControl  # Diagnostics Data Import
        DcmDspControlDTCSetting: DcmSupportDTCSettingControlOptionRecord=true  # Diagnostics Data Import
        17 x DcmDspDidInfo:
          DidInfo_DID_0xF413  # Diagnostics Data Import
            DcmDspDidAccess  # Diagnostics Data Import
              DcmDspDidRead  # Diagnostics Data Import
          DidInfo_DID_0xF412  # Diagnostics Data Import
            DcmDspDidAccess  # Diagnostics Data Import
              DcmDspDidRead  # Diagnostics Data Import
          DidInfo_DID_0xF410  # Diagnostics Data Import
            DcmDspDidAccess  # Diagnostics Data Import
              DcmDspDidRead  # Diagnostics Data Import
          DidInfo_SampleDynamicallyDefinedNonPeriodicDID: DcmDspDidDynamicallyDefined=true  # Diagnostics Data Import
            DcmDspDidAccess  # Diagnostics Data Import
              DcmDspDidDefine: DcmDspDDDidMaxElements=5  # Diagnostics Data Import
              DcmDspDidRead  # Diagnostics Data Import
          DidInfo_PeriodicDataSample  # Diagnostics Data Import
            DcmDspDidAccess  # Diagnostics Data Import
              DcmDspDidRead: DcmDspDidReadSessionRef=DcmDspSession/Programming, DcmDspDidReadSessionRef=DcmDspSession/Extended  # Diagnostics Data Import
          DidInfo_Hardware_Version  # Diagnostics Data Import
            DcmDspDidAccess  # Diagnostics Data Import
              DcmDspDidWrite  # Diagnostics Data Import
              DcmDspDidRead  # Diagnostics Data Import
          DidInfo_Vehicle_Identification  # Diagnostics Data Import
            DcmDspDidAccess  # Diagnostics Data Import
              DcmDspDidWrite  # Diagnostics Data Import
              DcmDspDidRead  # Diagnostics Data Import
          DidInfo_SerialNumber  # Diagnostics Data Import
            DcmDspDidAccess  # Diagnostics Data Import
              DcmDspDidWrite  # Diagnostics Data Import
              DcmDspDidRead  # Diagnostics Data Import
          DidInfo_EcuIdentification  # Diagnostics Data Import
            DcmDspDidAccess  # Diagnostics Data Import
              DcmDspDidWrite  # Diagnostics Data Import
              DcmDspDidRead  # Diagnostics Data Import
          DidInfo_Spare_Part_Number  # Diagnostics Data Import
            DcmDspDidAccess  # Diagnostics Data Import
              DcmDspDidWrite  # Diagnostics Data Import
              DcmDspDidRead  # Diagnostics Data Import
          DidInfo_Boot_Software  # Diagnostics Data Import
            DcmDspDidAccess  # Diagnostics Data Import
              DcmDspDidWrite  # Diagnostics Data Import
              DcmDspDidRead  # Diagnostics Data Import
          DidInfo_DataDiagnosticIdentifier_DID  # Diagnostics Data Import
            DcmDspDidAccess  # Diagnostics Data Import
              DcmDspDidWrite  # Diagnostics Data Import
              DcmDspDidRead  # Diagnostics Data Import
          DidInfo_DevelopmentData  # Diagnostics Data Import
            DcmDspDidAccess  # Diagnostics Data Import
              DcmDspDidWrite  # Diagnostics Data Import
              DcmDspDidRead  # Diagnostics Data Import
          DidInfo_Example_WriteOnlyDID  # Diagnostics Data Import
            DcmDspDidAccess  # Diagnostics Data Import
              DcmDspDidWrite  # Diagnostics Data Import
          DidInfo_SampleIoControl  # Diagnostics Data Import
            DcmDspDidAccess  # Diagnostics Data Import
              DcmDspDidRead  # Diagnostics Data Import
              DcmDspDidControl:  # Diagnostics Data Import
                DcmDspDidFreezeCurrentState = true
                DcmDspDidResetToDefault = true
                DcmDspDidReturnControlToEcu = true
                DcmDspDidShortTermAdjustment = true
                DcmDspDidControlSessionRef = DcmDspSession/Extended
          DidInfo_Example_ReadWriteData  # Diagnostics Data Import
            DcmDspDidAccess  # Diagnostics Data Import
              DcmDspDidWrite  # Diagnostics Data Import
              DcmDspDidRead  # Diagnostics Data Import
          DidInfo_Example_ReadOnlyDID  # Diagnostics Data Import
            DcmDspDidAccess  # Diagnostics Data Import
              DcmDspDidRead  # Diagnostics Data Import
        17 x DcmDspDid:
          DID_0xF413: DcmDspDidIdentifier=62483, DcmDspDidInfoRef=DidInfo_DID_0xF413  # Diagnostics Data Import
            DID_Data (DcmDspDidSignal): DcmDspDidDataPos=0, DcmDspDidDataRef=DID_0xF413_DID_Data  # Diagnostics Data Import
          DID_0xF412: DcmDspDidIdentifier=62482, DcmDspDidInfoRef=DidInfo_DID_0xF412  # Diagnostics Data Import
            DID_Data (DcmDspDidSignal): DcmDspDidDataPos=0, DcmDspDidDataRef=DID_0xF412_DID_Data  # Diagnostics Data Import
          DID_0xF410: DcmDspDidIdentifier=62480, DcmDspDidInfoRef=DidInfo_DID_0xF410  # Diagnostics Data Import
            DID_Data (DcmDspDidSignal): DcmDspDidDataPos=0, DcmDspDidDataRef=DID_0xF410_DID_Data  # Diagnostics Data Import
          SampleDynamicallyDefinedNonPeriodicDID: DcmDspDidIdentifier=62208, DcmDspDidInfoRef=DidInfo_SampleDynamicallyDefinedNonPeriodicDID  # Diagnostics Data Import
          PeriodicDataSample: DcmDspDidIdentifier=61953, DcmDspDidInfoRef=DidInfo_PeriodicDataSample  # Diagnostics Data Import
            DataRecord (DcmDspDidSignal): DcmDspDidDataPos=0, DcmDspDidDataRef=PeriodicDataSample_DataRecord  # Diagnostics Data Import
          Hardware_Version: DcmDspDidIdentifier=61843, DcmDspDidInfoRef=DidInfo_Hardware_Version  # Diagnostics Data Import
            Hardware_Version_Number (DcmDspDidSignal): DcmDspDidDataPos=0, DcmDspDidDataRef=Hardware_Version_Hardware_Version_Number  # Diagnostics Data Import
          Vehicle_Identification: DcmDspDidIdentifier=61840, DcmDspDidInfoRef=DidInfo_Vehicle_Identification  # Diagnostics Data Import
            VIN (DcmDspDidSignal): DcmDspDidDataPos=0, DcmDspDidDataRef=Vehicle_Identification_VIN  # Diagnostics Data Import
          SerialNumber: DcmDspDidIdentifier=61836, DcmDspDidInfoRef=DidInfo_SerialNumber  # Diagnostics Data Import
            SerialNumber (DcmDspDidSignal): DcmDspDidDataPos=0, DcmDspDidDataRef=SerialNumber_SerialNumber  # Diagnostics Data Import
          EcuIdentification: DcmDspDidIdentifier=61833, DcmDspDidInfoRef=DidInfo_EcuIdentification  # Diagnostics Data Import
            Part_Number (DcmDspDidSignal): DcmDspDidDataPos=0, DcmDspDidDataRef=EcuIdentification_Part_Number  # Diagnostics Data Import
          Spare_Part_Number: DcmDspDidIdentifier=61831, DcmDspDidInfoRef=DidInfo_Spare_Part_Number  # Diagnostics Data Import
            Spare_Part_Number (DcmDspDidSignal): DcmDspDidDataPos=0, DcmDspDidDataRef=Spare_Part_Number_Spare_Part_Number  # Diagnostics Data Import
          Boot_Software: DcmDspDidIdentifier=61824, DcmDspDidInfoRef=DidInfo_Boot_Software  # Diagnostics Data Import
            Boot_Software_Identification (DcmDspDidSignal): DcmDspDidDataPos=8, DcmDspDidDataRef=Boot_Software_Boot_Software_Identification  # Diagnostics Data Import
            NumberOfModules (DcmDspDidSignal): DcmDspDidDataPos=0, DcmDspDidDataRef=Boot_Software_NumberOfModules  # Diagnostics Data Import
          DataDiagnosticIdentifier_DID: DcmDspDidIdentifier=257, DcmDspDidInfoRef=DidInfo_DataDiagnosticIdentifier_DID  # Diagnostics Data Import
            DataDiagnosticIdentifier (DcmDspDidSignal): DcmDspDidDataPos=0, DcmDspDidDataRef=DataDiagnosticIdentifier_DID_DataDiagnosticIdentifier  # Diagnostics Data Import
          DevelopmentData: DcmDspDidIdentifier=256, DcmDspDidInfoRef=DidInfo_DevelopmentData  # Diagnostics Data Import
            5 x DcmDspDidSignal:
              TransportLayerVersion: DcmDspDidDataPos=64, DcmDspDidDataRef=DevelopmentData_TransportLayerVersion  # Diagnostics Data Import
              DiagnosticModuleVersion: DcmDspDidDataPos=48, DcmDspDidDataRef=DevelopmentData_DiagnosticModuleVersion  # Diagnostics Data Import
              NmVersion: DcmDspDidDataPos=32, DcmDspDidDataRef=DevelopmentData_NmVersion  # Diagnostics Data Import
              CanDriverVersion: DcmDspDidDataPos=16, DcmDspDidDataRef=DevelopmentData_CanDriverVersion  # Diagnostics Data Import
              OperatingSystemVersion: DcmDspDidDataPos=0, DcmDspDidDataRef=DevelopmentData_OperatingSystemVersion  # Diagnostics Data Import
          Example_WriteOnlyDID: DcmDspDidIdentifier=4, DcmDspDidInfoRef=DidInfo_Example_WriteOnlyDID  # Diagnostics Data Import
            DID_DataObject (DcmDspDidSignal): DcmDspDidDataPos=0, DcmDspDidDataRef=Example_WriteOnlyDID_DID_DataObject  # Diagnostics Data Import
          SampleIoControl: DcmDspDidIdentifier=3, DcmDspDidInfoRef=DidInfo_SampleIoControl  # Diagnostics Data Import
            DID_Data (DcmDspDidSignal): DcmDspDidDataPos=0, DcmDspDidDataRef=SampleIoControl_DID_Data  # Diagnostics Data Import
          Example_ReadWriteData: DcmDspDidIdentifier=2, DcmDspDidInfoRef=DidInfo_Example_ReadWriteData  # Diagnostics Data Import
            GlobalTime (DcmDspDidSignal): DcmDspDidDataPos=0, DcmDspDidDataRef=Example_ReadWriteData_GlobalTime  # Diagnostics Data Import
          Example_ReadOnlyDID: DcmDspDidIdentifier=1, DcmDspDidInfoRef=DidInfo_Example_ReadOnlyDID  # Diagnostics Data Import
            DID_Data_GlobalTime (DcmDspDidSignal): DcmDspDidDataPos=0, DcmDspDidDataRef=Example_ReadOnlyDID_DID_Data_GlobalTime  # Diagnostics Data Import
        DataInfo_DID_0xF413_DID_Data (DcmDspDataInfo): DcmDspDataFixedLength=true  # Diagnostics Data Import
        DID_0xF413_DID_Data (DcmDspData): DcmDspDataSize=16, DcmDspDataType=UINT16, DcmDspDataInfoRef=DataInfo_DID_0xF413_DID_Data  # Diagnostics Data Import
        DataInfo_DID_0xF412_DID_Data (DcmDspDataInfo): DcmDspDataFixedLength=true  # Diagnostics Data Import
        DID_0xF412_DID_Data (DcmDspData): DcmDspDataSize=16, DcmDspDataType=UINT16, DcmDspDataInfoRef=DataInfo_DID_0xF412_DID_Data  # Diagnostics Data Import
        DataInfo_DID_0xF410_DID_Data (DcmDspDataInfo): DcmDspDataFixedLength=true  # Diagnostics Data Import
        DID_0xF410_DID_Data (DcmDspData): DcmDspDataSize=16, DcmDspDataType=UINT16, DcmDspDataInfoRef=DataInfo_DID_0xF410_DID_Data  # Diagnostics Data Import
        DataInfo_PeriodicDataSample_DataRecord (DcmDspDataInfo): DcmDspDataFixedLength=true  # Diagnostics Data Import
        PeriodicDataSample_DataRecord (DcmDspData): DcmDspDataSize=16, DcmDspDataType=UINT16, DcmDspDataInfoRef=DataInfo_PeriodicDataSample_DataRecord  # Diagnostics Data Import
        DataInfo_Hardware_Version_Hardware_Version_Number (DcmDspDataInfo): DcmDspDataFixedLength=true  # Diagnostics Data Import
        Hardware_Version_Hardware_Version_Number (DcmDspData): DcmDspDataSize=32, DcmDspDataType=UINT32, DcmDspDataInfoRef=DataInfo_Hardware_Version_Hardware_Version_Number  # Diagnostics Data Import
        DataInfo_Vehicle_Identification_VIN (DcmDspDataInfo): DcmDspDataFixedLength=true  # Diagnostics Data Import
        Vehicle_Identification_VIN (DcmDspData): DcmDspDataSize=136, DcmDspDataType=UINT8_N, DcmDspDataInfoRef=DataInfo_Vehicle_Identification_VIN  # Diagnostics Data Import
        DataInfo_SerialNumber_SerialNumber (DcmDspDataInfo): DcmDspDataFixedLength=true  # Diagnostics Data Import
        SerialNumber_SerialNumber (DcmDspData): DcmDspDataSize=32, DcmDspDataType=UINT32, DcmDspDataInfoRef=DataInfo_SerialNumber_SerialNumber  # Diagnostics Data Import
        DataInfo_EcuIdentification_Part_Number (DcmDspDataInfo): DcmDspDataFixedLength=true  # Diagnostics Data Import
        EcuIdentification_Part_Number (DcmDspData): DcmDspDataSize=104, DcmDspDataType=UINT8_N, DcmDspDataInfoRef=DataInfo_EcuIdentification_Part_Number  # Diagnostics Data Import
        DataInfo_Spare_Part_Number_Spare_Part_Number (DcmDspDataInfo): DcmDspDataFixedLength=true  # Diagnostics Data Import
        Spare_Part_Number_Spare_Part_Number (DcmDspData): DcmDspDataSize=32, DcmDspDataType=UINT32, DcmDspDataInfoRef=DataInfo_Spare_Part_Number_Spare_Part_Number  # Diagnostics Data Import
        DataInfo_Boot_Software_Boot_Software_Identification (DcmDspDataInfo): DcmDspDataFixedLength=true  # Diagnostics Data Import
        Boot_Software_Boot_Software_Identification (DcmDspData): DcmDspDataSize=32, DcmDspDataType=UINT32, DcmDspDataInfoRef=DataInfo_Boot_Software_Boot_Software_Identification  # Diagnostics Data Import
        DataInfo_Boot_Software_NumberOfModules (DcmDspDataInfo): DcmDspDataFixedLength=true  # Diagnostics Data Import
        Boot_Software_NumberOfModules (DcmDspData): DcmDspDataSize=8, DcmDspDataType=UINT8, DcmDspDataInfoRef=DataInfo_Boot_Software_NumberOfModules  # Diagnostics Data Import
        DataInfo_DataDiagnosticIdentifier_DID_DataDiagnosticIdentifier (DcmDspDataInfo): DcmDspDataFixedLength=true  # Diagnostics Data Import
        DataDiagnosticIdentifier_DID_DataDiagnosticIdentifier (DcmDspData): DcmDspDataSize=16, DcmDspDataType=UINT16, DcmDspDataInfoRef=DataInfo_DataDiagnosticIdentifier_DID_DataDiagnosticIdentifier  # Diagnostics Data Import
        DataInfo_DevelopmentData_TransportLayerVersion (DcmDspDataInfo): DcmDspDataFixedLength=true  # Diagnostics Data Import
        DevelopmentData_TransportLayerVersion (DcmDspData): DcmDspDataSize=16, DcmDspDataType=UINT16, DcmDspDataInfoRef=DataInfo_DevelopmentData_TransportLayerVersion  # Diagnostics Data Import
        DataInfo_DevelopmentData_DiagnosticModuleVersion (DcmDspDataInfo): DcmDspDataFixedLength=true  # Diagnostics Data Import
        DevelopmentData_DiagnosticModuleVersion (DcmDspData): DcmDspDataSize=16, DcmDspDataType=UINT16, DcmDspDataInfoRef=DataInfo_DevelopmentData_DiagnosticModuleVersion  # Diagnostics Data Import
        DataInfo_DevelopmentData_NmVersion (DcmDspDataInfo): DcmDspDataFixedLength=true  # Diagnostics Data Import
        DevelopmentData_NmVersion (DcmDspData): DcmDspDataSize=16, DcmDspDataType=UINT16, DcmDspDataInfoRef=DataInfo_DevelopmentData_NmVersion  # Diagnostics Data Import
        DataInfo_DevelopmentData_CanDriverVersion (DcmDspDataInfo): DcmDspDataFixedLength=true  # Diagnostics Data Import
        DevelopmentData_CanDriverVersion (DcmDspData): DcmDspDataSize=16, DcmDspDataType=UINT16, DcmDspDataInfoRef=DataInfo_DevelopmentData_CanDriverVersion  # Diagnostics Data Import
        DataInfo_DevelopmentData_OperatingSystemVersion (DcmDspDataInfo): DcmDspDataFixedLength=true  # Diagnostics Data Import
        DevelopmentData_OperatingSystemVersion (DcmDspData): DcmDspDataSize=16, DcmDspDataType=UINT16, DcmDspDataInfoRef=DataInfo_DevelopmentData_OperatingSystemVersion  # Diagnostics Data Import
        DataInfo_Example_WriteOnlyDID_DID_DataObject (DcmDspDataInfo): DcmDspDataFixedLength=true  # Diagnostics Data Import
        Example_WriteOnlyDID_DID_DataObject (DcmDspData): DcmDspDataSize=8, DcmDspDataType=UINT8, DcmDspDataInfoRef=DataInfo_Example_WriteOnlyDID_DID_DataObject  # Diagnostics Data Import
        DataInfo_SampleIoControl_DID_Data (DcmDspDataInfo): DcmDspDataFixedLength=true  # Diagnostics Data Import
        SampleIoControl_DID_Data (DcmDspData): DcmDspDataConditionCheckReadFncUsed=false, DcmDspDataSize=32, DcmDspDataType=UINT32, DcmDspDataInfoRef=DataInfo_SampleIoControl_DID_Data  # Diagnostics Data Import
        DataInfo_Example_ReadWriteData_GlobalTime (DcmDspDataInfo): DcmDspDataFixedLength=true  # Diagnostics Data Import
        Example_ReadWriteData_GlobalTime (DcmDspData): DcmDspDataSize=32, DcmDspDataType=UINT32, DcmDspDataInfoRef=DataInfo_Example_ReadWriteData_GlobalTime  # Diagnostics Data Import
        DataInfo_Example_ReadOnlyDID_DID_Data_GlobalTime (DcmDspDataInfo): DcmDspDataFixedLength=true  # Diagnostics Data Import
        Example_ReadOnlyDID_DID_Data_GlobalTime (DcmDspData): DcmDspDataSize=48, DcmDspDataType=UINT8_N, DcmDspDataInfoRef=DataInfo_Example_ReadOnlyDID_DID_Data_GlobalTime  # Diagnostics Data Import
      DcmDsd  # Diagnostics Data Import
        DcmDsdServiceTable  # Diagnostics Data Import
          16 x DcmDsdService:
            ControlDtcSetting: DcmDsdSidTabServiceId=133, DcmDsdSidTabSubfuncAvail=true  # Diagnostics Data Import
              Disable (DcmDsdSubService): DcmDsdSubServiceId=2  # Diagnostics Data Import
              Enable (DcmDsdSubService): DcmDsdSubServiceId=1  # Diagnostics Data Import
            TesterPresent: DcmDsdSidTabServiceId=62, DcmDsdSidTabSubfuncAvail=true  # Diagnostics Data Import
              TesterPresent (DcmDsdSubService): DcmDsdSubServiceId=0  # Diagnostics Data Import
            WriteMemoryByAddress: DcmDsdSidTabServiceId=61, DcmDsdSidTabSubfuncAvail=false  # Diagnostics Data Import
            RoutineControl: DcmDsdSidTabServiceId=49, DcmDsdSidTabSubfuncAvail=true, DcmDsdSidTabSessionLevelRef=DcmDspSession/Programming, DcmDsdSidTabSessionLevelRef=DcmDspSession/Extended  # Diagnostics Data Import
            IoControlById: DcmDsdSidTabServiceId=47, DcmDsdSidTabSubfuncAvail=false, DcmDsdSidTabSessionLevelRef=DcmDspSession/Extended  # Diagnostics Data Import
            WriteDataById: DcmDsdSidTabServiceId=46, DcmDsdSidTabSubfuncAvail=false  # Diagnostics Data Import
            DynamicallyDefineDataId: DcmDsdSidTabServiceId=44, DcmDsdSidTabSubfuncAvail=true  # Diagnostics Data Import
              3 x DcmDsdSubService:
                DynDefClr: DcmDsdSubServiceId=3  # Diagnostics Data Import
                DynDefByAddr: DcmDsdSubServiceId=2  # Diagnostics Data Import
                DynDefById: DcmDsdSubServiceId=1  # Diagnostics Data Import
            ReadDataByPeriodicId: DcmDsdSidTabServiceId=42, DcmDsdSidTabSubfuncAvail=false, DcmDsdSidTabSessionLevelRef=DcmDspSession/Programming, DcmDsdSidTabSessionLevelRef=DcmDspSession/Extended  # Diagnostics Data Import
            CommunicationControl: DcmDsdSidTabServiceId=40, DcmDsdSidTabSubfuncAvail=true, DcmDsdSidTabSessionLevelRef=DcmDspSession/Programming, DcmDsdSidTabSessionLevelRef=DcmDspSession/Extended  # Diagnostics Data Import
              4 x DcmDsdSubService, all with DcmDsdSubServiceSessionLevelRef=DcmDspSession/Programming, DcmDsdSubServiceSessionLevelRef=DcmDspSession/Extended:
                DisableRxAndTx: DcmDsdSubServiceId=3  # Diagnostics Data Import
                DisableRxAndEnableTx: DcmDsdSubServiceId=2  # Diagnostics Data Import
                EnableRxAndDisableTx: DcmDsdSubServiceId=1  # Diagnostics Data Import
                EnableRxAndTx: DcmDsdSubServiceId=0  # Diagnostics Data Import
            SecurityAccess: DcmDsdSidTabServiceId=39, DcmDsdSidTabSubfuncAvail=true, DcmDsdSidTabSessionLevelRef=DcmDspSession/Programming, DcmDsdSidTabSessionLevelRef=DcmDspSession/Extended  # Diagnostics Data Import
              4 x DcmDsdSubService, all with DcmDsdSubServiceSessionLevelRef=DcmDspSession/Programming, DcmDsdSubServiceSessionLevelRef=DcmDspSession/Extended:
                sendKey_Send: DcmDsdSubServiceId=4  # Diagnostics Data Import
                requestSeed_Request: DcmDsdSubServiceId=3  # Diagnostics Data Import
                KeyLevel1_Send: DcmDsdSubServiceId=2  # Diagnostics Data Import
                SeedLevel1_Request: DcmDsdSubServiceId=1  # Diagnostics Data Import
            ReadMemoryByAddress: DcmDsdSidTabServiceId=35, DcmDsdSidTabSubfuncAvail=false  # Diagnostics Data Import
            ReadDataById: DcmDsdSidTabServiceId=34, DcmDsdSidTabSubfuncAvail=false  # Diagnostics Data Import
            ReadDtcInfo: DcmDsdSidTabServiceId=25, DcmDsdSidTabSubfuncAvail=true  # Diagnostics Data Import
              12 x DcmDsdSubService:
                RDTCFDC: DcmDsdSubServiceId=20  # Diagnostics Data Import
                RMRTFDTC: DcmDsdSubServiceId=13  # Diagnostics Data Import
                RFCDTC: DcmDsdSubServiceId=12  # Diagnostics Data Import
                RSUPDTC: DcmDsdSubServiceId=10  # Diagnostics Data Import
                RSIODTC: DcmDsdSubServiceId=9  # Diagnostics Data Import
                RDTCBSMR: DcmDsdSubServiceId=8  # Diagnostics Data Import
                RNODTCBSMR: DcmDsdSubServiceId=7  # Diagnostics Data Import
                RDTCEDRBDN: DcmDsdSubServiceId=6  # Diagnostics Data Import
                RDTCSSBDTC: DcmDsdSubServiceId=4  # Diagnostics Data Import
                RDTCSSI: DcmDsdSubServiceId=3  # Diagnostics Data Import
                RNODTCBSM: DcmDsdSubServiceId=1  # Diagnostics Data Import
                RDTCBSM: DcmDsdSubServiceId=2  # Diagnostics Data Import
            ClearDiagInfo: DcmDsdSidTabServiceId=20, DcmDsdSidTabSubfuncAvail=false  # Diagnostics Data Import
            EcuReset: DcmDsdSidTabServiceId=17, DcmDsdSidTabSubfuncAvail=true  # Diagnostics Data Import
              Hard (DcmDsdSubService): DcmDsdSubServiceId=1  # Diagnostics Data Import
            DiagSessionControl: DcmDsdSidTabServiceId=16, DcmDsdSidTabSubfuncAvail=true  # Diagnostics Data Import
              3 x DcmDsdSubService:
                Extended: DcmDsdSubServiceId=3  # Diagnostics Data Import
                Programming: DcmDsdSubServiceId=2  # Diagnostics Data Import
                Default: DcmDsdSubServiceId=1  # Diagnostics Data Import
  module config Dem
    DemGeneral:  # Diagnostics Data Import
      DemAgingCycleCounterProcessing = DEM_PROCESS_AGINGCTR_INTERN
      DemDebounceCounterBasedSupport = true
      DemDtcStatusAvailabilityMask = 255
      DemMaxNumberEventEntryMirror = 0
      DemPTOSupport = false
      DemTypeOfFreezeFrameRecordNumeration = DEM_FF_RECNUM_CALCULATED
      4 x DemDataClass:
        OccurrenceCounter_Occurrence_Counter: DemDataElementDataSize=1, DemDataElementInternalData=DEM_OCCCTR, DemDataElementUsePort=USE_DATA_INTERNAL  # Diagnostics Data Import
        DID_0x1_DID_Data_GlobalTime: DemDataElementDataSize=6, DemDataElementDataType=UINT8_N, DemDataElementEndianness=opaque, DemDataElementUsePort=USE_DATA_CLIENT_SERVER_PORT, DemDataElementStoreNonVolatile=true  # Diagnostics Data Import
        PID_0x13_DID_Data: DemDataElementDataSize=2, DemDataElementDataType=UINT16, DemDataElementEndianness=BIG_ENDIAN, DemDataElementUsePort=USE_DATA_CLIENT_SERVER_PORT, DemDataElementStoreNonVolatile=true  # Diagnostics Data Import
        PID_0x12_DID_Data: DemDataElementDataSize=2, DemDataElementDataType=UINT16, DemDataElementEndianness=BIG_ENDIAN, DemDataElementUsePort=USE_DATA_CLIENT_SERVER_PORT, DemDataElementStoreNonVolatile=true  # Diagnostics Data Import
      4 x DemOperationCycle:
        WarmUpCycle: DemOperationCycleType=DEM_OPCYC_WARMUP  # Diagnostics Data Import
        PowerCycle: DemOperationCycleType=DEM_OPCYC_POWER  # Diagnostics Data Import
        OBDDrivingCycle: DemOperationCycleType=DEM_OPCYC_OBD_DCY  # Diagnostics Data Import
        IgnitionCycle: DemOperationCycleType=DEM_OPCYC_IGNITION  # Diagnostics Data Import
      WarningIndicator (DemIndicator)  # Diagnostics Data Import
      FreezeFrameClass_5440cf4a (DemFreezeFrameClass): DemDidClassRef=DemGeneral/Example_ReadOnlyDID, DemDidClassRef=DemGeneral/DID_0xF412, DemDidClassRef=DemGeneral/DID_0xF413  # Diagnostics Data Import
      FreezeFrameClass_d65a1577 (DemFreezeFrameClass): DemDidClassRef=DemGeneral/Example_ReadOnlyDID  # Diagnostics Data Import
      OccurrenceCounter (DemExtendedDataRecordClass): DemExtendedDataRecordNumber=1, DemDataClassRef=OccurrenceCounter_Occurrence_Counter  # Diagnostics Data Import
      ExtendedDataClass_83dcefb7 (DemExtendedDataClass): DemExtendedDataRecordClassRef=OccurrenceCounter  # Diagnostics Data Import
      3 x DemDidClass:
        DID_0xF413: DemDidIdentifier=62483, DemDidDataClassRef=PID_0x13_DID_Data  # Diagnostics Data Import
        DID_0xF412: DemDidIdentifier=62482, DemDidDataClassRef=PID_0x12_DID_Data  # Diagnostics Data Import
        Example_ReadOnlyDID: DemDidIdentifier=1, DemDidDataClassRef=DID_0x1_DID_Data_GlobalTime  # Diagnostics Data Import
    DemConfigSet  # Diagnostics Data Import
      DTC_0x000003 (DemEventParameter):  # Diagnostics Data Import
        DemEventKind = DEM_EVENT_KIND_SWC
        DemMaxNumberFreezeFrameRecords = 1
        DemDTCClassRef = DTCClass_DTC_0x000003
        DemExtendedDataClassRef = ExtendedDataClass_83dcefb7
        DemFreezeFrameClassRef = FreezeFrameClass_5440cf4a
        DemEventClass:  # Diagnostics Data Import
          DemAgingAllowed = true
          DemAgingCycleCounterThreshold = 40
          DemEventDestination = DEM_DTC_ORIGIN_PRIMARY_MEMORY
          DemEventPriority = 1
          DemEventFailureCycleCounterThreshold = 2
          DemAgingCycleRef = WarmUpCycle
          DemOperationCycleRef = OBDDrivingCycle
          IndicatorAttribute_WarningIndicator (DemIndicatorAttribute): DemIndicatorFailureCycleSource=DEM_FAILURE_CYCLE_EVENT, DemIndicatorHealingCycleRef=OBDDrivingCycle, DemIndicatorRef=WarningIndicator  # Diagnostics Data Import
          DemDebounceAlgorithmClass  # Diagnostics Data Import
            DemDebounceCounterBased: DemDebounceCounterDecrementStepSize=1, DemDebounceCounterIncrementStepSize=1, DemDebounceCounterJumpDown=false, DemDebounceCounterJumpUp=true  # Diagnostics Data Import
      DTCClass_DTC_0x000003 (DemDTCClass): DemDTCSeverity=DEM_DTC_SEV_NO_SEVERITY, DemUdsDTC=3  # Diagnostics Data Import
      DTC_0x000002 (DemEventParameter):  # Diagnostics Data Import
        DemEventKind = DEM_EVENT_KIND_SWC
        DemMaxNumberFreezeFrameRecords = 1
        DemDTCClassRef = DTCClass_DTC_0x000002
        DemExtendedDataClassRef = ExtendedDataClass_83dcefb7
        DemFreezeFrameClassRef = FreezeFrameClass_d65a1577
        DemEventClass:  # Diagnostics Data Import
          DemAgingAllowed = false
          DemAgingCycleCounterThreshold = 100
          DemEventDestination = DEM_DTC_ORIGIN_PRIMARY_MEMORY
          DemEventPriority = 2
          DemEventFailureCycleCounterThreshold = 0
          DemAgingCycleRef = IgnitionCycle
          DemOperationCycleRef = PowerCycle
          IndicatorAttribute_WarningIndicator (DemIndicatorAttribute): DemIndicatorFailureCycleSource=DEM_FAILURE_CYCLE_EVENT, DemIndicatorHealingCycleRef=PowerCycle, DemIndicatorRef=WarningIndicator  # Diagnostics Data Import
          DemDebounceAlgorithmClass  # Diagnostics Data Import
            DemDebounceCounterBased: DemDebounceCounterDecrementStepSize=1, DemDebounceCounterIncrementStepSize=1, DemDebounceCounterJumpDown=false, DemDebounceCounterJumpUp=true  # Diagnostics Data Import
        DemCallbackInitMForE  # Diagnostics Data Import
      DTCClass_DTC_0x000002 (DemDTCClass): DemDTCSeverity=DEM_DTC_SEV_NO_SEVERITY, DemUdsDTC=2  # Diagnostics Data Import
  module config EcuC
    EcucPduCollection: PduIdTypeEnum=UINT8, PduLengthTypeEnum=UINT8
      6 x Pdu:
        NmUsrData_msg_NM_MyECU_oCAN00_3abd61be  # msg_NM_MyECU_oCAN00
        PT_msg_MyECU_Lamp_PP_msg_MyECU_Lamp_Tx_0fb271d2_5e566ad9: PduLength=8, SysTPduToFrameMappingRef=msg_MyECU_Lamp  # msg_MyECU_Lamp_oCAN00
        PT_msg_NM_MyECU_PP_msg_NM_MyECU_Tx_0fb271d2_5e566ad9: PduLength=8, SysTPduToFrameMappingRef=msg_NM_MyECU  # msg_NM_MyECU_oCAN00
        PT_msg_Receive_PP_msg_Receive_Rx_0fb271d2_5e566ad9: PduLength=1, SysTPduToFrameMappingRef=msg_Receive  # msg_Receive_oCAN00
        PT_msg_Transmit_PP_msg_Transmit_Tx_0fb271d2_5e566ad9: PduLength=1, SysTPduToFrameMappingRef=msg_Transmit  # msg_Transmit_oCAN00
        msg_NM_RearECU_4b8e7e70: PduLength=8, SysTPduToFrameMappingRef=msg_NM_RearECU  # msg_NM_RearECU_oCAN00
  module config EcuM
    EcuMConfiguration
      EcuMCommonConfiguration
        EcuMDriverInitListOne
        EcuMDriverRestartList
        CAN00_f26020e5 (EcuMWakeupSource): EcuMWakeupSourceId=5, EcuMComMChannelRef=ComMConfigSet/CAN00_f26020e5  # CN_CAN00
      EcuMFlexConfiguration: EcuMFlexModuleConfigurationRef=CanConfigSet
  module config PduR
    PduRGeneral
    PduRRoutingTables
      PduRRoutingTable
        3 x PduRRoutingPath:
          Can_PT_msg_MyECU_Lamp_0fb271d2  # msg_MyECU_Lamp_oCAN00
            DST_Can_PT_msg_MyECU_Lamp_0fb271d2 (PduRDestPdu): PduRDestPduRef=PT_msg_MyECU_Lamp_PP_msg_MyECU_Lamp_Tx_0fb271d2_5e566ad9
            SRC_Can_PT_msg_MyECU_Lamp_0fb271d2 (PduRSrcPdu): PduRSrcPduRef=PT_msg_MyECU_Lamp_PP_msg_MyECU_Lamp_Tx_0fb271d2_5e566ad9
          Can_PT_msg_Receive_0fb271d2  # msg_Receive_oCAN00
            DST_Can_PT_msg_Receive_0fb271d2 (PduRDestPdu): PduRDestPduRef=PT_msg_Receive_PP_msg_Receive_Rx_0fb271d2_5e566ad9
            SRC_Can_PT_msg_Receive_0fb271d2 (PduRSrcPdu): PduRSrcPduRef=PT_msg_Receive_PP_msg_Receive_Rx_0fb271d2_5e566ad9
          Can_PT_msg_Transmit_0fb271d2  # msg_Transmit_oCAN00
            DST_Can_PT_msg_Transmit_0fb271d2 (PduRDestPdu): PduRDestPduRef=PT_msg_Transmit_PP_msg_Transmit_Tx_0fb271d2_5e566ad9
            SRC_Can_PT_msg_Transmit_0fb271d2 (PduRSrcPdu): PduRSrcPduRef=PT_msg_Transmit_PP_msg_Transmit_Tx_0fb271d2_5e566ad9
