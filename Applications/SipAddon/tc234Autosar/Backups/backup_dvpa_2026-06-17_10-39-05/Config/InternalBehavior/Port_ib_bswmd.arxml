AUTOSAR XML (schema 4-2-1)
package /AURIX/Port_ib_bswmd/BswModuleDescriptions
  bsw module description Port
    bsw internal behavior PortBehavior
