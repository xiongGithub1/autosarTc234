AUTOSAR XML (schema 4-2-1)
package /COM/VECTOR/CFG/WORKFLOW/SYSDESC/SYNC
  flat map FLATMAP
    5 x flat instance descriptor:
      StartApplication: upstream-reference=ECU_Composition.StartApplication, ecu-extract-reference=COMPOSITIONTYPE.StartApplication
      ComM: upstream-reference=ECU_Composition.ComM, ecu-extract-reference=COMPOSITIONTYPE.ComM
      AppCom: upstream-reference=ECU_Composition.AppCom, ecu-extract-reference=COMPOSITIONTYPE.AppCom
      sig_State_RearInteriorLight: upstream-reference=ECU_Composition.Pisignal_Rx1bit_RearInteriorLightState.RearInteriorLightState, ecu-extract-reference=COMPOSITIONTYPE.Pisignal_Rx1bit_RearInteriorLightState.RearInteriorLightState
      Pisignal_Rx1bit_RearInteriorLightState: upstream-reference=ECU_Composition.Pisignal_Rx1bit_RearInteriorLightState, ecu-extract-reference=COMPOSITIONTYPE.Pisignal_Rx1bit_RearInteriorLightState
