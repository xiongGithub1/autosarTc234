[part 2 of 2: packages /Resource to /Mcu]
AUTOSAR XML (schema 4-2-1)
package /Resource
  module config Resource: implementation-config-variant=VARIANT-PRE-COMPILE
    ResourceGeneral: ResourceSubDerivative=TC234LP_32F200F
package /Dio
  module config Dio: implementation-config-variant=VARIANT-POST-BUILD-LOADABLE, module-description=Dio_Impl
    DioConfig_p00 (DioConfig)
      4 x DioPort:
        DioPort_P00: DioPortId=0
          DioChannelGroup: DioChannelGroupIdentification=DioChGrpId_P0_0, DioPortMask=384, DioPortOffset=7
          3 x DioChannel:
            DioChannel_led1: DioChannelId=7
            DioChannel_led2: DioChannelId=8
            DioChannel_35584_MPS: DioChannelId=12
        DioPort: DioPortId=2
          3 x DioChannel:
            DioChannel_canEn: DioChannelId=3
            DioChannel_canNerr: DioChannelId=4
            DioChannel_canNstb: DioChannelId=2
        DioPort_P21: DioPortId=21
          DioChannel_35584_SS1 (DioChannel): DioChannelId=2
          DioChannel_35584_SS2 (DioChannel): DioChannelId=3
        DioPort_P33: DioPortId=33
          DioChannel_35584_ERR (DioChannel): DioChannelId=8
          DioChannel_35584_WDI (DioChannel): DioChannelId=12
    DioGeneral:
      DioDevErrorDetect = true
      DioFlipChannelApi = true
      DioPBFixedAddress = false
      DioRunningInUser0Mode = false
      DioUserModeInitApiEnable = false
      DioUserModeRuntimeApiEnable = false
      DioVersionInfoApi = false
    DioSafety: DioInitCheckApi=false, DioSafetyEnable=false
    CommonPublishedInformation:
      ArMajorVersion = 2
      ArMinorVersion = 5
      ArPatchVersion = 0
      ModuleId = 120
      Release = _TRICORE_TC234
      SwMajorVersion = 3
      SwMinorVersion = 1
      SwPatchVersion = 0
      VendorId = 17
package /Port
  module config Port: implementation-config-variant=VARIANT-POST-BUILD-LOADABLE, module-description=Port_Impl
    PortConfigSet_0 (PortConfigSet)
      15 x PortContainer:
        PortContainer_P00: PortNumber=0, PortNumberOfPortPins=11
          11 x PortPin, all with PortPinAnalogInput=DISABLE, PortPinControllerSelect=DISABLE, PortPinDirectionChangeable=false, PortPinDriverStrength=PORT_CMOS_SPEED_GRADE1, PortPinInitialMode=PORT_PIN_MODE_GPIO, PortPinInputCharacteristic=PORT_PIN_IN_PULL_UP, PortPinLevelValue=PORT_PIN_LEVEL_LOW, PortPinModeChangeable=false, PortPinPadLevel=PORT_PDR_CMOS_AUTOMOTIVE_LEVEL:
            PortPin_0: PortPinDirection=PORT_PIN_IN, PortPinId=0, PortPinMode=PORT_PIN_MODE_ALL, PortPinSymbolicName=PORT_0_PIN_0
            PortPin_1: PortPinDirection=PORT_PIN_IN, PortPinId=1, PortPinMode=PORT_PIN_MODE_ALL, PortPinSymbolicName=PORT_0_PIN_1
            PortPin_P00_12_35584_MPS: PortPinDirection=PORT_PIN_OUT, PortPinId=12, PortPinMode=PORT_PIN_MODE_GPIO, PortPinSymbolicName=PORT_0_PIN_12, PortPinOutputCharacteristic=PORT_PIN_OUT_PUSHPULL
            PortPin_{2..6}: PortPinDirection=PORT_PIN_IN, PortPinId={2..6}, PortPinMode=PORT_PIN_MODE_ALL, PortPinSymbolicName=PORT_0_PIN_{2..6}
            Port0Pin_7_LED2: PortPinDirection=PORT_PIN_OUT, PortPinId=7, PortPinMode=PORT_PIN_MODE_GPIO, PortPinSymbolicName=PORT_0_PIN_7, PortPinOutputCharacteristic=PORT_PIN_OUT_PUSHPULL
            Port0Pin_8_LED1: PortPinDirection=PORT_PIN_OUT, PortPinId=8, PortPinMode=PORT_PIN_MODE_GPIO, PortPinSymbolicName=PORT_0_PIN_8, PortPinOutputCharacteristic=PORT_PIN_OUT_PUSHPULL
            PortPin_9: PortPinDirection=PORT_PIN_IN, PortPinId=9, PortPinMode=PORT_PIN_MODE_ALL, PortPinSymbolicName=PORT_0_PIN_9
        PortContainer_P02: PortNumber=2, PortNumberOfPortPins=9
          9 x PortPin, all with PortPinAnalogInput=DISABLE, PortPinDirectionChangeable=false, PortPinDriverStrength=PORT_CMOS_SPEED_GRADE1, PortPinModeChangeable=false, PortPinPadLevel=PORT_PDR_CMOS_AUTOMOTIVE_LEVEL:
            Port_2_Pin_0_Can1Tx: PortPinControllerSelect=DISABLE, PortPinDirection=PORT_PIN_OUT, PortPinId=32, PortPinInitialMode=PORT_PIN_MODE_ALT5, PortPinInputCharacteristic=PORT_PIN_IN_NO_PULL, PortPinLevelValue=PORT_PIN_LEVEL_LOW, PortPinSymbolicName=PORT_2_PIN_0, PortPinMode=PORT_PIN_MODE_ALT5, PortPinOutputCharacteristic=PORT_PIN_OUT_PUSHPULL
            Port_2_Pin_1_Can1Rx: PortPinControllerSelect=ENABLE, PortPinDirection=PORT_PIN_IN, PortPinId=33, PortPinInitialMode=PORT_PIN_MODE_GPIO, PortPinInputCharacteristic=PORT_PIN_IN_PULL_UP, PortPinLevelValue=PORT_PIN_LEVEL_HIGH, PortPinMode=PORT_PIN_MODE_ALL, PortPinSymbolicName=PORT_2_PIN_1
            Port_2_Pin_2_Can1NsTB: PortPinControllerSelect=DISABLE, PortPinDirection=PORT_PIN_OUT, PortPinId=34, PortPinInitialMode=PORT_PIN_MODE_GPIO, PortPinInputCharacteristic=PORT_PIN_IN_PULL_UP, PortPinLevelValue=PORT_PIN_LEVEL_HIGH, PortPinMode=PORT_PIN_MODE_GPIO, PortPinSymbolicName=PORT_2_PIN_2, PortPinOutputCharacteristic=PORT_PIN_OUT_PUSHPULL
            Port_2_Pin_3_Can1En: PortPinControllerSelect=DISABLE, PortPinDirection=PORT_PIN_OUT, PortPinId=35, PortPinInitialMode=PORT_PIN_MODE_GPIO, PortPinInputCharacteristic=PORT_PIN_IN_PULL_UP, PortPinLevelValue=PORT_PIN_LEVEL_HIGH, PortPinMode=PORT_PIN_MODE_GPIO, PortPinSymbolicName=PORT_2_PIN_3, PortPinOutputCharacteristic=PORT_PIN_OUT_PUSHPULL
            Port02Pin_4_CAN1_NERR: PortPinControllerSelect=DISABLE, PortPinDirection=PORT_PIN_IN, PortPinId=36, PortPinInitialMode=PORT_PIN_MODE_GPIO, PortPinInputCharacteristic=PORT_PIN_IN_PULL_UP, PortPinLevelValue=PORT_PIN_LEVEL_LOW, PortPinMode=PORT_PIN_MODE_GPIO, PortPinSymbolicName=PORT_2_PIN_4
            PortPin_5: PortPinControllerSelect=DISABLE, PortPinDirection=PORT_PIN_IN, PortPinId=37, PortPinInitialMode=PORT_PIN_MODE_GPIO, PortPinInputCharacteristic=PORT_PIN_IN_PULL_UP, PortPinLevelValue=PORT_PIN_LEVEL_LOW, PortPinMode=PORT_PIN_MODE_ALL, PortPinSymbolicName=PORT_2_PIN_5
            PortPin_6: PortPinControllerSelect=DISABLE, PortPinDirection=PORT_PIN_IN, PortPinId=38, PortPinInitialMode=PORT_PIN_MODE_GPIO, PortPinInputCharacteristic=PORT_PIN_IN_PULL_UP, PortPinLevelValue=PORT_PIN_LEVEL_LOW, PortPinMode=PORT_PIN_MODE_ALL, PortPinSymbolicName=PORT_2_PIN_6
            Port02Pin_7_GTMTIM: PortPinControllerSelect=DISABLE, PortPinDirection=PORT_PIN_IN, PortPinId=39, PortPinInitialMode=PORT_PIN_MODE_GPIO, PortPinInputCharacteristic=PORT_PIN_IN_PULL_UP, PortPinLevelValue=PORT_PIN_LEVEL_LOW, PortPinMode=PORT_PIN_MODE_ALL, PortPinSymbolicName=PORT_2_PIN_7
            PortPin_8: PortPinControllerSelect=DISABLE, PortPinDirection=PORT_PIN_IN, PortPinId=40, PortPinInitialMode=PORT_PIN_MODE_GPIO, PortPinInputCharacteristic=PORT_PIN_IN_PULL_UP, PortPinLevelValue=PORT_PIN_LEVEL_LOW, PortPinMode=PORT_PIN_MODE_ALL, PortPinSymbolicName=PORT_2_PIN_8
        PortContainer_P23: PortNumber=23, PortNumberOfPortPins=1
          PortPin_0 (PortPin):
            PortPinAnalogInput = DISABLE
            PortPinControllerSelect = DISABLE
            PortPinDirection = PORT_PIN_IN
            PortPinDirectionChangeable = false
            PortPinDriverStrength = PORT_CMOS_SPEED_GRADE1
            PortPinId = 369
            PortPinInitialMode = PORT_PIN_MODE_GPIO
            PortPinInputCharacteristic = PORT_PIN_IN_PULL_UP
            PortPinLevelValue = PORT_PIN_LEVEL_LOW
            PortPinMode = PORT_PIN_MODE_ALL
            PortPinModeChangeable = false
            PortPinPadLevel = PORT_PDR_CMOS_AUTOMOTIVE_LEVEL
            PortPinSymbolicName = PORT_23_PIN_1
        PortContainer_P33: PortNumber=33, PortNumberOfPortPins=13
          13 x PortPin, all with PortPinAnalogInput=DISABLE, PortPinControllerSelect=DISABLE, PortPinDirectionChangeable=false, PortPinDriverStrength=PORT_CMOS_SPEED_GRADE1, PortPinInitialMode=PORT_PIN_MODE_GPIO, PortPinModeChangeable=false, PortPinPadLevel=PORT_PDR_CMOS_AUTOMOTIVE_LEVEL:
            PortPin_0: PortPinDirection=PORT_PIN_IN, PortPinId=528, PortPinInputCharacteristic=PORT_PIN_IN_PULL_UP, PortPinLevelValue=PORT_PIN_LEVEL_LOW, PortPinMode=PORT_PIN_MODE_ALL, PortPinSymbolicName=PORT_33_PIN_0
            PortPin_1: PortPinDirection=PORT_PIN_IN, PortPinId=529, PortPinInputCharacteristic=PORT_PIN_IN_PULL_UP, PortPinLevelValue=PORT_PIN_LEVEL_LOW, PortPinMode=PORT_PIN_MODE_ALL, PortPinSymbolicName=PORT_33_PIN_1
            PortPin_10: PortPinDirection=PORT_PIN_IN, PortPinId=538, PortPinInputCharacteristic=PORT_PIN_IN_PULL_UP, PortPinLevelValue=PORT_PIN_LEVEL_LOW, PortPinMode=PORT_PIN_MODE_ALL, PortPinSymbolicName=PORT_33_PIN_10
            PortPin_11: PortPinDirection=PORT_PIN_IN, PortPinId=539, PortPinInputCharacteristic=PORT_PIN_IN_PULL_UP, PortPinLevelValue=PORT_PIN_LEVEL_LOW, PortPinMode=PORT_PIN_MODE_ALL, PortPinSymbolicName=PORT_33_PIN_11
            PortPin_P33_12_35584_WDI: PortPinDirection=PORT_PIN_OUT, PortPinId=540, PortPinInputCharacteristic=PORT_PIN_IN_PULL_UP, PortPinLevelValue=PORT_PIN_LEVEL_HIGH, PortPinMode=PORT_PIN_MODE_GPIO, PortPinSymbolicName=PORT_33_PIN_12, PortPinOutputCharacteristic=PORT_PIN_OUT_PUSHPULL
            PortPin_2: PortPinDirection=PORT_PIN_IN, PortPinId=530, PortPinInputCharacteristic=PORT_PIN_IN_PULL_UP, PortPinLevelValue=PORT_PIN_LEVEL_LOW, PortPinMode=PORT_PIN_MODE_ALL, PortPinSymbolicName=PORT_33_PIN_2
            PortPin_3: PortPinDirection=PORT_PIN_IN, PortPinId=531, PortPinInputCharacteristic=PORT_PIN_IN_PULL_UP, PortPinLevelValue=PORT_PIN_LEVEL_LOW, PortPinMode=PORT_PIN_MODE_ALL, PortPinSymbolicName=PORT_33_PIN_3
            PortPin_4: PortPinDirection=PORT_PIN_IN, PortPinId=532, PortPinInputCharacteristic=PORT_PIN_IN_PULL_UP, PortPinLevelValue=PORT_PIN_LEVEL_LOW, PortPinMode=PORT_PIN_MODE_ALL, PortPinSymbolicName=PORT_33_PIN_4
            PortPin_5: PortPinDirection=PORT_PIN_IN, PortPinId=533, PortPinInputCharacteristic=PORT_PIN_IN_PULL_UP, PortPinLevelValue=PORT_PIN_LEVEL_LOW, PortPinMode=PORT_PIN_MODE_ALL, PortPinSymbolicName=PORT_33_PIN_5
            PortPin_6: PortPinDirection=PORT_PIN_IN, PortPinId=534, PortPinInputCharacteristic=PORT_PIN_IN_PULL_UP, PortPinLevelValue=PORT_PIN_LEVEL_LOW, PortPinMode=PORT_PIN_MODE_ALL, PortPinSymbolicName=PORT_33_PIN_6
            PortPin_P33_7: PortPinDirection=PORT_PIN_IN, PortPinId=535, PortPinLevelValue=PORT_PIN_LEVEL_LOW, PortPinMode=PORT_PIN_MODE_ALL, PortPinSymbolicName=PORT_33_PIN_7
            PortPin_P33_8_35584_ERR: PortPinDirection=PORT_PIN_OUT, PortPinId=536, PortPinLevelValue=PORT_PIN_LEVEL_HIGH, PortPinMode=PORT_PIN_MODE_GPIO, PortPinSymbolicName=PORT_33_PIN_8, PortPinOutputCharacteristic=PORT_PIN_OUT_PUSHPULL
            PortPin_9: PortPinDirection=PORT_PIN_IN, PortPinId=537, PortPinInputCharacteristic=PORT_PIN_IN_PULL_UP, PortPinLevelValue=PORT_PIN_LEVEL_LOW, PortPinMode=PORT_PIN_MODE_ALL, PortPinSymbolicName=PORT_33_PIN_9
        PortContainer_P34: PortNumber=34, PortNumberOfPortPins=4
          4 x PortPin, all with PortPinAnalogInput=DISABLE, PortPinControllerSelect=DISABLE, PortPinDirection=PORT_PIN_IN, PortPinDirectionChangeable=false, PortPinDriverStrength=PORT_CMOS_SPEED_GRADE1, PortPinInitialMode=PORT_PIN_MODE_GPIO, PortPinInputCharacteristic=PORT_PIN_IN_PULL_UP, PortPinLevelValue=PORT_PIN_LEVEL_LOW, PortPinMode=PORT_PIN_MODE_ALL, PortPinModeChangeable=false, PortPinPadLevel=PORT_PDR_CMOS_AUTOMOTIVE_LEVEL:
            PortPin_0: PortPinId=544, PortPinSymbolicName=PORT_34_PIN_0
            PortPin_1: PortPinId=545, PortPinSymbolicName=PORT_34_PIN_1
            PortPin_2: PortPinId=546, PortPinSymbolicName=PORT_34_PIN_2
            PortPin_3: PortPinId=547, PortPinSymbolicName=PORT_34_PIN_3
        PortContainer_P40: PortNumber=40, PortNumberOfPortPins=12
          12 x PortPin, all with PortPinAnalogInput=DISABLE, PortPinControllerSelect=DISABLE, PortPinDirection=PORT_PIN_IN, PortPinDirectionChangeable=false, PortPinDriverStrength=PORT_CMOS_SPEED_GRADE1, PortPinInitialMode=PORT_PIN_MODE_GPIO, PortPinInputCharacteristic=PORT_PIN_IN_PULL_UP, PortPinLevelValue=PORT_PIN_LEVEL_LOW, PortPinModeChangeable=false, PortPinPadLevel=PORT_PDR_CMOS_AUTOMOTIVE_LEVEL:
            PortPin_0: PortPinId=640, PortPinSymbolicName=PORT_40_PIN_0
            PortPin_1: PortPinId=641, PortPinSymbolicName=PORT_40_PIN_1
            PortPin_10: PortPinId=650, PortPinSymbolicName=PORT_40_PIN_10
            PortPin_11: PortPinId=651, PortPinSymbolicName=PORT_40_PIN_11
            PortPin_2: PortPinId=642, PortPinSymbolicName=PORT_40_PIN_2
            PortPin_3: PortPinId=643, PortPinSymbolicName=PORT_40_PIN_3
            PortPin_4: PortPinId=644, PortPinSymbolicName=PORT_40_PIN_4
            PortPin_5: PortPinId=645, PortPinSymbolicName=PORT_40_PIN_5
            PortPin_6: PortPinId=646, PortPinSymbolicName=PORT_40_PIN_6
            PortPin_7: PortPinId=647, PortPinSymbolicName=PORT_40_PIN_7
            PortPin_8: PortPinId=648, PortPinSymbolicName=PORT_40_PIN_8
            PortPin_9: PortPinId=649, PortPinSymbolicName=PORT_40_PIN_9
        PortContainer_P41: PortNumber=41, PortNumberOfPortPins=12
          12 x PortPin, all with PortPinAnalogInput=DISABLE, PortPinControllerSelect=DISABLE, PortPinDirection=PORT_PIN_IN, PortPinDirectionChangeable=false, PortPinDriverStrength=PORT_CMOS_SPEED_GRADE1, PortPinInitialMode=PORT_PIN_MODE_GPIO, PortPinInputCharacteristic=PORT_PIN_IN_PULL_UP, PortPinLevelValue=PORT_PIN_LEVEL_LOW, PortPinModeChangeable=false, PortPinPadLevel=PORT_PDR_CMOS_AUTOMOTIVE_LEVEL:
            PortPin_0: PortPinId=656, PortPinSymbolicName=PORT_41_PIN_0
            PortPin_1: PortPinId=657, PortPinSymbolicName=PORT_41_PIN_1
            PortPin_10: PortPinId=666, PortPinSymbolicName=PORT_41_PIN_10
            PortPin_11: PortPinId=667, PortPinSymbolicName=PORT_41_PIN_11
            PortPin_2: PortPinId=658, PortPinSymbolicName=PORT_41_PIN_2
            PortPin_3: PortPinId=659, PortPinSymbolicName=PORT_41_PIN_3
            PortPin_4: PortPinId=660, PortPinSymbolicName=PORT_41_PIN_4
            PortPin_5: PortPinId=661, PortPinSymbolicName=PORT_41_PIN_5
            PortPin_6: PortPinId=662, PortPinSymbolicName=PORT_41_PIN_6
            PortPin_7: PortPinId=663, PortPinSymbolicName=PORT_41_PIN_7
            PortPin_8: PortPinId=664, PortPinSymbolicName=PORT_41_PIN_8
            PortPin_9: PortPinId=665, PortPinSymbolicName=PORT_41_PIN_9
        PortContainer_P10: PortNumber=10, PortNumberOfPortPins=5
          5 x PortPin, all with PortPinAnalogInput=DISABLE, PortPinControllerSelect=DISABLE, PortPinDirection=PORT_PIN_IN, PortPinDirectionChangeable=false, PortPinDriverStrength=PORT_CMOS_SPEED_GRADE1, PortPinInitialMode=PORT_PIN_MODE_GPIO, PortPinInputCharacteristic=PORT_PIN_IN_PULL_UP, PortPinLevelValue=PORT_PIN_LEVEL_LOW, PortPinMode=PORT_PIN_MODE_ALL, PortPinModeChangeable=false, PortPinPadLevel=PORT_PDR_CMOS_AUTOMOTIVE_LEVEL:
            PortPin_0: PortPinId=161, PortPinSymbolicName=PORT_10_PIN_1
            PortPin_1: PortPinId=162, PortPinSymbolicName=PORT_10_PIN_2
            PortPin_2: PortPinId=163, PortPinSymbolicName=PORT_10_PIN_3
            PortPin_3: PortPinId=165, PortPinSymbolicName=PORT_10_PIN_5
            PortPin_4: PortPinId=166, PortPinSymbolicName=PORT_10_PIN_6
        PortContainer_P11: PortNumber=11, PortNumberOfPortPins=8
          8 x PortPin, all with PortPinAnalogInput=DISABLE, PortPinControllerSelect=DISABLE, PortPinDirectionChangeable=false, PortPinDriverStrength=PORT_CMOS_SPEED_GRADE1, PortPinLevelValue=PORT_PIN_LEVEL_LOW, PortPinModeChangeable=false, PortPinPadLevel=PORT_PDR_CMOS_AUTOMOTIVE_LEVEL:
            PortPin_35584SCS: PortPinDirection=PORT_PIN_OUT, PortPinId=178, PortPinInitialMode=PORT_PIN_MODE_ALT4, PortPinInputCharacteristic=PORT_PIN_IN_PULL_UP, PortPinMode=PORT_PIN_MODE_ALT4, PortPinSymbolicName=PORT_11_PIN_2, PortPinOutputCharacteristic=PORT_PIN_OUT_PUSHPULL
            PortPin_35584SDO: PortPinDirection=PORT_PIN_IN, PortPinId=179, PortPinInitialMode=PORT_PIN_MODE_GPIO, PortPinInputCharacteristic=PORT_PIN_IN_NO_PULL, PortPinMode=PORT_PIN_MODE_GPIO, PortPinSymbolicName=PORT_11_PIN_3
            PortPin_35584SCL: PortPinDirection=PORT_PIN_OUT, PortPinId=182, PortPinInitialMode=PORT_PIN_MODE_ALT3, PortPinInputCharacteristic=PORT_PIN_IN_PULL_UP, PortPinMode=PORT_PIN_MODE_ALT3, PortPinSymbolicName=PORT_11_PIN_6, PortPinOutputCharacteristic=PORT_PIN_OUT_PUSHPULL
            PortPin_3: PortPinDirection=PORT_PIN_IN, PortPinId=184, PortPinInitialMode=PORT_PIN_MODE_GPIO, PortPinInputCharacteristic=PORT_PIN_IN_PULL_UP, PortPinMode=PORT_PIN_MODE_ALL, PortPinSymbolicName=PORT_11_PIN_8
            PortPin_33584SDI: PortPinDirection=PORT_PIN_OUT, PortPinId=185, PortPinInitialMode=PORT_PIN_MODE_ALT3, PortPinInputCharacteristic=PORT_PIN_IN_PULL_UP, PortPinMode=PORT_PIN_MODE_ALT3, PortPinSymbolicName=PORT_11_PIN_9, PortPinOutputCharacteristic=PORT_PIN_OUT_PUSHPULL
            PortPin_5: PortPinDirection=PORT_PIN_IN, PortPinId=186, PortPinInitialMode=PORT_PIN_MODE_GPIO, PortPinInputCharacteristic=PORT_PIN_IN_PULL_UP, PortPinMode=PORT_PIN_MODE_ALL, PortPinSymbolicName=PORT_11_PIN_10
            PortPin_6: PortPinDirection=PORT_PIN_IN, PortPinId=187, PortPinInitialMode=PORT_PIN_MODE_GPIO, PortPinInputCharacteristic=PORT_PIN_IN_PULL_UP, PortPinMode=PORT_PIN_MODE_ALL, PortPinSymbolicName=PORT_11_PIN_11
            PortPin_7: PortPinDirection=PORT_PIN_IN, PortPinId=188, PortPinInitialMode=PORT_PIN_MODE_GPIO, PortPinInputCharacteristic=PORT_PIN_IN_PULL_UP, PortPinMode=PORT_PIN_MODE_ALL, PortPinSymbolicName=PORT_11_PIN_12
        PortContainer_P13: PortNumber=13, PortNumberOfPortPins=4
          4 x PortPin, all with PortPinAnalogInput=DISABLE, PortPinControllerSelect=DISABLE, PortPinDirection=PORT_PIN_IN, PortPinDirectionChangeable=false, PortPinDriverStrength=PORT_CMOS_SPEED_GRADE1, PortPinInitialMode=PORT_PIN_MODE_GPIO, PortPinInputCharacteristic=PORT_PIN_IN_PULL_UP, PortPinLevelValue=PORT_PIN_LEVEL_LOW, PortPinMode=PORT_PIN_MODE_ALL, PortPinModeChangeable=false, PortPinPadLevel=PORT_PDR_CMOS_AUTOMOTIVE_LEVEL:
            PortPin_0: PortPinId=208, PortPinSymbolicName=PORT_13_PIN_0
            PortPin_1: PortPinId=209, PortPinSymbolicName=PORT_13_PIN_1
            PortPin_2: PortPinId=210, PortPinSymbolicName=PORT_13_PIN_2
            PortPin_3: PortPinId=211, PortPinSymbolicName=PORT_13_PIN_3
        PortContainer_P14: PortNumber=14, PortNumberOfPortPins=9
          9 x PortPin, all with PortPinAnalogInput=DISABLE, PortPinControllerSelect=DISABLE, PortPinDirectionChangeable=false, PortPinDriverStrength=PORT_CMOS_SPEED_GRADE1, PortPinInputCharacteristic=PORT_PIN_IN_PULL_UP, PortPinModeChangeable=false, PortPinPadLevel=PORT_PDR_CMOS_AUTOMOTIVE_LEVEL:
            Port14Pin_0_CanTx: PortPinDirection=PORT_PIN_OUT, PortPinId=224, PortPinInitialMode=PORT_PIN_MODE_ALT5, PortPinLevelValue=PORT_PIN_LEVEL_LOW, PortPinMode=PORT_PIN_MODE_ALT5, PortPinSymbolicName=PORT_14_PIN_0, PortPinOutputCharacteristic=PORT_PIN_OUT_PUSHPULL
            Port14Pin_1_CanRx: PortPinDirection=PORT_PIN_IN, PortPinId=225, PortPinInitialMode=PORT_PIN_MODE_GPIO, PortPinLevelValue=PORT_PIN_LEVEL_LOW, PortPinMode=PORT_PIN_MODE_GPIO, PortPinSymbolicName=PORT_14_PIN_1
            PortPin_2: PortPinDirection=PORT_PIN_IN, PortPinId=226, PortPinInitialMode=PORT_PIN_MODE_GPIO, PortPinLevelValue=PORT_PIN_LEVEL_LOW, PortPinMode=PORT_PIN_MODE_ALL, PortPinSymbolicName=PORT_14_PIN_2
            PortPin_3: PortPinDirection=PORT_PIN_IN, PortPinId=227, PortPinInitialMode=PORT_PIN_MODE_GPIO, PortPinLevelValue=PORT_PIN_LEVEL_LOW, PortPinMode=PORT_PIN_MODE_ALL, PortPinSymbolicName=PORT_14_PIN_3
            Port14Pin_4_Can2En: PortPinDirection=PORT_PIN_OUT, PortPinId=228, PortPinInitialMode=PORT_PIN_MODE_GPIO, PortPinLevelValue=PORT_PIN_LEVEL_HIGH, PortPinMode=PORT_PIN_MODE_GPIO, PortPinSymbolicName=PORT_14_PIN_4, PortPinOutputCharacteristic=PORT_PIN_OUT_PUSHPULL
            PortPin_5: PortPinDirection=PORT_PIN_IN, PortPinId=229, PortPinInitialMode=PORT_PIN_MODE_GPIO, PortPinLevelValue=PORT_PIN_LEVEL_LOW, PortPinMode=PORT_PIN_MODE_ALL, PortPinSymbolicName=PORT_14_PIN_5
            PortPin_6: PortPinDirection=PORT_PIN_IN, PortPinId=230, PortPinInitialMode=PORT_PIN_MODE_GPIO, PortPinLevelValue=PORT_PIN_LEVEL_LOW, PortPinMode=PORT_PIN_MODE_ALL, PortPinSymbolicName=PORT_14_PIN_6
            PortPin_7: PortPinDirection=PORT_PIN_IN, PortPinId=231, PortPinInitialMode=PORT_PIN_MODE_GPIO, PortPinLevelValue=PORT_PIN_LEVEL_LOW, PortPinMode=PORT_PIN_MODE_ALL, PortPinSymbolicName=PORT_14_PIN_7
            PortPin_8: PortPinDirection=PORT_PIN_IN, PortPinId=232, PortPinInitialMode=PORT_PIN_MODE_GPIO, PortPinLevelValue=PORT_PIN_LEVEL_LOW, PortPinMode=PORT_PIN_MODE_ALL, PortPinSymbolicName=PORT_14_PIN_8
        PortContainer_P15: PortNumber=15, PortNumberOfPortPins=9
          9 x PortPin, all with PortPinAnalogInput=DISABLE, PortPinControllerSelect=DISABLE, PortPinDirection=PORT_PIN_IN, PortPinDirectionChangeable=false, PortPinDriverStrength=PORT_CMOS_SPEED_GRADE1, PortPinInitialMode=PORT_PIN_MODE_GPIO, PortPinInputCharacteristic=PORT_PIN_IN_PULL_UP, PortPinLevelValue=PORT_PIN_LEVEL_LOW, PortPinMode=PORT_PIN_MODE_ALL, PortPinModeChangeable=false, PortPinPadLevel=PORT_PDR_CMOS_AUTOMOTIVE_LEVEL:
            PortPin_0: PortPinId=240, PortPinSymbolicName=PORT_15_PIN_0
            PortPin_1: PortPinId=241, PortPinSymbolicName=PORT_15_PIN_1
            PortPin_2: PortPinId=242, PortPinSymbolicName=PORT_15_PIN_2
            PortPin_3: PortPinId=243, PortPinSymbolicName=PORT_15_PIN_3
            PortPin_4: PortPinId=244, PortPinSymbolicName=PORT_15_PIN_4
            PortPin_5: PortPinId=245, PortPinSymbolicName=PORT_15_PIN_5
            PortPin_6: PortPinId=246, PortPinSymbolicName=PORT_15_PIN_6
            PortPin_7: PortPinId=247, PortPinSymbolicName=PORT_15_PIN_7
            PortPin_8: PortPinId=248, PortPinSymbolicName=PORT_15_PIN_8
        PortContainer_P20: PortNumber=20, PortNumberOfPortPins=12
          12 x PortPin, all with PortPinAnalogInput=DISABLE, PortPinControllerSelect=DISABLE, PortPinDirection=PORT_PIN_IN, PortPinDirectionChangeable=false, PortPinDriverStrength=PORT_CMOS_SPEED_GRADE1, PortPinInitialMode=PORT_PIN_MODE_GPIO, PortPinLevelValue=PORT_PIN_LEVEL_LOW, PortPinMode=PORT_PIN_MODE_ALL, PortPinModeChangeable=false, PortPinPadLevel=PORT_PDR_CMOS_AUTOMOTIVE_LEVEL:
            PortPin_0: PortPinId=320, PortPinInputCharacteristic=PORT_PIN_IN_PULL_UP, PortPinSymbolicName=PORT_20_PIN_0
            PortPin_1: PortPinId=322, PortPinInputCharacteristic=PORT_PIN_IN_PULL_UP, PortPinSymbolicName=PORT_20_PIN_2
            PortPin_10: PortPinId=333, PortPinInputCharacteristic=PORT_PIN_IN_PULL_UP, PortPinSymbolicName=PORT_20_PIN_13
            PortPin_11: PortPinId=334, PortPinInputCharacteristic=PORT_PIN_IN_PULL_UP, PortPinSymbolicName=PORT_20_PIN_14
            PortPin_2: PortPinId=323, PortPinSymbolicName=PORT_20_PIN_3
            PortPin_3: PortPinId=326, PortPinInputCharacteristic=PORT_PIN_IN_PULL_UP, PortPinSymbolicName=PORT_20_PIN_6
            PortPin_4: PortPinId=327, PortPinInputCharacteristic=PORT_PIN_IN_PULL_UP, PortPinSymbolicName=PORT_20_PIN_7
            PortPin_5: PortPinId=328, PortPinInputCharacteristic=PORT_PIN_IN_PULL_UP, PortPinSymbolicName=PORT_20_PIN_8
            PortPin_6: PortPinId=329, PortPinInputCharacteristic=PORT_PIN_IN_PULL_UP, PortPinSymbolicName=PORT_20_PIN_9
            PortPin_7: PortPinId=330, PortPinInputCharacteristic=PORT_PIN_IN_PULL_UP, PortPinSymbolicName=PORT_20_PIN_10
            PortPin_8: PortPinId=331, PortPinInputCharacteristic=PORT_PIN_IN_PULL_UP, PortPinSymbolicName=PORT_20_PIN_11
            PortPin_9: PortPinId=332, PortPinInputCharacteristic=PORT_PIN_IN_PULL_UP, PortPinSymbolicName=PORT_20_PIN_12
        PortContainer_P21: PortNumber=21, PortNumberOfPortPins=6
          6 x PortPin, all with PortPinAnalogInput=DISABLE, PortPinControllerSelect=DISABLE, PortPinDirection=PORT_PIN_IN, PortPinDirectionChangeable=false, PortPinDriverStrength=PORT_CMOS_SPEED_GRADE1, PortPinInitialMode=PORT_PIN_MODE_GPIO, PortPinLevelValue=PORT_PIN_LEVEL_LOW, PortPinMode=PORT_PIN_MODE_ALL, PortPinModeChangeable=false, PortPinPadLevel=PORT_PDR_CMOS_AUTOMOTIVE_LEVEL:
            PortPin_SS1: PortPinId=338, PortPinInputCharacteristic=PORT_PIN_IN_NO_PULL, PortPinSymbolicName=PORT_21_PIN_2
            PortPin_SS2: PortPinId=339, PortPinInputCharacteristic=PORT_PIN_IN_NO_PULL, PortPinSymbolicName=PORT_21_PIN_3
            PortPin_2: PortPinId=340, PortPinInputCharacteristic=PORT_PIN_IN_PULL_UP, PortPinSymbolicName=PORT_21_PIN_4
            PortPin_3: PortPinId=341, PortPinInputCharacteristic=PORT_PIN_IN_PULL_UP, PortPinSymbolicName=PORT_21_PIN_5
            Port21Pin_6: PortPinId=342, PortPinSymbolicName=PORT_21_PIN_6
            Port21Pin_7: PortPinId=343, PortPinSymbolicName=PORT_21_PIN_7
        PortContainer_P22: PortNumber=22, PortNumberOfPortPins=5
          5 x PortPin, all with PortPinAnalogInput=DISABLE, PortPinControllerSelect=DISABLE, PortPinDirection=PORT_PIN_IN, PortPinDirectionChangeable=false, PortPinDriverStrength=PORT_CMOS_SPEED_GRADE1, PortPinInitialMode=PORT_PIN_MODE_GPIO, PortPinInputCharacteristic=PORT_PIN_IN_PULL_UP, PortPinLevelValue=PORT_PIN_LEVEL_LOW, PortPinMode=PORT_PIN_MODE_ALL, PortPinModeChangeable=false, PortPinPadLevel=PORT_PDR_CMOS_AUTOMOTIVE_LEVEL:
            PortPin_0: PortPinId=352, PortPinSymbolicName=PORT_22_PIN_0
            PortPin_1: PortPinId=353, PortPinSymbolicName=PORT_22_PIN_1
            PortPin_2: PortPinId=354, PortPinSymbolicName=PORT_22_PIN_2
            PortPin_3: PortPinId=355, PortPinSymbolicName=PORT_22_PIN_3
            PortPin_4: PortPinId=356, PortPinSymbolicName=PORT_22_PIN_4
    PortSafety: PortInitCheckApi=false, PortSafetyEnable=false
    PortGeneral:
      PortDevErrorDetect = true
      PortPBFixedAddress = false
      PortRunningInUser0Mode = false
      PortSetPinDirectionApi = false
      PortSetPinModeApi = false
      PortUserModeInitApiEnable = false
      PortUserModeRuntimeApiEnable = false
      PortVersionInfoApi = false
    CommonPublishedInformation:
      ArMajorVersion = 3
      ArMinorVersion = 2
      ArPatchVersion = 0
      ModuleId = 124
      Release = _TRICORE_TC234
      SwMajorVersion = 3
      SwMinorVersion = 1
      SwPatchVersion = 0
      VendorId = 17
package /Mcu
  module config Mcu: implementation-config-variant=VARIANT-POST-BUILD-LOADABLE, module-description=Mcu_Impl
    McuPublishedInformation
      16 x McuResetReasonConf, all with McuResetReason=0:
        MCU_CB0_RESET
        MCU_CB1_RESET
        MCU_CB3_RESET
        MCU_ESR0_RESET
        MCU_ESR1_RESET
        MCU_EVR13_RESET
        MCU_EVR33_RESET
        MCU_POWER_ON_RESET
        MCU_RESET_MULTIPLE
        MCU_RESET_UNDEFINED
        MCU_SMU_RESET
        MCU_STBYR_RESET
        MCU_STM0_RESET
        MCU_SUPPLY_WDOG_RESET
        MCU_SW_RESET
        MCU_TP_RESET
    McuGeneralConfiguration:
      McuClearColdResetApi = false
      McuDeInitApi = false
      McuDevErrorDetect = true
      McuErayPllInitDelay = 10
      McuFmPllEnable = false
      McuGetRamStateApi = false
      McuInitClock = true
      McuMainOscillatorFrequency = 20
      McuNoPll = false
      McuPBFixedAddress = false
      McuPerformResetApi = true
      McuPllInitDelay = 10
      McuResetSfrAtInit = false
      McuRunningInUser0Mode = false
      McuUserModeDeInitApiEnable = false
      McuUserModeInitApiEnable = false
      McuUserModeRuntimeApiEnable = false
      McuVersionInfoApi = false
    McuModuleConfiguration_0 (McuModuleConfiguration): McuClockSrcFailureNotification=DISABLED, McuNumberOfMcuModes=1, McuRamSectors=0, McuResetSetting=1, McuStm0ResetDisable=false
      AscLinConfiguration: AscLin0=USE_FOR_NONE, AscLin1=USE_FOR_NONE
      CcuConfiguration_0 (CcuConfiguration)
        Ccu60 (Ccu6)
          General: Ccu6ModuleUsage=UNUSED
          T12
            3 x Cc6:
              Cc60: CCChannelInputSelection=CCINA_PORT2_PIN0
              Cc61: CCChannelInputSelection=CCINA_PORT2_PIN2
              Cc62: CCChannelInputSelection=CCINA_PORT2_PIN4
            General: T12ClkSelection=0, T12PrescalerEnabled=false
          T13
            General: T13ClkSelection=0, T13PrescalerEnabled=false
        Ccu61 (Ccu6)
          General: Ccu6ModuleUsage=UNUSED
          T12
            3 x Cc6:
              Cc60: CCChannelInputSelection=CCINA_PORT0_PIN1
              Cc61: CCChannelInputSelection=CCINA_PORT0_PIN3
              Cc62: CCChannelInputSelection=CCINA_PORT0_PIN5
            General: T12ClkSelection=0, T12PrescalerEnabled=false
          T13
            General: T13ClkSelection=0, T13PrescalerEnabled=false
      DmaConfiguration_0 (DmaConfiguration)
        16 x DmaChannel:
          DmaChannel_0: ChannelId=0, ChannelUsed=USE_FOR_SPI_DRIVER
          DmaChannel_1: ChannelId=1, ChannelUsed=USE_FOR_SPI_DRIVER
          DmaChannel_{10..15}: ChannelId={10..15}, ChannelUsed=USE_FOR_NONE
          DmaChannel_{2..7}: ChannelId={2..7}, ChannelUsed=USE_FOR_SPI_DRIVER
          DmaChannel_8: ChannelId=8, ChannelUsed=USE_FOR_NONE
          DmaChannel_9: ChannelId=9, ChannelUsed=USE_FOR_NONE
      EruConfiguration_0 (EruConfiguration)
        ERU{0..7}: EruChannelUsage=UNUSED
      GtmConfiguration_0 (GtmConfiguration)
        Cmu_0 (Cmu)
          CmuConfigurableClock:
            CmuClk6SourceSelect = CMU_CLK_6_DIVIDER
            CmuClk7SourceSelect = CMU_CLK_7_DIVIDER
            CmuConfigurableClk{0..7}Div = 0
            CmuEnableConfigurableClk{0..7} = false
          CmuExternalClock:
            CmuEnableExternalClk{0..2} = false
            CmuExternalClk0Denominator = 1
            CmuExternalClk0Numerator = 1
            CmuExternalClk1Denominator = 1
            CmuExternalClk1Numerator = 1
            CmuExternalClk2Denominator = 1
            CmuExternalClk2Numerator = 1
          CmuFixedClock: CmuEnableAllFixedClocks=true, CmuFxdClkSourceSelect=GTM_GLOBAL_CLOCK
        GtmAeiInterface:
          GtmAeiIllegalModuleAddErrIntEn = false
          GtmAeiIllegalModuleAddIntEn = false
          GtmAeiInterruptMode = GTM_INTERRUPT_LEVEL_MODE
          GtmAeiTimeOutMode = OBSERVE
          GtmAeiTimeOutValue = 0
          GtmAeiTimeoutExceptionErrIntEn = false
          GtmAeiTimeoutExceptionIntEn = false
          GtmAeiUnsupportedAddressErrIntEn = false
          GtmAeiUnsupportedAddressIntEn = false
          GtmAeiUnsupportedByteEnErrIntEn = false
          GtmAeiUnsupportedByteEnIntEn = false
        GtmConnections_0 (GtmConnections)
          4 x GtmTriggerForAdc, all with GtmTrigger0Select=TRIG_0_NONE, GtmTrigger1Select=TRIG_0_NONE:
            GtmTriggerForAdc_{0..3}
          4 x GtmTtcanTrigger:
            GtmTtcanTrigger_0: GtmTriggerSelect=SEL0_TOM0_CH0
            GtmTtcanTrigger_1: GtmTriggerSelect=SEL0_TOM1_CH0
            GtmTtcanTrigger_2: GtmTriggerSelect=SEL0_TOM0_CH0
            GtmTtcanTrigger_3: GtmTriggerSelect=SEL0_TOM1_CH0
        GtmGeneral: GtmEnRstAndForceIntFunctionality=false, GtmGlobalClkDivDenominator=1, GtmGlobalClkDivNumerator=1, GtmSleepMode=GTM_SLEEP_ENABLE
        Tbu_0 (Tbu)
          3 x TbuChannel, all with TbuChannelClockSource=GTM_CONFIGURABLE_CLOCK_0, TbuChannelModeSelect=FREE_RUNNING_COUNTER_MODE, TbuChannelResolution=BITS_0_TO_23, TbuChannelUsage=USED_BY_OTHER_DRIVERS_OR_UNUSED, TbuEnableChannel=false, TbuTimebaseValue=0:
            TbuChannel_{0..2}
        Tim_0 (Tim)
          8 x TimChannel:
            TimChannel_0
              TimChannelErrorInterrupt:
                TimInterruptEnableOnCntOflErr = false
                TimInterruptEnableOnEcntOflErr = false
                TimInterruptEnableOnGlitchDetErr = false
                TimInterruptEnableOnGprxOflErr = false
                TimInterruptEnableOnNewValErr = false
                TimInterruptEnableOnToDetErr = false
              TimChannelFilterConfig:
                TimChFilterCounterFreqSelect = GTM_CONFIGURABLE_CLOCK_0
                TimChFilterModeForFallingEdge = IMMEDIATE_EDGE_PROPAGATION_MODE
                TimChFilterModeForRisingEdge = IMMEDIATE_EDGE_PROPAGATION_MODE
                TimChFilterTimeForFallingEdge = 0
                TimChFilterTimeForRisingEdge = 0
                TimChannelFilterEnable = false
              TimChannelGeneral:
                TimChannelClockSelect = GTM_CONFIGURABLE_CLOCK_0
                TimChannelCntsInputSelect = CNT_VALUE
                TimChannelCntsValue = 0
                TimChannelEcntOvflwSetting = SEL0_OVRFLOW_SIG_ON_ECNT_BITWIDTH_8
                TimChannelEcntResetSetting = SEL0_ECNT_IN_WRAP_AROUND_MODE
                TimChannelEnable = false
                TimChannelExtCaptureModeEnable = false
                TimChannelExtCaptureSrc = SEL0_NEW_VAL_IRQ
                TimChannelGpr0InputSelect = TIMEBASE_TBU_TS0
                TimChannelGpr1InputSelect = TIMEBASE_TBU_TS0
                TimChannelInputSelect = INPUT_OF_CURRENT_TIM_CHANNEL
                TimChannelModeSelect = PWM_MEASUREMENT_MODE_TPWM
                TimChannelOneShotMode = false
                TimChannelPortPinSelect = NONE_SEL0
                TimChannelSignalEdgeSelect = FALLING_EDGE
                TimChannelTbu0Ts0BitsSelect = BITS_0_TO_23
                TimChannelUsage = USED_BY_OTHER_DRIVERS_OR_UNUSED
                TimChannelValInitSignal = VAL_LOW
              TimChannelInterrupt:
                TimInterruptEnableOnCntOfl = false
                TimInterruptEnableOnEcntOfl = false
                TimInterruptEnableOnGlitchDet = false
                TimInterruptEnableOnGprxOfl = false
                TimInterruptEnableOnNewVal = false
                TimInterruptEnableOnToDet = false
                TimInterruptMode = GTM_INTERRUPT_LEVEL_MODE
                TimNotification = NULL_PTR
              TimChannelTimeoutDetection: TimChTimeoutClockSelect=GTM_CONFIGURABLE_CLOCK_0, TimChTimeoutDetectionEnable=SEL0_TIMOUT_DISABLED, TimChTimeoutDuration=0
            TimChannel_1
              TimChannelErrorInterrupt:
                TimInterruptEnableOnCntOflErr = false
                TimInterruptEnableOnEcntOflErr = false
                TimInterruptEnableOnGlitchDetErr = false
                TimInterruptEnableOnGprxOflErr = false
                TimInterruptEnableOnNewValErr = false
                TimInterruptEnableOnToDetErr = false
              TimChannelFilterConfig:
                TimChFilterCounterFreqSelect = GTM_CONFIGURABLE_CLOCK_0
                TimChFilterModeForFallingEdge = IMMEDIATE_EDGE_PROPAGATION_MODE
                TimChFilterModeForRisingEdge = IMMEDIATE_EDGE_PROPAGATION_MODE
                TimChFilterTimeForFallingEdge = 0
                TimChFilterTimeForRisingEdge = 0
                TimChannelFilterEnable = false
              TimChannelGeneral:
                TimChannelClockSelect = GTM_CONFIGURABLE_CLOCK_0
                TimChannelCntsInputSelect = CNT_VALUE
                TimChannelCntsValue = 0
                TimChannelEcntOvflwSetting = SEL0_OVRFLOW_SIG_ON_ECNT_BITWIDTH_8
                TimChannelEcntResetSetting = SEL0_ECNT_IN_WRAP_AROUND_MODE
                TimChannelEnable = false
                TimChannelExtCaptureModeEnable = false
                TimChannelExtCaptureSrc = SEL0_NEW_VAL_IRQ
                TimChannelGpr0InputSelect = TIMEBASE_TBU_TS0
                TimChannelGpr1InputSelect = TIMEBASE_TBU_TS0
                TimChannelInputSelect = INPUT_OF_CURRENT_TIM_CHANNEL
                TimChannelModeSelect = PWM_MEASUREMENT_MODE_TPWM
                TimChannelOneShotMode = false
                TimChannelPortPinSelect = NONE_SEL0
                TimChannelSignalEdgeSelect = FALLING_EDGE
                TimChannelTbu0Ts0BitsSelect = BITS_0_TO_23
                TimChannelUsage = USED_BY_OTHER_DRIVERS_OR_UNUSED
                TimChannelValInitSignal = VAL_LOW
              TimChannelInterrupt:
                TimInterruptEnableOnCntOfl = false
                TimInterruptEnableOnEcntOfl = false
                TimInterruptEnableOnGlitchDet = false
                TimInterruptEnableOnGprxOfl = false
                TimInterruptEnableOnNewVal = false
                TimInterruptEnableOnToDet = false
                TimInterruptMode = GTM_INTERRUPT_LEVEL_MODE
                TimNotification = NULL_PTR
              TimChannelTimeoutDetection: TimChTimeoutClockSelect=GTM_CONFIGURABLE_CLOCK_0, TimChTimeoutDetectionEnable=SEL0_TIMOUT_DISABLED, TimChTimeoutDuration=0
            TimChannel_2
              TimChannelErrorInterrupt:
                TimInterruptEnableOnCntOflErr = false
                TimInterruptEnableOnEcntOflErr = false
                TimInterruptEnableOnGlitchDetErr = false
                TimInterruptEnableOnGprxOflErr = false
                TimInterruptEnableOnNewValErr = false
                TimInterruptEnableOnToDetErr = false
              TimChannelFilterConfig:
                TimChFilterCounterFreqSelect = GTM_CONFIGURABLE_CLOCK_0
                TimChFilterModeForFallingEdge = IMMEDIATE_EDGE_PROPAGATION_MODE
                TimChFilterModeForRisingEdge = IMMEDIATE_EDGE_PROPAGATION_MODE
                TimChFilterTimeForFallingEdge = 0
                TimChFilterTimeForRisingEdge = 0
                TimChannelFilterEnable = false
              TimChannelGeneral:
                TimChannelClockSelect = GTM_CONFIGURABLE_CLOCK_0
                TimChannelCntsInputSelect = CNT_VALUE
                TimChannelCntsValue = 0
                TimChannelEcntOvflwSetting = SEL0_OVRFLOW_SIG_ON_ECNT_BITWIDTH_8
                TimChannelEcntResetSetting = SEL0_ECNT_IN_WRAP_AROUND_MODE
                TimChannelEnable = false
                TimChannelExtCaptureModeEnable = false
                TimChannelExtCaptureSrc = SEL0_NEW_VAL_IRQ
                TimChannelGpr0InputSelect = TIMEBASE_TBU_TS0
                TimChannelGpr1InputSelect = TIMEBASE_TBU_TS0
                TimChannelInputSelect = INPUT_OF_CURRENT_TIM_CHANNEL
                TimChannelModeSelect = PWM_MEASUREMENT_MODE_TPWM
                TimChannelOneShotMode = false
                TimChannelPortPinSelect = NONE_SEL0
                TimChannelSignalEdgeSelect = FALLING_EDGE
                TimChannelTbu0Ts0BitsSelect = BITS_0_TO_23
                TimChannelUsage = USED_BY_OTHER_DRIVERS_OR_UNUSED
                TimChannelValInitSignal = VAL_LOW
              TimChannelInterrupt:
                TimInterruptEnableOnCntOfl = false
                TimInterruptEnableOnEcntOfl = false
                TimInterruptEnableOnGlitchDet = false
                TimInterruptEnableOnGprxOfl = false
                TimInterruptEnableOnNewVal = false
                TimInterruptEnableOnToDet = false
                TimInterruptMode = GTM_INTERRUPT_LEVEL_MODE
                TimNotification = NULL_PTR
              TimChannelTimeoutDetection: TimChTimeoutClockSelect=GTM_CONFIGURABLE_CLOCK_0, TimChTimeoutDetectionEnable=SEL0_TIMOUT_DISABLED, TimChTimeoutDuration=0
            TimChannel_3
              TimChannelErrorInterrupt:
                TimInterruptEnableOnCntOflErr = false
                TimInterruptEnableOnEcntOflErr = false
                TimInterruptEnableOnGlitchDetErr = false
                TimInterruptEnableOnGprxOflErr = false
                TimInterruptEnableOnNewValErr = false
                TimInterruptEnableOnToDetErr = false
              TimChannelFilterConfig:
                TimChFilterCounterFreqSelect = GTM_CONFIGURABLE_CLOCK_0
                TimChFilterModeForFallingEdge = IMMEDIATE_EDGE_PROPAGATION_MODE
                TimChFilterModeForRisingEdge = IMMEDIATE_EDGE_PROPAGATION_MODE
                TimChFilterTimeForFallingEdge = 0
                TimChFilterTimeForRisingEdge = 0
                TimChannelFilterEnable = false
              TimChannelGeneral:
                TimChannelClockSelect = GTM_CONFIGURABLE_CLOCK_0
                TimChannelCntsInputSelect = CNT_VALUE
                TimChannelCntsValue = 0
                TimChannelEcntOvflwSetting = SEL0_OVRFLOW_SIG_ON_ECNT_BITWIDTH_8
                TimChannelEcntResetSetting = SEL0_ECNT_IN_WRAP_AROUND_MODE
                TimChannelEnable = false
                TimChannelExtCaptureModeEnable = false
                TimChannelExtCaptureSrc = SEL0_NEW_VAL_IRQ
                TimChannelGpr0InputSelect = TIMEBASE_TBU_TS0
                TimChannelGpr1InputSelect = TIMEBASE_TBU_TS0
                TimChannelInputSelect = INPUT_OF_CURRENT_TIM_CHANNEL
                TimChannelModeSelect = PWM_MEASUREMENT_MODE_TPWM
                TimChannelOneShotMode = false
                TimChannelPortPinSelect = NONE_SEL0
                TimChannelSignalEdgeSelect = FALLING_EDGE
                TimChannelTbu0Ts0BitsSelect = BITS_0_TO_23
                TimChannelUsage = USED_BY_OTHER_DRIVERS_OR_UNUSED
                TimChannelValInitSignal = VAL_LOW
              TimChannelInterrupt:
                TimInterruptEnableOnCntOfl = false
                TimInterruptEnableOnEcntOfl = false
                TimInterruptEnableOnGlitchDet = false
                TimInterruptEnableOnGprxOfl = false
                TimInterruptEnableOnNewVal = false
                TimInterruptEnableOnToDet = false
                TimInterruptMode = GTM_INTERRUPT_LEVEL_MODE
                TimNotification = NULL_PTR
              TimChannelTimeoutDetection: TimChTimeoutClockSelect=GTM_CONFIGURABLE_CLOCK_0, TimChTimeoutDetectionEnable=SEL0_TIMOUT_DISABLED, TimChTimeoutDuration=0
            TimChannel_4
              TimChannelErrorInterrupt:
                TimInterruptEnableOnCntOflErr = false
                TimInterruptEnableOnEcntOflErr = false
                TimInterruptEnableOnGlitchDetErr = false
                TimInterruptEnableOnGprxOflErr = false
                TimInterruptEnableOnNewValErr = false
                TimInterruptEnableOnToDetErr = false
              TimChannelFilterConfig:
                TimChFilterCounterFreqSelect = GTM_CONFIGURABLE_CLOCK_0
                TimChFilterModeForFallingEdge = IMMEDIATE_EDGE_PROPAGATION_MODE
                TimChFilterModeForRisingEdge = IMMEDIATE_EDGE_PROPAGATION_MODE
                TimChFilterTimeForFallingEdge = 0
                TimChFilterTimeForRisingEdge = 0
                TimChannelFilterEnable = false
              TimChannelGeneral:
                TimChannelClockSelect = GTM_CONFIGURABLE_CLOCK_0
                TimChannelCntsInputSelect = CNT_VALUE
                TimChannelCntsValue = 0
                TimChannelEcntOvflwSetting = SEL0_OVRFLOW_SIG_ON_ECNT_BITWIDTH_8
                TimChannelEcntResetSetting = SEL0_ECNT_IN_WRAP_AROUND_MODE
                TimChannelEnable = false
                TimChannelExtCaptureModeEnable = false
                TimChannelExtCaptureSrc = SEL0_NEW_VAL_IRQ
                TimChannelGpr0InputSelect = TIMEBASE_TBU_TS0
                TimChannelGpr1InputSelect = TIMEBASE_TBU_TS0
                TimChannelInputSelect = INPUT_OF_CURRENT_TIM_CHANNEL
                TimChannelModeSelect = PWM_MEASUREMENT_MODE_TPWM
                TimChannelOneShotMode = false
                TimChannelPortPinSelect = NONE_SEL0
                TimChannelSignalEdgeSelect = FALLING_EDGE
                TimChannelTbu0Ts0BitsSelect = BITS_0_TO_23
                TimChannelUsage = USED_BY_OTHER_DRIVERS_OR_UNUSED
                TimChannelValInitSignal = VAL_LOW
              TimChannelInterrupt:
                TimInterruptEnableOnCntOfl = false
                TimInterruptEnableOnEcntOfl = false
                TimInterruptEnableOnGlitchDet = false
                TimInterruptEnableOnGprxOfl = false
                TimInterruptEnableOnNewVal = false
                TimInterruptEnableOnToDet = false
                TimInterruptMode = GTM_INTERRUPT_LEVEL_MODE
                TimNotification = NULL_PTR
              TimChannelTimeoutDetection: TimChTimeoutClockSelect=GTM_CONFIGURABLE_CLOCK_0, TimChTimeoutDetectionEnable=SEL0_TIMOUT_DISABLED, TimChTimeoutDuration=0
            TimChannel_5
              TimChannelErrorInterrupt:
                TimInterruptEnableOnCntOflErr = false
                TimInterruptEnableOnEcntOflErr = false
                TimInterruptEnableOnGlitchDetErr = false
                TimInterruptEnableOnGprxOflErr = false
                TimInterruptEnableOnNewValErr = false
                TimInterruptEnableOnToDetErr = false
              TimChannelFilterConfig:
                TimChFilterCounterFreqSelect = GTM_CONFIGURABLE_CLOCK_0
                TimChFilterModeForFallingEdge = IMMEDIATE_EDGE_PROPAGATION_MODE
                TimChFilterModeForRisingEdge = IMMEDIATE_EDGE_PROPAGATION_MODE
                TimChFilterTimeForFallingEdge = 0
                TimChFilterTimeForRisingEdge = 0
                TimChannelFilterEnable = false
              TimChannelGeneral:
                TimChannelClockSelect = GTM_CONFIGURABLE_CLOCK_0
                TimChannelCntsInputSelect = CNT_VALUE
                TimChannelCntsValue = 0
                TimChannelEcntOvflwSetting = SEL0_OVRFLOW_SIG_ON_ECNT_BITWIDTH_8
                TimChannelEcntResetSetting = SEL0_ECNT_IN_WRAP_AROUND_MODE
                TimChannelEnable = false
                TimChannelExtCaptureModeEnable = false
                TimChannelExtCaptureSrc = SEL0_NEW_VAL_IRQ
                TimChannelGpr0InputSelect = TIMEBASE_TBU_TS0
                TimChannelGpr1InputSelect = TIMEBASE_TBU_TS0
                TimChannelInputSelect = INPUT_OF_CURRENT_TIM_CHANNEL
                TimChannelModeSelect = PWM_MEASUREMENT_MODE_TPWM
                TimChannelOneShotMode = false
                TimChannelPortPinSelect = NONE_SEL0
                TimChannelSignalEdgeSelect = FALLING_EDGE
                TimChannelTbu0Ts0BitsSelect = BITS_0_TO_23
                TimChannelUsage = USED_BY_OTHER_DRIVERS_OR_UNUSED
                TimChannelValInitSignal = VAL_LOW
              TimChannelInterrupt:
                TimInterruptEnableOnCntOfl = false
                TimInterruptEnableOnEcntOfl = false
                TimInterruptEnableOnGlitchDet = false
                TimInterruptEnableOnGprxOfl = false
                TimInterruptEnableOnNewVal = false
                TimInterruptEnableOnToDet = false
                TimInterruptMode = GTM_INTERRUPT_LEVEL_MODE
                TimNotification = NULL_PTR
              TimChannelTimeoutDetection: TimChTimeoutClockSelect=GTM_CONFIGURABLE_CLOCK_0, TimChTimeoutDetectionEnable=SEL0_TIMOUT_DISABLED, TimChTimeoutDuration=0
            TimChannel_6
              TimChannelErrorInterrupt:
                TimInterruptEnableOnCntOflErr = false
                TimInterruptEnableOnEcntOflErr = false
                TimInterruptEnableOnGlitchDetErr = false
                TimInterruptEnableOnGprxOflErr = false
                TimInterruptEnableOnNewValErr = false
                TimInterruptEnableOnToDetErr = false
              TimChannelFilterConfig:
                TimChFilterCounterFreqSelect = GTM_CONFIGURABLE_CLOCK_0
                TimChFilterModeForFallingEdge = IMMEDIATE_EDGE_PROPAGATION_MODE
                TimChFilterModeForRisingEdge = IMMEDIATE_EDGE_PROPAGATION_MODE
                TimChFilterTimeForFallingEdge = 0
                TimChFilterTimeForRisingEdge = 0
                TimChannelFilterEnable = false
              TimChannelGeneral:
                TimChannelClockSelect = GTM_CONFIGURABLE_CLOCK_0
                TimChannelCntsInputSelect = CNT_VALUE
                TimChannelCntsValue = 0
                TimChannelEcntOvflwSetting = SEL0_OVRFLOW_SIG_ON_ECNT_BITWIDTH_8
                TimChannelEcntResetSetting = SEL0_ECNT_IN_WRAP_AROUND_MODE
                TimChannelEnable = false
                TimChannelExtCaptureModeEnable = false
                TimChannelExtCaptureSrc = SEL0_NEW_VAL_IRQ
                TimChannelGpr0InputSelect = TIMEBASE_TBU_TS0
                TimChannelGpr1InputSelect = TIMEBASE_TBU_TS0
                TimChannelInputSelect = INPUT_OF_CURRENT_TIM_CHANNEL
                TimChannelModeSelect = PWM_MEASUREMENT_MODE_TPWM
                TimChannelOneShotMode = false
                TimChannelPortPinSelect = NONE_SEL0
                TimChannelSignalEdgeSelect = FALLING_EDGE
                TimChannelTbu0Ts0BitsSelect = BITS_0_TO_23
                TimChannelUsage = USED_BY_OTHER_DRIVERS_OR_UNUSED
                TimChannelValInitSignal = VAL_LOW
              TimChannelInterrupt:
                TimInterruptEnableOnCntOfl = false
                TimInterruptEnableOnEcntOfl = false
                TimInterruptEnableOnGlitchDet = false
                TimInterruptEnableOnGprxOfl = false
                TimInterruptEnableOnNewVal = false
                TimInterruptEnableOnToDet = false
                TimInterruptMode = GTM_INTERRUPT_LEVEL_MODE
                TimNotification = NULL_PTR
              TimChannelTimeoutDetection: TimChTimeoutClockSelect=GTM_CONFIGURABLE_CLOCK_0, TimChTimeoutDetectionEnable=SEL0_TIMOUT_DISABLED, TimChTimeoutDuration=0
            TimChannel_7
              TimChannelErrorInterrupt:
                TimInterruptEnableOnCntOflErr = false
                TimInterruptEnableOnEcntOflErr = false
                TimInterruptEnableOnGlitchDetErr = false
                TimInterruptEnableOnGprxOflErr = false
                TimInterruptEnableOnNewValErr = false
                TimInterruptEnableOnToDetErr = false
              TimChannelFilterConfig:
                TimChFilterCounterFreqSelect = GTM_CONFIGURABLE_CLOCK_0
                TimChFilterModeForFallingEdge = IMMEDIATE_EDGE_PROPAGATION_MODE
                TimChFilterModeForRisingEdge = IMMEDIATE_EDGE_PROPAGATION_MODE
                TimChFilterTimeForFallingEdge = 0
                TimChFilterTimeForRisingEdge = 0
                TimChannelFilterEnable = false
              TimChannelGeneral:
                TimChannelClockSelect = GTM_CONFIGURABLE_CLOCK_0
                TimChannelCntsInputSelect = CNT_VALUE
                TimChannelCntsValue = 0
                TimChannelEcntOvflwSetting = SEL0_OVRFLOW_SIG_ON_ECNT_BITWIDTH_8
                TimChannelEcntResetSetting = SEL0_ECNT_IN_WRAP_AROUND_MODE
                TimChannelEnable = false
                TimChannelExtCaptureModeEnable = false
                TimChannelExtCaptureSrc = SEL0_NEW_VAL_IRQ
                TimChannelGpr0InputSelect = TIMEBASE_TBU_TS0
                TimChannelGpr1InputSelect = TIMEBASE_TBU_TS0
                TimChannelInputSelect = INPUT_OF_CURRENT_TIM_CHANNEL
                TimChannelModeSelect = PWM_MEASUREMENT_MODE_TPWM
                TimChannelOneShotMode = false
                TimChannelPortPinSelect = NONE_SEL0
                TimChannelSignalEdgeSelect = FALLING_EDGE
                TimChannelTbu0Ts0BitsSelect = BITS_0_TO_23
                TimChannelUsage = USED_BY_OTHER_DRIVERS_OR_UNUSED
                TimChannelValInitSignal = VAL_LOW
              TimChannelInterrupt:
                TimInterruptEnableOnCntOfl = false
                TimInterruptEnableOnEcntOfl = false
                TimInterruptEnableOnGlitchDet = false
                TimInterruptEnableOnGprxOfl = false
                TimInterruptEnableOnNewVal = false
                TimInterruptEnableOnToDet = false
                TimInterruptMode = GTM_INTERRUPT_LEVEL_MODE
                TimNotification = NULL_PTR
              TimChannelTimeoutDetection: TimChTimeoutClockSelect=GTM_CONFIGURABLE_CLOCK_0, TimChTimeoutDetectionEnable=SEL0_TIMOUT_DISABLED, TimChTimeoutDuration=0
        Tom_0 (Tom)
          16 x TomChannel:
            TomChannel_0
              TomChannelEnable: TomChDisableOnTgcTrigger=false, TomChannelEnable=AT_START
              TomChannelInterrupt: TomIntEnableOnDutyCycleMatchCcu1=false, TomIntEnableOnPeriodMatchCcu0=false, TomInterruptMode=GTM_INTERRUPT_LEVEL_MODE, TomNotification=NULL_PTR
              TomChannelOutput:
                TomChOutputDisableOnTgcTrig = false
                TomChannelOutputControl = DONT_ENABLE_CHANNEL_OUTPUT
                TomChannelOutputSignalLevel = LOW
                TomChannelPortPinSelect = TOUT18_SELA_PORT0_PIN9
              TomChannelTimerParameters:
                TomChDCycCompareShadowValSr1 = 0
                TomChEnableForceUpdate = false
                TomChPeriodCompareShadowValSr0 = 0
                TomChResetCn0OnForceUpdate = false
                TomChUpdateEnableOnCn0Reset = false
                TomChannelBitReversalMode = false
                TomChannelClockSelect = GTM_FIXED_CLOCK_0
                TomChannelCounterCn0Reset = ON_COMPARE_MATCH_ON_CHANNEL
                TomChannelCounterValCn0 = 0
                TomChannelDutyCycleCompareValCm1 = 0
                TomChannelExtCounterCn0Reset = TRIG_ON_PREV_COMPARE_MATCH
                TomChannelExtTriggerOutput = EXT_TRIG_FROM_PREVIOUS_CHANNEL
                TomChannelOneShotMode = false
                TomChannelPeriodCompareValCm0 = 0
                TomChannelTrigOneShotMode = false
                TomChannelTriggerOutput = TRIG_FROM_PREVIOUS_CHANNEL
              TomChannelUsage: TomChannelUsage=USED_BY_OTHER_DRIVERS_OR_UNUSED
            TomChannel_1
              TomChannelEnable: TomChDisableOnTgcTrigger=false, TomChannelEnable=AT_START
              TomChannelInterrupt: TomIntEnableOnDutyCycleMatchCcu1=false, TomIntEnableOnPeriodMatchCcu0=false, TomInterruptMode=GTM_INTERRUPT_LEVEL_MODE, TomNotification=NULL_PTR
              TomChannelOutput:
                TomChOutputDisableOnTgcTrig = false
                TomChannelOutputControl = DONT_ENABLE_CHANNEL_OUTPUT
                TomChannelOutputSignalLevel = LOW
                TomChannelPortPinSelect = TOUT103_SELA_PORT10_PIN1
              TomChannelTimerParameters:
                TomChDCycCompareShadowValSr1 = 0
                TomChEnableForceUpdate = false
                TomChPeriodCompareShadowValSr0 = 0
                TomChResetCn0OnForceUpdate = false
                TomChUpdateEnableOnCn0Reset = false
                TomChannelBitReversalMode = false
                TomChannelClockSelect = GTM_FIXED_CLOCK_0
                TomChannelCounterCn0Reset = ON_COMPARE_MATCH_ON_CHANNEL
                TomChannelCounterValCn0 = 0
                TomChannelDutyCycleCompareValCm1 = 0
                TomChannelExtCounterCn0Reset = TRIG_ON_PREV_COMPARE_MATCH
                TomChannelExtTriggerOutput = EXT_TRIG_FROM_PREVIOUS_CHANNEL
                TomChannelOneShotMode = false
                TomChannelPeriodCompareValCm0 = 0
                TomChannelTrigOneShotMode = false
                TomChannelTriggerOutput = TRIG_FROM_PREVIOUS_CHANNEL
              TomChannelUsage: TomChannelUsage=USED_BY_OTHER_DRIVERS_OR_UNUSED
            TomChannel_10
              TomChannelEnable: TomChDisableOnTgcTrigger=false, TomChannelEnable=AT_START
              TomChannelInterrupt: TomIntEnableOnDutyCycleMatchCcu1=false, TomIntEnableOnPeriodMatchCcu0=false, TomInterruptMode=GTM_INTERRUPT_LEVEL_MODE, TomNotification=NULL_PTR
              TomChannelOutput:
                TomChOutputDisableOnTgcTrig = false
                TomChannelOutputControl = DONT_ENABLE_CHANNEL_OUTPUT
                TomChannelOutputSignalLevel = LOW
                TomChannelPortPinSelect = TOUT12_SELA_PORT0_PIN3
              TomChannelTimerParameters:
                TomChDCycCompareShadowValSr1 = 0
                TomChEnableForceUpdate = false
                TomChPeriodCompareShadowValSr0 = 0
                TomChResetCn0OnForceUpdate = false
                TomChUpdateEnableOnCn0Reset = false
                TomChannelBitReversalMode = false
                TomChannelClockSelect = GTM_FIXED_CLOCK_0
                TomChannelCounterCn0Reset = ON_COMPARE_MATCH_ON_CHANNEL
                TomChannelCounterValCn0 = 0
                TomChannelDutyCycleCompareValCm1 = 0
                TomChannelExtCounterCn0Reset = TRIG_ON_PREV_COMPARE_MATCH
                TomChannelExtTriggerOutput = EXT_TRIG_FROM_PREVIOUS_CHANNEL
                TomChannelOneShotMode = false
                TomChannelPeriodCompareValCm0 = 0
                TomChannelTrigOneShotMode = false
                TomChannelTriggerOutput = TRIG_FROM_PREVIOUS_CHANNEL
              TomChannelUsage: TomChannelUsage=USED_BY_OTHER_DRIVERS_OR_UNUSED
            TomChannel_11
              TomChannelEnable: TomChDisableOnTgcTrigger=false, TomChannelEnable=AT_START
              TomChannelInterrupt: TomIntEnableOnDutyCycleMatchCcu1=false, TomIntEnableOnPeriodMatchCcu0=false, TomInterruptMode=GTM_INTERRUPT_LEVEL_MODE, TomNotification=NULL_PTR
              TomChannelOutput:
                TomChOutputDisableOnTgcTrig = false
                TomChannelOutputControl = DONT_ENABLE_CHANNEL_OUTPUT
                TomChannelOutputSignalLevel = LOW
                TomChannelPortPinSelect = TOUT13_SELA_PORT0_PIN4
              TomChannelTimerParameters:
                TomChDCycCompareShadowValSr1 = 0
                TomChEnableForceUpdate = false
                TomChPeriodCompareShadowValSr0 = 0
                TomChResetCn0OnForceUpdate = false
                TomChUpdateEnableOnCn0Reset = false
                TomChannelBitReversalMode = false
                TomChannelClockSelect = GTM_FIXED_CLOCK_0
                TomChannelCounterCn0Reset = ON_COMPARE_MATCH_ON_CHANNEL
                TomChannelCounterValCn0 = 0
                TomChannelDutyCycleCompareValCm1 = 0
                TomChannelExtCounterCn0Reset = TRIG_ON_PREV_COMPARE_MATCH
                TomChannelExtTriggerOutput = EXT_TRIG_FROM_PREVIOUS_CHANNEL
                TomChannelOneShotMode = false
                TomChannelPeriodCompareValCm0 = 0
                TomChannelTrigOneShotMode = false
                TomChannelTriggerOutput = TRIG_FROM_PREVIOUS_CHANNEL
              TomChannelUsage: TomChannelUsage=USED_BY_OTHER_DRIVERS_OR_UNUSED
            TomChannel_12
              TomChannelEnable: TomChDisableOnTgcTrigger=false, TomChannelEnable=AT_START
              TomChannelInterrupt: TomIntEnableOnDutyCycleMatchCcu1=false, TomIntEnableOnPeriodMatchCcu0=false, TomInterruptMode=GTM_INTERRUPT_LEVEL_MODE, TomNotification=NULL_PTR
              TomChannelOutput:
                TomChOutputDisableOnTgcTrig = false
                TomChannelOutputControl = DONT_ENABLE_CHANNEL_OUTPUT
                TomChannelOutputSignalLevel = LOW
                TomChannelPortPinSelect = TOUT14_SELA_PORT0_PIN5
              TomChannelTimerParameters:
                TomChDCycCompareShadowValSr1 = 0
                TomChEnableForceUpdate = false
                TomChPeriodCompareShadowValSr0 = 0
                TomChResetCn0OnForceUpdate = false
                TomChUpdateEnableOnCn0Reset = false
                TomChannelBitReversalMode = false
                TomChannelClockSelect = GTM_FIXED_CLOCK_0
                TomChannelCounterCn0Reset = ON_COMPARE_MATCH_ON_CHANNEL
                TomChannelCounterValCn0 = 0
                TomChannelDutyCycleCompareValCm1 = 0
                TomChannelExtCounterCn0Reset = TRIG_ON_PREV_COMPARE_MATCH
                TomChannelExtTriggerOutput = EXT_TRIG_FROM_PREVIOUS_CHANNEL
                TomChannelOneShotMode = false
                TomChannelPeriodCompareValCm0 = 0
                TomChannelTrigOneShotMode = false
                TomChannelTriggerOutput = TRIG_FROM_PREVIOUS_CHANNEL
              TomChannelUsage: TomChannelUsage=USED_BY_OTHER_DRIVERS_OR_UNUSED
            TomChannel_13
              TomChannelEnable: TomChDisableOnTgcTrigger=false, TomChannelEnable=AT_START
              TomChannelInterrupt: TomIntEnableOnDutyCycleMatchCcu1=false, TomIntEnableOnPeriodMatchCcu0=false, TomInterruptMode=GTM_INTERRUPT_LEVEL_MODE, TomNotification=NULL_PTR
              TomChannelOutput:
                TomChOutputDisableOnTgcTrig = false
                TomChannelOutputControl = DONT_ENABLE_CHANNEL_OUTPUT
                TomChannelOutputSignalLevel = LOW
                TomChannelPortPinSelect = TOUT15_SELA_PORT0_PIN6
              TomChannelTimerParameters:
                TomChDCycCompareShadowValSr1 = 0
                TomChEnableForceUpdate = false
                TomChPeriodCompareShadowValSr0 = 0
                TomChResetCn0OnForceUpdate = false
                TomChUpdateEnableOnCn0Reset = false
                TomChannelBitReversalMode = false
                TomChannelClockSelect = GTM_FIXED_CLOCK_0
                TomChannelCounterCn0Reset = ON_COMPARE_MATCH_ON_CHANNEL
                TomChannelCounterValCn0 = 0
                TomChannelDutyCycleCompareValCm1 = 0
                TomChannelExtCounterCn0Reset = TRIG_ON_PREV_COMPARE_MATCH
                TomChannelExtTriggerOutput = EXT_TRIG_FROM_PREVIOUS_CHANNEL
                TomChannelOneShotMode = false
                TomChannelPeriodCompareValCm0 = 0
                TomChannelTrigOneShotMode = false
                TomChannelTriggerOutput = TRIG_FROM_PREVIOUS_CHANNEL
              TomChannelUsage: TomChannelUsage=USED_BY_OTHER_DRIVERS_OR_UNUSED
            TomChannel_14
              TomChannelEnable: TomChDisableOnTgcTrigger=false, TomChannelEnable=AT_START
              TomChannelInterrupt: TomIntEnableOnDutyCycleMatchCcu1=false, TomIntEnableOnPeriodMatchCcu0=false, TomInterruptMode=GTM_INTERRUPT_LEVEL_MODE, TomNotification=NULL_PTR
              TomChannelOutput:
                TomChOutputDisableOnTgcTrig = false
                TomChannelOutputControl = DONT_ENABLE_CHANNEL_OUTPUT
                TomChannelOutputSignalLevel = LOW
                TomChannelPortPinSelect = TOUT16_SELA_PORT0_PIN7
              TomChannelTimerParameters:
                TomChDCycCompareShadowValSr1 = 0
                TomChEnableForceUpdate = false
                TomChPeriodCompareShadowValSr0 = 0
                TomChResetCn0OnForceUpdate = false
                TomChUpdateEnableOnCn0Reset = false
                TomChannelBitReversalMode = false
                TomChannelClockSelect = GTM_FIXED_CLOCK_0
                TomChannelCounterCn0Reset = ON_COMPARE_MATCH_ON_CHANNEL
                TomChannelCounterValCn0 = 0
                TomChannelDutyCycleCompareValCm1 = 0
                TomChannelExtCounterCn0Reset = TRIG_ON_PREV_COMPARE_MATCH
                TomChannelExtTriggerOutput = EXT_TRIG_FROM_PREVIOUS_CHANNEL
                TomChannelOneShotMode = false
                TomChannelPeriodCompareValCm0 = 0
                TomChannelTrigOneShotMode = false
                TomChannelTriggerOutput = TRIG_FROM_PREVIOUS_CHANNEL
              TomChannelUsage: TomChannelUsage=USED_BY_OTHER_DRIVERS_OR_UNUSED
            TomChannel_15
              TomChannelEnable: TomChDisableOnTgcTrigger=false, TomChannelEnable=AT_START
              TomChannelInterrupt: TomIntEnableOnDutyCycleMatchCcu1=false, TomIntEnableOnPeriodMatchCcu0=false, TomInterruptMode=GTM_INTERRUPT_LEVEL_MODE, TomNotification=NULL_PTR
              TomChannelOutput:
                TomChOutputDisableOnTgcTrig = false
                TomChannelOutputControl = DONT_ENABLE_CHANNEL_OUTPUT
                TomChannelOutputSignalLevel = LOW
                TomChannelPortPinSelect = TOUT17_SELA_PORT0_PIN8
              TomChannelTimerParameters:
                TomChDCycCompareShadowValSr1 = 0
                TomChEnableForceUpdate = false
                TomChPeriodCompareShadowValSr0 = 0
                TomChResetCn0OnForceUpdate = false
                TomChUpdateEnableOnCn0Reset = false
                TomChannelBitReversalMode = false
                TomChannelClockSelect = GTM_FIXED_CLOCK_0
                TomChannelCounterCn0Reset = ON_COMPARE_MATCH_ON_CHANNEL
                TomChannelCounterValCn0 = 0
                TomChannelDutyCycleCompareValCm1 = 0
                TomChannelExtCounterCn0Reset = TRIG_ON_PREV_COMPARE_MATCH
                TomChannelExtTriggerOutput = EXT_TRIG_FROM_PREVIOUS_CHANNEL
                TomChannelOneShotMode = false
                TomChannelPeriodCompareValCm0 = 0
                TomChannelTrigOneShotMode = false
                TomChannelTriggerOutput = TRIG_FROM_PREVIOUS_CHANNEL
              TomChannelUsage: TomChannelUsage=USED_BY_OTHER_DRIVERS_OR_UNUSED
            TomChannel_2
              TomChannelEnable: TomChDisableOnTgcTrigger=false, TomChannelEnable=AT_START
              TomChannelInterrupt: TomIntEnableOnDutyCycleMatchCcu1=false, TomIntEnableOnPeriodMatchCcu0=false, TomInterruptMode=GTM_INTERRUPT_LEVEL_MODE, TomNotification=NULL_PTR
              TomChannelOutput:
                TomChOutputDisableOnTgcTrig = false
                TomChannelOutputControl = DONT_ENABLE_CHANNEL_OUTPUT
                TomChannelOutputSignalLevel = LOW
                TomChannelPortPinSelect = TOUT104_SELA_PORT10_PIN2
              TomChannelTimerParameters:
                TomChDCycCompareShadowValSr1 = 0
                TomChEnableForceUpdate = false
                TomChPeriodCompareShadowValSr0 = 0
                TomChResetCn0OnForceUpdate = false
                TomChUpdateEnableOnCn0Reset = false
                TomChannelBitReversalMode = false
                TomChannelClockSelect = GTM_FIXED_CLOCK_0
                TomChannelCounterCn0Reset = ON_COMPARE_MATCH_ON_CHANNEL
                TomChannelCounterValCn0 = 0
                TomChannelDutyCycleCompareValCm1 = 0
                TomChannelExtCounterCn0Reset = TRIG_ON_PREV_COMPARE_MATCH
                TomChannelExtTriggerOutput = EXT_TRIG_FROM_PREVIOUS_CHANNEL
                TomChannelOneShotMode = false
                TomChannelPeriodCompareValCm0 = 0
                TomChannelTrigOneShotMode = false
                TomChannelTriggerOutput = TRIG_FROM_PREVIOUS_CHANNEL
              TomChannelUsage: TomChannelUsage=USED_BY_OTHER_DRIVERS_OR_UNUSED
            TomChannel_3
              TomChannelEnable: TomChDisableOnTgcTrigger=false, TomChannelEnable=AT_START
              TomChannelInterrupt: TomIntEnableOnDutyCycleMatchCcu1=false, TomIntEnableOnPeriodMatchCcu0=false, TomInterruptMode=GTM_INTERRUPT_LEVEL_MODE, TomNotification=NULL_PTR
              TomChannelOutput:
                TomChOutputDisableOnTgcTrig = false
                TomChannelOutputControl = DONT_ENABLE_CHANNEL_OUTPUT
                TomChannelOutputSignalLevel = LOW
                TomChannelPortPinSelect = TOUT21_SELA_PORT0_PIN12
              TomChannelTimerParameters:
                TomChDCycCompareShadowValSr1 = 0
                TomChEnableForceUpdate = false
                TomChPeriodCompareShadowValSr0 = 0
                TomChResetCn0OnForceUpdate = false
                TomChUpdateEnableOnCn0Reset = false
                TomChannelBitReversalMode = false
                TomChannelClockSelect = GTM_FIXED_CLOCK_0
                TomChannelCounterCn0Reset = ON_COMPARE_MATCH_ON_CHANNEL
                TomChannelCounterValCn0 = 0
                TomChannelDutyCycleCompareValCm1 = 0
                TomChannelExtCounterCn0Reset = TRIG_ON_PREV_COMPARE_MATCH
                TomChannelExtTriggerOutput = EXT_TRIG_FROM_PREVIOUS_CHANNEL
                TomChannelOneShotMode = false
                TomChannelPeriodCompareValCm0 = 0
                TomChannelTrigOneShotMode = false
                TomChannelTriggerOutput = TRIG_FROM_PREVIOUS_CHANNEL
              TomChannelUsage: TomChannelUsage=USED_BY_OTHER_DRIVERS_OR_UNUSED
            TomChannel_4
              TomChannelEnable: TomChDisableOnTgcTrigger=false, TomChannelEnable=AT_START
              TomChannelInterrupt: TomIntEnableOnDutyCycleMatchCcu1=false, TomIntEnableOnPeriodMatchCcu0=false, TomInterruptMode=GTM_INTERRUPT_LEVEL_MODE, TomNotification=NULL_PTR
              TomChannelOutput:
                TomChOutputDisableOnTgcTrig = false
                TomChannelOutputControl = DONT_ENABLE_CHANNEL_OUTPUT
                TomChannelOutputSignalLevel = LOW
                TomChannelPortPinSelect = TOUT81_SELA_PORT14_PIN1
              TomChannelTimerParameters:
                TomChDCycCompareShadowValSr1 = 0
                TomChEnableForceUpdate = false
                TomChPeriodCompareShadowValSr0 = 0
                TomChResetCn0OnForceUpdate = false
                TomChUpdateEnableOnCn0Reset = false
                TomChannelBitReversalMode = false
                TomChannelClockSelect = GTM_FIXED_CLOCK_0
                TomChannelCounterCn0Reset = ON_COMPARE_MATCH_ON_CHANNEL
                TomChannelCounterValCn0 = 0
                TomChannelDutyCycleCompareValCm1 = 0
                TomChannelExtCounterCn0Reset = TRIG_ON_PREV_COMPARE_MATCH
                TomChannelExtTriggerOutput = EXT_TRIG_FROM_PREVIOUS_CHANNEL
                TomChannelOneShotMode = false
                TomChannelPeriodCompareValCm0 = 0
                TomChannelTrigOneShotMode = false
                TomChannelTriggerOutput = TRIG_FROM_PREVIOUS_CHANNEL
              TomChannelUsage: TomChannelUsage=USED_BY_OTHER_DRIVERS_OR_UNUSED
            TomChannel_5
              TomChannelEnable: TomChDisableOnTgcTrigger=false, TomChannelEnable=AT_START
              TomChannelInterrupt: TomIntEnableOnDutyCycleMatchCcu1=false, TomIntEnableOnPeriodMatchCcu0=false, TomInterruptMode=GTM_INTERRUPT_LEVEL_MODE, TomNotification=NULL_PTR
              TomChannelOutput:
                TomChOutputDisableOnTgcTrig = false
                TomChannelOutputControl = DONT_ENABLE_CHANNEL_OUTPUT
                TomChannelOutputSignalLevel = LOW
                TomChannelPortPinSelect = TOUT91_SELA_PORT13_PIN0
              TomChannelTimerParameters:
                TomChDCycCompareShadowValSr1 = 0
                TomChEnableForceUpdate = false
                TomChPeriodCompareShadowValSr0 = 0
                TomChResetCn0OnForceUpdate = false
                TomChUpdateEnableOnCn0Reset = false
                TomChannelBitReversalMode = false
                TomChannelClockSelect = GTM_FIXED_CLOCK_0
                TomChannelCounterCn0Reset = ON_COMPARE_MATCH_ON_CHANNEL
                TomChannelCounterValCn0 = 0
                TomChannelDutyCycleCompareValCm1 = 0
                TomChannelExtCounterCn0Reset = TRIG_ON_PREV_COMPARE_MATCH
                TomChannelExtTriggerOutput = EXT_TRIG_FROM_PREVIOUS_CHANNEL
                TomChannelOneShotMode = false
                TomChannelPeriodCompareValCm0 = 0
                TomChannelTrigOneShotMode = false
                TomChannelTriggerOutput = TRIG_FROM_PREVIOUS_CHANNEL
              TomChannelUsage: TomChannelUsage=USED_BY_OTHER_DRIVERS_OR_UNUSED
            TomChannel_6
              TomChannelEnable: TomChDisableOnTgcTrigger=false, TomChannelEnable=AT_START
              TomChannelInterrupt: TomIntEnableOnDutyCycleMatchCcu1=false, TomIntEnableOnPeriodMatchCcu0=false, TomInterruptMode=GTM_INTERRUPT_LEVEL_MODE, TomNotification=NULL_PTR
              TomChannelOutput:
                TomChOutputDisableOnTgcTrig = false
                TomChannelOutputControl = DONT_ENABLE_CHANNEL_OUTPUT
                TomChannelOutputSignalLevel = LOW
                TomChannelPortPinSelect = TOUT92_SELA_PORT13_PIN1
              TomChannelTimerParameters:
                TomChDCycCompareShadowValSr1 = 0
                TomChEnableForceUpdate = false
                TomChPeriodCompareShadowValSr0 = 0
                TomChResetCn0OnForceUpdate = false
                TomChUpdateEnableOnCn0Reset = false
                TomChannelBitReversalMode = false
                TomChannelClockSelect = GTM_FIXED_CLOCK_0
                TomChannelCounterCn0Reset = ON_COMPARE_MATCH_ON_CHANNEL
                TomChannelCounterValCn0 = 0
                TomChannelDutyCycleCompareValCm1 = 0
                TomChannelExtCounterCn0Reset = TRIG_ON_PREV_COMPARE_MATCH
                TomChannelExtTriggerOutput = EXT_TRIG_FROM_PREVIOUS_CHANNEL
                TomChannelOneShotMode = false
                TomChannelPeriodCompareValCm0 = 0
                TomChannelTrigOneShotMode = false
                TomChannelTriggerOutput = TRIG_FROM_PREVIOUS_CHANNEL
              TomChannelUsage: TomChannelUsage=USED_BY_OTHER_DRIVERS_OR_UNUSED
            TomChannel_7
              TomChannelEnable: TomChDisableOnTgcTrigger=false, TomChannelEnable=AT_START
              TomChannelInterrupt: TomIntEnableOnDutyCycleMatchCcu1=false, TomIntEnableOnPeriodMatchCcu0=false, TomInterruptMode=GTM_INTERRUPT_LEVEL_MODE, TomNotification=NULL_PTR
              TomChannelOutput:
                TomChOutputDisableOnTgcTrig = false
                TomChannelOutputControl = DONT_ENABLE_CHANNEL_OUTPUT
                TomChannelOutputSignalLevel = LOW
                TomChannelPortPinSelect = TOUT93_SELA_PORT13_PIN2
              TomChannelTimerParameters:
                TomChDCycCompareShadowValSr1 = 0
                TomChEnableForceUpdate = false
                TomChPeriodCompareShadowValSr0 = 0
                TomChResetCn0OnForceUpdate = false
                TomChUpdateEnableOnCn0Reset = false
                TomChannelBitReversalMode = false
                TomChannelClockSelect = GTM_FIXED_CLOCK_0
                TomChannelCounterCn0Reset = ON_COMPARE_MATCH_ON_CHANNEL
                TomChannelCounterValCn0 = 0
                TomChannelDutyCycleCompareValCm1 = 0
                TomChannelExtCounterCn0Reset = TRIG_ON_PREV_COMPARE_MATCH
                TomChannelExtTriggerOutput = EXT_TRIG_FROM_PREVIOUS_CHANNEL
                TomChannelOneShotMode = false
                TomChannelPeriodCompareValCm0 = 0
                TomChannelTrigOneShotMode = false
                TomChannelTriggerOutput = TRIG_FROM_PREVIOUS_CHANNEL
              TomChannelUsage: TomChannelUsage=USED_BY_OTHER_DRIVERS_OR_UNUSED
            TomChannel_8
              TomChannelEnable: TomChDisableOnTgcTrigger=false, TomChannelEnable=AT_START
              TomChannelInterrupt: TomIntEnableOnDutyCycleMatchCcu1=false, TomIntEnableOnPeriodMatchCcu0=false, TomInterruptMode=GTM_INTERRUPT_LEVEL_MODE, TomNotification=NULL_PTR
              TomChannelOutput:
                TomChOutputDisableOnTgcTrig = false
                TomChannelOutputControl = DONT_ENABLE_CHANNEL_OUTPUT
                TomChannelOutputSignalLevel = LOW
                TomChannelPortPinSelect = TOUT9_SELA_PORT0_PIN0
              TomChannelTimerParameters:
                TomChDCycCompareShadowValSr1 = 0
                TomChEnableForceUpdate = false
                TomChPeriodCompareShadowValSr0 = 0
                TomChResetCn0OnForceUpdate = false
                TomChUpdateEnableOnCn0Reset = false
                TomChannelBitReversalMode = false
                TomChannelClockSelect = GTM_FIXED_CLOCK_0
                TomChannelCounterCn0Reset = ON_COMPARE_MATCH_ON_CHANNEL
                TomChannelCounterValCn0 = 0
                TomChannelDutyCycleCompareValCm1 = 0
                TomChannelExtCounterCn0Reset = TRIG_ON_PREV_COMPARE_MATCH
                TomChannelExtTriggerOutput = EXT_TRIG_FROM_PREVIOUS_CHANNEL
                TomChannelOneShotMode = false
                TomChannelPeriodCompareValCm0 = 0
                TomChannelTrigOneShotMode = false
                TomChannelTriggerOutput = TRIG_FROM_PREVIOUS_CHANNEL
              TomChannelUsage: TomChannelUsage=USED_BY_OTHER_DRIVERS_OR_UNUSED
            TomChannel_9
              TomChannelEnable: TomChDisableOnTgcTrigger=false, TomChannelEnable=AT_START
              TomChannelInterrupt: TomIntEnableOnDutyCycleMatchCcu1=false, TomIntEnableOnPeriodMatchCcu0=false, TomInterruptMode=GTM_INTERRUPT_LEVEL_MODE, TomNotification=NULL_PTR
              TomChannelOutput:
                TomChOutputDisableOnTgcTrig = false
                TomChannelOutputControl = DONT_ENABLE_CHANNEL_OUTPUT
                TomChannelOutputSignalLevel = LOW
                TomChannelPortPinSelect = TOUT10_SELA_PORT0_PIN1
              TomChannelTimerParameters:
                TomChDCycCompareShadowValSr1 = 0
                TomChEnableForceUpdate = false
                TomChPeriodCompareShadowValSr0 = 0
                TomChResetCn0OnForceUpdate = false
                TomChUpdateEnableOnCn0Reset = false
                TomChannelBitReversalMode = false
                TomChannelClockSelect = GTM_FIXED_CLOCK_0
                TomChannelCounterCn0Reset = ON_COMPARE_MATCH_ON_CHANNEL
                TomChannelCounterValCn0 = 0
                TomChannelDutyCycleCompareValCm1 = 0
                TomChannelExtCounterCn0Reset = TRIG_ON_PREV_COMPARE_MATCH
                TomChannelExtTriggerOutput = EXT_TRIG_FROM_PREVIOUS_CHANNEL
                TomChannelOneShotMode = false
                TomChannelPeriodCompareValCm0 = 0
                TomChannelTrigOneShotMode = false
                TomChannelTriggerOutput = TRIG_FROM_PREVIOUS_CHANNEL
              TomChannelUsage: TomChannelUsage=USED_BY_OTHER_DRIVERS_OR_UNUSED
          TomTriggersForTgc_0 (TomTriggersForTgc)
            TomTgcInternalTriggerSelect:
              TomTgcIntTriggerFromChannel{0..7} = false
            TomTgcTriggerByTimebase: TomTgcTbuTimebaseSelect=TBU_TS0_TIMEBASE, TomTgcTimeBaseTriggerEnable=false, TomTgcTimebaseMatchValue=0
          TomTriggersForTgc_1 (TomTriggersForTgc)
            TomTgcInternalTriggerSelect:
              TomTgcIntTriggerFromChannel{0..7} = false
            TomTgcTriggerByTimebase: TomTgcTbuTimebaseSelect=TBU_TS0_TIMEBASE, TomTgcTimeBaseTriggerEnable=false, TomTgcTimebaseMatchValue=0
        Tom_1 (Tom)
          16 x TomChannel:
            TomChannel_0
              TomChannelEnable: TomChDisableOnTgcTrigger=false, TomChannelEnable=AT_START
              TomChannelInterrupt: TomIntEnableOnDutyCycleMatchCcu1=false, TomIntEnableOnPeriodMatchCcu0=false, TomInterruptMode=GTM_INTERRUPT_LEVEL_MODE, TomNotification=NULL_PTR
              TomChannelOutput:
                TomChOutputDisableOnTgcTrig = false
                TomChannelOutputControl = DONT_ENABLE_CHANNEL_OUTPUT
                TomChannelOutputSignalLevel = LOW
                TomChannelPortPinSelect = TOUT9_SELB_PORT0_PIN0
              TomChannelTimerParameters:
                TomChDCycCompareShadowValSr1 = 0
                TomChEnableForceUpdate = false
                TomChPeriodCompareShadowValSr0 = 0
                TomChResetCn0OnForceUpdate = false
                TomChUpdateEnableOnCn0Reset = false
                TomChannelBitReversalMode = false
                TomChannelClockSelect = GTM_FIXED_CLOCK_0
                TomChannelCounterCn0Reset = ON_COMPARE_MATCH_ON_CHANNEL
                TomChannelCounterValCn0 = 0
                TomChannelDutyCycleCompareValCm1 = 0
                TomChannelExtCounterCn0Reset = TRIG_ON_PREV_COMPARE_MATCH
                TomChannelExtTriggerOutput = EXT_TRIG_FROM_PREVIOUS_CHANNEL
                TomChannelOneShotMode = false
                TomChannelPeriodCompareValCm0 = 0
                TomChannelTrigOneShotMode = false
                TomChannelTriggerOutput = TRIG_FROM_PREVIOUS_CHANNEL
              TomChannelUsage: TomChannelUsage=USED_BY_OTHER_DRIVERS_OR_UNUSED
            TomChannel_1
              TomChannelEnable: TomChDisableOnTgcTrigger=false, TomChannelEnable=AT_START
              TomChannelInterrupt: TomIntEnableOnDutyCycleMatchCcu1=false, TomIntEnableOnPeriodMatchCcu0=false, TomInterruptMode=GTM_INTERRUPT_LEVEL_MODE, TomNotification=NULL_PTR
              TomChannelOutput:
                TomChOutputDisableOnTgcTrig = false
                TomChannelOutputControl = DONT_ENABLE_CHANNEL_OUTPUT
                TomChannelOutputSignalLevel = LOW
                TomChannelPortPinSelect = TOUT10_SELB_PORT0_PIN1
              TomChannelTimerParameters:
                TomChDCycCompareShadowValSr1 = 0
                TomChEnableForceUpdate = false
                TomChPeriodCompareShadowValSr0 = 0
                TomChResetCn0OnForceUpdate = false
                TomChUpdateEnableOnCn0Reset = false
                TomChannelBitReversalMode = false
                TomChannelClockSelect = GTM_FIXED_CLOCK_0
                TomChannelCounterCn0Reset = ON_COMPARE_MATCH_ON_CHANNEL
                TomChannelCounterValCn0 = 0
                TomChannelDutyCycleCompareValCm1 = 0
                TomChannelExtCounterCn0Reset = TRIG_ON_PREV_COMPARE_MATCH
                TomChannelExtTriggerOutput = EXT_TRIG_FROM_PREVIOUS_CHANNEL
                TomChannelOneShotMode = false
                TomChannelPeriodCompareValCm0 = 0
                TomChannelTrigOneShotMode = false
                TomChannelTriggerOutput = TRIG_FROM_PREVIOUS_CHANNEL
              TomChannelUsage: TomChannelUsage=USED_BY_OTHER_DRIVERS_OR_UNUSED
            TomChannel_10
              TomChannelEnable: TomChDisableOnTgcTrigger=false, TomChannelEnable=AT_START
              TomChannelInterrupt: TomIntEnableOnDutyCycleMatchCcu1=false, TomIntEnableOnPeriodMatchCcu0=false, TomInterruptMode=GTM_INTERRUPT_LEVEL_MODE, TomNotification=NULL_PTR
              TomChannelOutput:
                TomChOutputDisableOnTgcTrig = false
                TomChannelOutputControl = DONT_ENABLE_CHANNEL_OUTPUT
                TomChannelOutputSignalLevel = LOW
                TomChannelPortPinSelect = TOUT2_SELB_PORT2_PIN2
              TomChannelTimerParameters:
                TomChDCycCompareShadowValSr1 = 0
                TomChEnableForceUpdate = false
                TomChPeriodCompareShadowValSr0 = 0
                TomChResetCn0OnForceUpdate = false
                TomChUpdateEnableOnCn0Reset = false
                TomChannelBitReversalMode = false
                TomChannelClockSelect = GTM_FIXED_CLOCK_0
                TomChannelCounterCn0Reset = ON_COMPARE_MATCH_ON_CHANNEL
                TomChannelCounterValCn0 = 0
                TomChannelDutyCycleCompareValCm1 = 0
                TomChannelExtCounterCn0Reset = TRIG_ON_PREV_COMPARE_MATCH
                TomChannelExtTriggerOutput = EXT_TRIG_FROM_PREVIOUS_CHANNEL
                TomChannelOneShotMode = false
                TomChannelPeriodCompareValCm0 = 0
                TomChannelTrigOneShotMode = false
                TomChannelTriggerOutput = TRIG_FROM_PREVIOUS_CHANNEL
              TomChannelUsage: TomChannelUsage=USED_BY_OTHER_DRIVERS_OR_UNUSED
            TomChannel_11
              TomChannelEnable: TomChDisableOnTgcTrigger=false, TomChannelEnable=AT_START
              TomChannelInterrupt: TomIntEnableOnDutyCycleMatchCcu1=false, TomIntEnableOnPeriodMatchCcu0=false, TomInterruptMode=GTM_INTERRUPT_LEVEL_MODE, TomNotification=NULL_PTR
              TomChannelOutput:
                TomChOutputDisableOnTgcTrig = false
                TomChannelOutputControl = DONT_ENABLE_CHANNEL_OUTPUT
                TomChannelOutputSignalLevel = LOW
                TomChannelPortPinSelect = TOUT3_SELB_PORT2_PIN3
              TomChannelTimerParameters:
                TomChDCycCompareShadowValSr1 = 0
                TomChEnableForceUpdate = false
                TomChPeriodCompareShadowValSr0 = 0
                TomChResetCn0OnForceUpdate = false
                TomChUpdateEnableOnCn0Reset = false
                TomChannelBitReversalMode = false
                TomChannelClockSelect = GTM_FIXED_CLOCK_0
                TomChannelCounterCn0Reset = ON_COMPARE_MATCH_ON_CHANNEL
                TomChannelCounterValCn0 = 0
                TomChannelDutyCycleCompareValCm1 = 0
                TomChannelExtCounterCn0Reset = TRIG_ON_PREV_COMPARE_MATCH
                TomChannelExtTriggerOutput = EXT_TRIG_FROM_PREVIOUS_CHANNEL
                TomChannelOneShotMode = false
                TomChannelPeriodCompareValCm0 = 0
                TomChannelTrigOneShotMode = false
                TomChannelTriggerOutput = TRIG_FROM_PREVIOUS_CHANNEL
              TomChannelUsage: TomChannelUsage=USED_BY_OTHER_DRIVERS_OR_UNUSED
            TomChannel_12
              TomChannelEnable: TomChDisableOnTgcTrigger=false, TomChannelEnable=AT_START
              TomChannelInterrupt: TomIntEnableOnDutyCycleMatchCcu1=false, TomIntEnableOnPeriodMatchCcu0=false, TomInterruptMode=GTM_INTERRUPT_LEVEL_MODE, TomNotification=NULL_PTR
              TomChannelOutput:
                TomChOutputDisableOnTgcTrig = false
                TomChannelOutputControl = DONT_ENABLE_CHANNEL_OUTPUT
                TomChannelOutputSignalLevel = LOW
                TomChannelPortPinSelect = TOUT4_SELB_PORT2_PIN4
              TomChannelTimerParameters:
                TomChDCycCompareShadowValSr1 = 0
                TomChEnableForceUpdate = false
                TomChPeriodCompareShadowValSr0 = 0
                TomChResetCn0OnForceUpdate = false
                TomChUpdateEnableOnCn0Reset = false
                TomChannelBitReversalMode = false
                TomChannelClockSelect = GTM_FIXED_CLOCK_0
                TomChannelCounterCn0Reset = ON_COMPARE_MATCH_ON_CHANNEL
                TomChannelCounterValCn0 = 0
                TomChannelDutyCycleCompareValCm1 = 0
                TomChannelExtCounterCn0Reset = TRIG_ON_PREV_COMPARE_MATCH
                TomChannelExtTriggerOutput = EXT_TRIG_FROM_PREVIOUS_CHANNEL
                TomChannelOneShotMode = false
                TomChannelPeriodCompareValCm0 = 0
                TomChannelTrigOneShotMode = false
                TomChannelTriggerOutput = TRIG_FROM_PREVIOUS_CHANNEL
              TomChannelUsage: TomChannelUsage=USED_BY_OTHER_DRIVERS_OR_UNUSED
            TomChannel_13
              TomChannelEnable: TomChDisableOnTgcTrigger=false, TomChannelEnable=AT_START
              TomChannelInterrupt: TomIntEnableOnDutyCycleMatchCcu1=false, TomIntEnableOnPeriodMatchCcu0=false, TomInterruptMode=GTM_INTERRUPT_LEVEL_MODE, TomNotification=NULL_PTR
              TomChannelOutput:
                TomChOutputDisableOnTgcTrig = false
                TomChannelOutputControl = DONT_ENABLE_CHANNEL_OUTPUT
                TomChannelOutputSignalLevel = LOW
                TomChannelPortPinSelect = TOUT5_SELB_PORT2_PIN5
              TomChannelTimerParameters:
                TomChDCycCompareShadowValSr1 = 0
                TomChEnableForceUpdate = false
                TomChPeriodCompareShadowValSr0 = 0
                TomChResetCn0OnForceUpdate = false
                TomChUpdateEnableOnCn0Reset = false
                TomChannelBitReversalMode = false
                TomChannelClockSelect = GTM_FIXED_CLOCK_0
                TomChannelCounterCn0Reset = ON_COMPARE_MATCH_ON_CHANNEL
                TomChannelCounterValCn0 = 0
                TomChannelDutyCycleCompareValCm1 = 0
                TomChannelExtCounterCn0Reset = TRIG_ON_PREV_COMPARE_MATCH
                TomChannelExtTriggerOutput = EXT_TRIG_FROM_PREVIOUS_CHANNEL
                TomChannelOneShotMode = false
                TomChannelPeriodCompareValCm0 = 0
                TomChannelTrigOneShotMode = false
                TomChannelTriggerOutput = TRIG_FROM_PREVIOUS_CHANNEL
              TomChannelUsage: TomChannelUsage=USED_BY_OTHER_DRIVERS_OR_UNUSED
            TomChannel_14
              TomChannelEnable: TomChDisableOnTgcTrigger=false, TomChannelEnable=AT_START
              TomChannelInterrupt: TomIntEnableOnDutyCycleMatchCcu1=false, TomIntEnableOnPeriodMatchCcu0=false, TomInterruptMode=GTM_INTERRUPT_LEVEL_MODE, TomNotification=NULL_PTR
              TomChannelOutput:
                TomChOutputDisableOnTgcTrig = false
                TomChannelOutputControl = DONT_ENABLE_CHANNEL_OUTPUT
                TomChannelOutputSignalLevel = LOW
                TomChannelPortPinSelect = TOUT6_SELB_PORT2_PIN6
              TomChannelTimerParameters:
                TomChDCycCompareShadowValSr1 = 0
                TomChEnableForceUpdate = false
                TomChPeriodCompareShadowValSr0 = 0
                TomChResetCn0OnForceUpdate = false
                TomChUpdateEnableOnCn0Reset = false
                TomChannelBitReversalMode = false
                TomChannelClockSelect = GTM_FIXED_CLOCK_0
                TomChannelCounterCn0Reset = ON_COMPARE_MATCH_ON_CHANNEL
                TomChannelCounterValCn0 = 0
                TomChannelDutyCycleCompareValCm1 = 0
                TomChannelExtCounterCn0Reset = TRIG_ON_PREV_COMPARE_MATCH
                TomChannelExtTriggerOutput = EXT_TRIG_FROM_PREVIOUS_CHANNEL
                TomChannelOneShotMode = false
                TomChannelPeriodCompareValCm0 = 0
                TomChannelTrigOneShotMode = false
                TomChannelTriggerOutput = TRIG_FROM_PREVIOUS_CHANNEL
              TomChannelUsage: TomChannelUsage=USED_BY_OTHER_DRIVERS_OR_UNUSED
            TomChannel_15
              TomChannelEnable: TomChDisableOnTgcTrigger=false, TomChannelEnable=AT_START
              TomChannelInterrupt: TomIntEnableOnDutyCycleMatchCcu1=false, TomIntEnableOnPeriodMatchCcu0=false, TomInterruptMode=GTM_INTERRUPT_LEVEL_MODE, TomNotification=NULL_PTR
              TomChannelOutput:
                TomChOutputDisableOnTgcTrig = false
                TomChannelOutputControl = DONT_ENABLE_CHANNEL_OUTPUT
                TomChannelOutputSignalLevel = LOW
                TomChannelPortPinSelect = TOUT7_SELB_PORT2_PIN7
              TomChannelTimerParameters:
                TomChDCycCompareShadowValSr1 = 0
                TomChEnableForceUpdate = false
                TomChPeriodCompareShadowValSr0 = 0
                TomChResetCn0OnForceUpdate = false
                TomChUpdateEnableOnCn0Reset = false
                TomChannelBitReversalMode = false
                TomChannelClockSelect = GTM_FIXED_CLOCK_0
                TomChannelCounterCn0Reset = ON_COMPARE_MATCH_ON_CHANNEL
                TomChannelCounterValCn0 = 0
                TomChannelDutyCycleCompareValCm1 = 0
                TomChannelExtCounterCn0Reset = TRIG_ON_PREV_COMPARE_MATCH
                TomChannelExtTriggerOutput = EXT_TRIG_FROM_PREVIOUS_CHANNEL
                TomChannelOneShotMode = false
                TomChannelPeriodCompareValCm0 = 0
                TomChannelTrigOneShotMode = false
                TomChannelTriggerOutput = TRIG_FROM_PREVIOUS_CHANNEL
              TomChannelUsage: TomChannelUsage=USED_BY_OTHER_DRIVERS_OR_UNUSED
            TomChannel_2
              TomChannelEnable: TomChDisableOnTgcTrigger=false, TomChannelEnable=AT_START
              TomChannelInterrupt: TomIntEnableOnDutyCycleMatchCcu1=false, TomIntEnableOnPeriodMatchCcu0=false, TomInterruptMode=GTM_INTERRUPT_LEVEL_MODE, TomNotification=NULL_PTR
              TomChannelOutput:
                TomChOutputDisableOnTgcTrig = false
                TomChannelOutputControl = DONT_ENABLE_CHANNEL_OUTPUT
                TomChannelOutputSignalLevel = LOW
                TomChannelPortPinSelect = TOUT12_SELB_PORT0_PIN3
              TomChannelTimerParameters:
                TomChDCycCompareShadowValSr1 = 0
                TomChEnableForceUpdate = false
                TomChPeriodCompareShadowValSr0 = 0
                TomChResetCn0OnForceUpdate = false
                TomChUpdateEnableOnCn0Reset = false
                TomChannelBitReversalMode = false
                TomChannelClockSelect = GTM_FIXED_CLOCK_0
                TomChannelCounterCn0Reset = ON_COMPARE_MATCH_ON_CHANNEL
                TomChannelCounterValCn0 = 0
                TomChannelDutyCycleCompareValCm1 = 0
                TomChannelExtCounterCn0Reset = TRIG_ON_PREV_COMPARE_MATCH
                TomChannelExtTriggerOutput = EXT_TRIG_FROM_PREVIOUS_CHANNEL
                TomChannelOneShotMode = false
                TomChannelPeriodCompareValCm0 = 0
                TomChannelTrigOneShotMode = false
                TomChannelTriggerOutput = TRIG_FROM_PREVIOUS_CHANNEL
              TomChannelUsage: TomChannelUsage=USED_BY_OTHER_DRIVERS_OR_UNUSED
            TomChannel_3
              TomChannelEnable: TomChDisableOnTgcTrigger=false, TomChannelEnable=AT_START
              TomChannelInterrupt: TomIntEnableOnDutyCycleMatchCcu1=false, TomIntEnableOnPeriodMatchCcu0=false, TomInterruptMode=GTM_INTERRUPT_LEVEL_MODE, TomNotification=NULL_PTR
              TomChannelOutput:
                TomChOutputDisableOnTgcTrig = false
                TomChannelOutputControl = DONT_ENABLE_CHANNEL_OUTPUT
                TomChannelOutputSignalLevel = LOW
                TomChannelPortPinSelect = TOUT13_SELB_PORT0_PIN4
              TomChannelTimerParameters:
                TomChDCycCompareShadowValSr1 = 0
                TomChEnableForceUpdate = false
                TomChPeriodCompareShadowValSr0 = 0
                TomChResetCn0OnForceUpdate = false
                TomChUpdateEnableOnCn0Reset = false
                TomChannelBitReversalMode = false
                TomChannelClockSelect = GTM_FIXED_CLOCK_0
                TomChannelCounterCn0Reset = ON_COMPARE_MATCH_ON_CHANNEL
                TomChannelCounterValCn0 = 0
                TomChannelDutyCycleCompareValCm1 = 0
                TomChannelExtCounterCn0Reset = TRIG_ON_PREV_COMPARE_MATCH
                TomChannelExtTriggerOutput = EXT_TRIG_FROM_PREVIOUS_CHANNEL
                TomChannelOneShotMode = false
                TomChannelPeriodCompareValCm0 = 0
                TomChannelTrigOneShotMode = false
                TomChannelTriggerOutput = TRIG_FROM_PREVIOUS_CHANNEL
              TomChannelUsage: TomChannelUsage=USED_BY_OTHER_DRIVERS_OR_UNUSED
            TomChannel_4
              TomChannelEnable: TomChDisableOnTgcTrigger=false, TomChannelEnable=AT_START
              TomChannelInterrupt: TomIntEnableOnDutyCycleMatchCcu1=false, TomIntEnableOnPeriodMatchCcu0=false, TomInterruptMode=GTM_INTERRUPT_LEVEL_MODE, TomNotification=NULL_PTR
              TomChannelOutput:
                TomChOutputDisableOnTgcTrig = false
                TomChannelOutputControl = DONT_ENABLE_CHANNEL_OUTPUT
                TomChannelOutputSignalLevel = LOW
                TomChannelPortPinSelect = TOUT14_SELB_PORT0_PIN5
              TomChannelTimerParameters:
                TomChDCycCompareShadowValSr1 = 0
                TomChEnableForceUpdate = false
                TomChPeriodCompareShadowValSr0 = 0
                TomChResetCn0OnForceUpdate = false
                TomChUpdateEnableOnCn0Reset = false
                TomChannelBitReversalMode = false
                TomChannelClockSelect = GTM_FIXED_CLOCK_0
                TomChannelCounterCn0Reset = ON_COMPARE_MATCH_ON_CHANNEL
                TomChannelCounterValCn0 = 0
                TomChannelDutyCycleCompareValCm1 = 0
                TomChannelExtCounterCn0Reset = TRIG_ON_PREV_COMPARE_MATCH
                TomChannelExtTriggerOutput = EXT_TRIG_FROM_PREVIOUS_CHANNEL
                TomChannelOneShotMode = false
                TomChannelPeriodCompareValCm0 = 0
                TomChannelTrigOneShotMode = false
                TomChannelTriggerOutput = TRIG_FROM_PREVIOUS_CHANNEL
              TomChannelUsage: TomChannelUsage=USED_BY_OTHER_DRIVERS_OR_UNUSED
            TomChannel_5
              TomChannelEnable: TomChDisableOnTgcTrigger=false, TomChannelEnable=AT_START
              TomChannelInterrupt: TomIntEnableOnDutyCycleMatchCcu1=false, TomIntEnableOnPeriodMatchCcu0=false, TomInterruptMode=GTM_INTERRUPT_LEVEL_MODE, TomNotification=NULL_PTR
              TomChannelOutput:
                TomChOutputDisableOnTgcTrig = false
                TomChannelOutputControl = DONT_ENABLE_CHANNEL_OUTPUT
                TomChannelOutputSignalLevel = LOW
                TomChannelPortPinSelect = TOUT15_SELB_PORT0_PIN6
              TomChannelTimerParameters:
                TomChDCycCompareShadowValSr1 = 0
                TomChEnableForceUpdate = false
                TomChPeriodCompareShadowValSr0 = 0
                TomChResetCn0OnForceUpdate = false
                TomChUpdateEnableOnCn0Reset = false
                TomChannelBitReversalMode = false
                TomChannelClockSelect = GTM_FIXED_CLOCK_0
                TomChannelCounterCn0Reset = ON_COMPARE_MATCH_ON_CHANNEL
                TomChannelCounterValCn0 = 0
                TomChannelDutyCycleCompareValCm1 = 0
                TomChannelExtCounterCn0Reset = TRIG_ON_PREV_COMPARE_MATCH
                TomChannelExtTriggerOutput = EXT_TRIG_FROM_PREVIOUS_CHANNEL
                TomChannelOneShotMode = false
                TomChannelPeriodCompareValCm0 = 0
                TomChannelTrigOneShotMode = false
                TomChannelTriggerOutput = TRIG_FROM_PREVIOUS_CHANNEL
              TomChannelUsage: TomChannelUsage=USED_BY_OTHER_DRIVERS_OR_UNUSED
            TomChannel_6
              TomChannelEnable: TomChDisableOnTgcTrigger=false, TomChannelEnable=AT_START
              TomChannelInterrupt: TomIntEnableOnDutyCycleMatchCcu1=false, TomIntEnableOnPeriodMatchCcu0=false, TomInterruptMode=GTM_INTERRUPT_LEVEL_MODE, TomNotification=NULL_PTR
              TomChannelOutput:
                TomChOutputDisableOnTgcTrig = false
                TomChannelOutputControl = DONT_ENABLE_CHANNEL_OUTPUT
                TomChannelOutputSignalLevel = LOW
                TomChannelPortPinSelect = TOUT16_SELB_PORT0_PIN7
              TomChannelTimerParameters:
                TomChDCycCompareShadowValSr1 = 0
                TomChEnableForceUpdate = false
                TomChPeriodCompareShadowValSr0 = 0
                TomChResetCn0OnForceUpdate = false
                TomChUpdateEnableOnCn0Reset = false
                TomChannelBitReversalMode = false
                TomChannelClockSelect = GTM_FIXED_CLOCK_0
                TomChannelCounterCn0Reset = ON_COMPARE_MATCH_ON_CHANNEL
                TomChannelCounterValCn0 = 0
                TomChannelDutyCycleCompareValCm1 = 0
                TomChannelExtCounterCn0Reset = TRIG_ON_PREV_COMPARE_MATCH
                TomChannelExtTriggerOutput = EXT_TRIG_FROM_PREVIOUS_CHANNEL
                TomChannelOneShotMode = false
                TomChannelPeriodCompareValCm0 = 0
                TomChannelTrigOneShotMode = false
                TomChannelTriggerOutput = TRIG_FROM_PREVIOUS_CHANNEL
              TomChannelUsage: TomChannelUsage=USED_BY_OTHER_DRIVERS_OR_UNUSED
            TomChannel_7
              TomChannelEnable: TomChDisableOnTgcTrigger=false, TomChannelEnable=AT_START
              TomChannelInterrupt: TomIntEnableOnDutyCycleMatchCcu1=false, TomIntEnableOnPeriodMatchCcu0=false, TomInterruptMode=GTM_INTERRUPT_LEVEL_MODE, TomNotification=NULL_PTR
              TomChannelOutput:
                TomChOutputDisableOnTgcTrig = false
                TomChannelOutputControl = DONT_ENABLE_CHANNEL_OUTPUT
                TomChannelOutputSignalLevel = LOW
                TomChannelPortPinSelect = TOUT17_SELB_PORT0_PIN8
              TomChannelTimerParameters:
                TomChDCycCompareShadowValSr1 = 0
                TomChEnableForceUpdate = false
                TomChPeriodCompareShadowValSr0 = 0
                TomChResetCn0OnForceUpdate = false
                TomChUpdateEnableOnCn0Reset = false
                TomChannelBitReversalMode = false
                TomChannelClockSelect = GTM_FIXED_CLOCK_0
                TomChannelCounterCn0Reset = ON_COMPARE_MATCH_ON_CHANNEL
                TomChannelCounterValCn0 = 0
                TomChannelDutyCycleCompareValCm1 = 0
                TomChannelExtCounterCn0Reset = TRIG_ON_PREV_COMPARE_MATCH
                TomChannelExtTriggerOutput = EXT_TRIG_FROM_PREVIOUS_CHANNEL
                TomChannelOneShotMode = false
                TomChannelPeriodCompareValCm0 = 0
                TomChannelTrigOneShotMode = false
                TomChannelTriggerOutput = TRIG_FROM_PREVIOUS_CHANNEL
              TomChannelUsage: TomChannelUsage=USED_BY_OTHER_DRIVERS_OR_UNUSED
            TomChannel_8
              TomChannelEnable: TomChDisableOnTgcTrigger=false, TomChannelEnable=AT_START
              TomChannelInterrupt: TomIntEnableOnDutyCycleMatchCcu1=false, TomIntEnableOnPeriodMatchCcu0=false, TomInterruptMode=GTM_INTERRUPT_LEVEL_MODE, TomNotification=NULL_PTR
              TomChannelOutput:
                TomChOutputDisableOnTgcTrig = false
                TomChannelOutputControl = DONT_ENABLE_CHANNEL_OUTPUT
                TomChannelOutputSignalLevel = LOW
                TomChannelPortPinSelect = TOUT0_SELB_PORT2_PIN0
              TomChannelTimerParameters:
                TomChDCycCompareShadowValSr1 = 0
                TomChEnableForceUpdate = false
                TomChPeriodCompareShadowValSr0 = 0
                TomChResetCn0OnForceUpdate = false
                TomChUpdateEnableOnCn0Reset = false
                TomChannelBitReversalMode = false
                TomChannelClockSelect = GTM_FIXED_CLOCK_0
                TomChannelCounterCn0Reset = ON_COMPARE_MATCH_ON_CHANNEL
                TomChannelCounterValCn0 = 0
                TomChannelDutyCycleCompareValCm1 = 0
                TomChannelExtCounterCn0Reset = TRIG_ON_PREV_COMPARE_MATCH
                TomChannelExtTriggerOutput = EXT_TRIG_FROM_PREVIOUS_CHANNEL
                TomChannelOneShotMode = false
                TomChannelPeriodCompareValCm0 = 0
                TomChannelTrigOneShotMode = false
                TomChannelTriggerOutput = TRIG_FROM_PREVIOUS_CHANNEL
              TomChannelUsage: TomChannelUsage=USED_BY_OTHER_DRIVERS_OR_UNUSED
            TomChannel_9
              TomChannelEnable: TomChDisableOnTgcTrigger=false, TomChannelEnable=AT_START
              TomChannelInterrupt: TomIntEnableOnDutyCycleMatchCcu1=false, TomIntEnableOnPeriodMatchCcu0=false, TomInterruptMode=GTM_INTERRUPT_LEVEL_MODE, TomNotification=NULL_PTR
              TomChannelOutput:
                TomChOutputDisableOnTgcTrig = false
                TomChannelOutputControl = DONT_ENABLE_CHANNEL_OUTPUT
                TomChannelOutputSignalLevel = LOW
                TomChannelPortPinSelect = TOUT1_SELB_PORT2_PIN1
              TomChannelTimerParameters:
                TomChDCycCompareShadowValSr1 = 0
                TomChEnableForceUpdate = false
                TomChPeriodCompareShadowValSr0 = 0
                TomChResetCn0OnForceUpdate = false
                TomChUpdateEnableOnCn0Reset = false
                TomChannelBitReversalMode = false
                TomChannelClockSelect = GTM_FIXED_CLOCK_0
                TomChannelCounterCn0Reset = ON_COMPARE_MATCH_ON_CHANNEL
                TomChannelCounterValCn0 = 0
                TomChannelDutyCycleCompareValCm1 = 0
                TomChannelExtCounterCn0Reset = TRIG_ON_PREV_COMPARE_MATCH
                TomChannelExtTriggerOutput = EXT_TRIG_FROM_PREVIOUS_CHANNEL
                TomChannelOneShotMode = false
                TomChannelPeriodCompareValCm0 = 0
                TomChannelTrigOneShotMode = false
                TomChannelTriggerOutput = TRIG_FROM_PREVIOUS_CHANNEL
              TomChannelUsage: TomChannelUsage=USED_BY_OTHER_DRIVERS_OR_UNUSED
          TomTriggersForTgc_0 (TomTriggersForTgc)
            TomTgcInternalTriggerSelect:
              TomTgcIntTriggerFromChannel{0..7} = false
            TomTgcTriggerByTimebase: TomTgcTbuTimebaseSelect=TBU_TS0_TIMEBASE, TomTgcTimeBaseTriggerEnable=false, TomTgcTimebaseMatchValue=0
          TomTriggersForTgc_1 (TomTriggersForTgc)
            TomTgcInternalTriggerSelect:
              TomTgcIntTriggerFromChannel{0..7} = false
            TomTgcTriggerByTimebase: TomTgcTbuTimebaseSelect=TBU_TS0_TIMEBASE, TomTgcTimeBaseTriggerEnable=false, TomTgcTimebaseMatchValue=0
      McuTriggerReset: ESR0ResetTrigger=0, ESR1ResetTrigger=0, SMUResetTrigger=0, STM0ResetTrigger=0
      McuClockSettingConfig: McuClockSettingId=0
        McuClockReferencePoint:
          McuClockSettingMode = NORMAL_MODE
          McuPllPDivider = 0
          McuPllNDivider = 29
          McuPllK1Divider = 1
          McuPllK2Divider = 4
          McuPllK3Divider = 5
          McuK2DivSteps = 2
          McuK2DivRampToPllConfDelay = 10
          McuK2DivRampToBackUpConfDelay = 10
          McuFMPllModAmp = 1.25
          McuClockReferencePointFrequency = 120000000
          McuClockReferencePoint2Frequency = 100000000
          McuSRIDivider = 1
          McuClockSRIFrequency = 120000000
          McuCPU0Divider = 0
          McuClockCPU0Frequency = 120000000
          McuSPBDivider = 2
          McuClockSPBFrequency = 60000000
          McuFSIDivider = 2
          McuClockFSIFrequency = 60000000
          McuFSI2Divider = 2
          McuClockFSI2Frequency = 60000000
          McuMAXDivider = 1
          McuClockMAXFrequency = 120000000
          McuGTMDivider = 2
          McuClockGTMFrequency = 60000000
          McuSTMDivider = 2
          McuClockSTMFrequency = 60000000
          McuBBBDivider = 2
          McuClockBBBFrequency = 60000000
          McuBAUD2Divider = 2
          McuClockBAUD2Frequency = 60000000
          McuCANDivider = 3
          McuClockCANFrequency = 40000000
          McuASCLINFDivider = 2
          McuClockASCLINFFrequency = 60000000
          McuASCLINSDivider = 8
          McuClockASCLINSFrequency = 15000000
          McuErayPllPDivider = 0
          McuErayPllNDivider = 19
          McuErayPllK2Divider = 4
          McuErayPllK3Divider = 4
          McuClockErayPllFrequency = 80000000
          McuClockErayPll2Frequency = 80000000
          McuErayDivider = 1
          McuClockErayFrequency = 80000000
      McuModeSettingConf_Sleep (McuModeSettingConf): McuMode=1
        McuStandbySettingConf
      McuModeSettingConf_0 (McuModeSettingConf): McuMode=0, McuIdleReqAckSeqDisable=false
        McuStandbySettingConf
    McuSafety: McuClockMonitoringEnable=true, McuGetModeApi=true, McuInitCheckApi=true, McuSafetyEnable=false
    CommonPublishedInformation:
      ArMajorVersion = 3
      ArMinorVersion = 2
      ArPatchVersion = 0
      ModuleId = 101
      Release = _TRICORE_TC234
      SwMajorVersion = 4
      SwMinorVersion = 6
      SwPatchVersion = 1
      VendorApiInfix = 
      VendorId = 17
