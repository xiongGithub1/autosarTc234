AUTOSAR XML (schema 4-3-0)
package /VehicleProject
  system System: category=SYSTEM_EXTRACT
    system mapping System_MPPNG
    root-software-compositions:
      root sw composition prototype ECU_Composition: software-composition=ECU_Composition
package /ECUCompositionTypes
  composition sw component type ECU_Composition
    component StartApplication: type=StartApplication
    component ComM: type=ComM
    connect ComM.UR_USR_CHNL_f276589c -> StartApplication.UR_USR_CHNL_3c6d4e43
package /EndToEndProtections
  end to end protection set EndToEndConnections
