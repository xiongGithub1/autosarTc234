AUTOSAR XML (schema 4-3-0)
package /VehicleProject
  system System: category=SYSTEM_EXTRACT
    system mapping System_MPPNG: sender-receiver-to-signal-mapping{data-element=Pisignal_Rx1bit_RearInteriorLightState.RearInteriorLightState, system-signal=sig_State_RearInteriorLight}
    root-software-compositions:
      root sw composition prototype ECU_Composition: software-composition=ECU_Composition
package /ECUCompositionTypes
  composition sw component type ECU_Composition
    require port Pisignal_Rx1bit_RearInteriorLightState: nonqueued-receiver-com-spec{data-element=RearInteriorLightState, filter=data-filter-type=ALWAYS, init-value=0}, required-interface=Pisignal_Rx1bit_RearInteriorLightState
    component StartApplication: type=StartApplication
    component ComM: type=ComM
    component AppCom: type=AppCom
    connect ComM.UR_USR_CHNL_f276589c -> StartApplication.UR_USR_CHNL_3c6d4e43
    delegate AppCom.Pisignal_Rx1bit_RearInteriorLightState <-> outer port Pisignal_Rx1bit_RearInteriorLightState
package /EndToEndProtections
  end to end protection set EndToEndConnections
