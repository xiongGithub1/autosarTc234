AUTOSAR XML (schema 4-2-1)
package /COM/VECTOR/CFG/WORKFLOW/SYSDESC/SYNC
  flat map FLATMAP
    flat instance descriptor StartApplication: upstream-reference=ECU_Composition.StartApplication, ecu-extract-reference=COMPOSITIONTYPE.StartApplication
    flat instance descriptor ComM: upstream-reference=ECU_Composition.ComM, ecu-extract-reference=COMPOSITIONTYPE.ComM
