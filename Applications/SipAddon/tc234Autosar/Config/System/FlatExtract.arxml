AUTOSAR XML (schema 4-3-0)
package /COM/VECTOR/CFG/WORKFLOW/SYSDESC/SYNC
  system SYSTEM: category=ECU_EXTRACT
    system mapping MAPPINGS
    root-software-compositions:
      root sw composition prototype COMPOSITIONTYPE: flat-map=FLATMAP, software-composition=COMPOSITIONTYPE
  composition sw component type COMPOSITIONTYPE  # UB:Derived from original system description
    6 x component:
      BswM: type=BswM
      ComM: type=ComM
      Det: type=Det
      EcuM: type=EcuM
      Os_OsCore_Core0_swc: type=Os_OsCore_Core0_swc
      StartApplication: type=StartApplication
    connect BswM.Switch_ESH_ModeSwitch -> BswM.Notification_ESH_ModeNotification
    connect EcuM.EcuM_ShutdownTarget -> StartApplication.EcuM_ShutdownTarget
    connect BswM.Provide_BswMRteModeRequestPort -> BswM.Request_ESH_PostRunRequest_0
    connect ComM.UR_USR_CHNL_f276589c -> StartApplication.UR_USR_CHNL_3c6d4e43  # UB:Derived from original system description
  end to end protection set E2EPROTECTIONSET
  port interface mapping set PORTINTERFACEMAPPINGSET
