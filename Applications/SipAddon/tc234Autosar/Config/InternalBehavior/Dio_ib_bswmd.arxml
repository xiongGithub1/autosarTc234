AUTOSAR XML (schema 4-2-1)
package /AURIX/Dio_ib_bswmd/BswModuleDescriptions
  bsw module description Dio
    bsw internal behavior DioBehavior
