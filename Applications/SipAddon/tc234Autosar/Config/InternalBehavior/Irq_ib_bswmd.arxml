AUTOSAR XML (schema 4-2-1)
package /AURIX/Irq_ib_bswmd/BswModuleDescriptions
  bsw module description Irq
    bsw internal behavior IrqBehavior
