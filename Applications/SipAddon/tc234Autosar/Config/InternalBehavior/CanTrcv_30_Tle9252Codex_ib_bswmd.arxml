AUTOSAR XML (schema 4-2-1)
package /MICROSAR/CanTrcv_Tle9252Codex
  bsw implementation CanTrcv_Impl: programming-language=C, sw-version=4.02.00, used-code-generator=cMSR, vendor-id=30, ar-release-version=4.00.03, vendor-api-infix=Tle9252Codex
