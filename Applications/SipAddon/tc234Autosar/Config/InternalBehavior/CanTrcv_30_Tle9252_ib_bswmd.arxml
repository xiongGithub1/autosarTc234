AUTOSAR XML (schema 4-2-1)
package /MICROSAR/CanTrcv_30_Tle9252_ib_bswmd/BswModuleDescriptions
  bsw module description CanTrcv
    bsw internal behavior CanTrcv_Tle9252_Behavior
