AUTOSAR XML (schema 4-0-3)
package /DaVinci_Project
  module config Com
    ComConfig
      4 x ComSignal:
        Signal_Rx15bit_OnWrite_a1df81ad: ComNotification=Rte_COMCbk_Signal_Rx15bit_OnWrite_a1df81ad, ComSignalType=UINT16
        Signal_Rx16bit_Cyclic_a691adb3: ComNotification=Rte_COMCbk_Signal_Rx16bit_Cyclic_a691adb3, ComSignalType=UINT16
        Signal_Tx24bit_Cyclic_85bf3e37: ComSignalType=UINT32
        Signal_Tx32bit_OnWrite_b2cd4fc2: ComSignalType=UINT32
  module config Rte
    30 x RteBswModuleInstance:
      Adc
      BswM
        BswM_MainFunctionTimingEvent0 (RteBswEventToTaskMapping): RteBswUsedOsEventRef=Rte_Ev_Cyclic2_Default_BSW_Async_Task_0_10ms, RteBswUsedOsAlarmRef=Os/Rte_Al_TE2_Default_BSW_Async_Task_0_10ms
      Can
        3 x RteBswEventToTaskMapping, all with RteBswUsedOsEventRef=Rte_Ev_Cyclic2_Default_BSW_Async_Task_0_10ms, RteBswUsedOsAlarmRef=Os/Rte_Al_TE2_Default_BSW_Async_Task_0_10ms:
          Can_MainFunction_BusOffTimingEvent0
          Can_MainFunction_ModeTimingEvent0
          Can_MainFunction_WakeupTimingEvent0
      CanIf
      CanNm
        CanNm_MainFunctionTimingEvent0 (RteBswEventToTaskMapping): RteBswUsedOsEventRef=Rte_Ev_Cyclic2_Default_BSW_Async_Task_0_10ms, RteBswUsedOsAlarmRef=Os/Rte_Al_TE2_Default_BSW_Async_Task_0_10ms
      CanSM
        CanSM_MainFunctionTimingEvent0 (RteBswEventToTaskMapping): RteBswUsedOsEventRef=Rte_Ev_Cyclic2_Default_BSW_Async_Task_0_10ms, RteBswUsedOsAlarmRef=Os/Rte_Al_TE2_Default_BSW_Async_Task_0_10ms
      CanTp
        CanTp_MainFunctionTimingEvent0 (RteBswEventToTaskMapping): RteBswUsedOsEventRef=Rte_Ev_Cyclic2_Default_BSW_Async_Task_0_5ms, RteBswUsedOsAlarmRef=Os/Rte_Al_TE2_Default_BSW_Async_Task_0_5ms
      Com
        Com_MainFunctionRxTimingEvent0 (RteBswEventToTaskMapping): RteBswUsedOsEventRef=Rte_Ev_Cyclic2_Default_BSW_Async_Task_0_10ms, RteBswUsedOsAlarmRef=Os/Rte_Al_TE2_Default_BSW_Async_Task_0_10ms
        Com_MainFunctionTxTimingEvent0 (RteBswEventToTaskMapping): RteBswUsedOsEventRef=Rte_Ev_Cyclic2_Default_BSW_Async_Task_0_10ms, RteBswUsedOsAlarmRef=Os/Rte_Al_TE2_Default_BSW_Async_Task_0_10ms
      ComM
        ComM_MainFunction_0TimingEvent0 (RteBswEventToTaskMapping): RteBswUsedOsEventRef=Rte_Ev_Cyclic2_Default_BSW_Async_Task_0_20ms, RteBswUsedOsAlarmRef=Os/Rte_Al_TE2_Default_BSW_Async_Task_0_20ms
      Dcm
        Dcm_MainFunctionTimingEvent0 (RteBswEventToTaskMapping): RteBswUsedOsEventRef=Rte_Ev_Cyclic2_Default_BSW_Async_Task_0_10ms, RteBswUsedOsAlarmRef=Os/Rte_Al_TE2_Default_BSW_Async_Task_0_10ms
      Dem
        Dem_MasterMainFunctionTimingEvent0 (RteBswEventToTaskMapping): RteBswUsedOsEventRef=Rte_Ev_Cyclic2_Default_BSW_Async_Task_0_10ms, RteBswUsedOsAlarmRef=Os/Rte_Al_TE2_Default_BSW_Async_Task_0_10ms
        Dem_SatelliteMainFunctionTimingEvent0 (RteBswEventToTaskMapping): RteBswUsedOsEventRef=Rte_Ev_Cyclic2_Default_BSW_Async_Task_0_10ms, RteBswUsedOsAlarmRef=Os/Rte_Al_TE2_Default_BSW_Async_Task_0_10ms
      Det
      Dio
      EcuM
        EcuM_MainFunctionTimingEvent0 (RteBswEventToTaskMapping): RteBswUsedOsEventRef=Rte_Ev_Cyclic2_Default_BSW_Async_Task_0_10ms, RteBswUsedOsAlarmRef=Os/Rte_Al_TE2_Default_BSW_Async_Task_0_10ms
      Fee
        Fee_MainFunctionTimingEvent0 (RteBswEventToTaskMapping): RteBswUsedOsEventRef=Rte_Ev_Cyclic2_Default_BSW_Async_Task_0_10ms, RteBswUsedOsAlarmRef=Os/Rte_Al_TE2_Default_BSW_Async_Task_0_10ms
      Fls
        Fls_17_Pmu_MainFunctionTimingEvent0 (RteBswEventToTaskMapping): RteBswUsedOsEventRef=Rte_Ev_Cyclic2_Default_BSW_Async_Task_0_10ms, RteBswUsedOsAlarmRef=Os/Rte_Al_TE2_Default_BSW_Async_Task_0_10ms
      Gpt
      Icu
      IoHwAb
      Irq
      Mcu
      Nm
      NvM
        NvM_MainFunctionTimingEvent0 (RteBswEventToTaskMapping): RteBswUsedOsEventRef=Rte_Ev_Cyclic2_Default_BSW_Async_Task_0_10ms, RteBswUsedOsAlarmRef=Os/Rte_Al_TE2_Default_BSW_Async_Task_0_10ms
      PduR
      Port
      Pwm
      Spi
        Spi_MainFunction_HandlingTimingEvent0 (RteBswEventToTaskMapping): RteBswUsedOsEventRef=Rte_Ev_Cyclic2_Default_BSW_Async_Task_0_5ms, RteBswUsedOsAlarmRef=Os/Rte_Al_TE2_Default_BSW_Async_Task_0_5ms
      WdgM
        WdgM_MainFunctionTimingEvent0 (RteBswEventToTaskMapping): RteBswUsedOsEventRef=Rte_Ev_Cyclic2_Default_BSW_Async_Task_0_10ms, RteBswUsedOsAlarmRef=Os/Rte_Al_TE2_Default_BSW_Async_Task_0_10ms
      Wdg
      Xcp
        CanXcp_MainFunctionTimingEvent0 (RteBswEventToTaskMapping): RteBswUsedOsEventRef=Rte_Ev_Cyclic2_Default_BSW_Async_Task_0_5ms, RteBswUsedOsAlarmRef=Os/Rte_Al_TE2_Default_BSW_Async_Task_0_5ms
        Xcp_MainFunctionTimingEvent0 (RteBswEventToTaskMapping): RteBswUsedOsEventRef=Rte_Ev_Cyclic2_Default_BSW_Async_Task_0_5ms, RteBswUsedOsAlarmRef=Os/Rte_Al_TE2_Default_BSW_Async_Task_0_5ms
    12 x RteSwComponentInstance:
      BswM_EcuSwComposition
        Timer_BswM_MainFunction (RteEventToTaskMapping): RteUsedOsEventRef=Rte_Ev_Cyclic2_Default_BSW_Async_Task_0_10ms, RteUsedOsAlarmRef=Os/Rte_Al_TE2_Default_BSW_Async_Task_0_10ms
      ComM_EcuSwComposition
        Timer_ComM_MainFunction_0 (RteEventToTaskMapping): RteUsedOsEventRef=Rte_Ev_Cyclic2_Default_BSW_Async_Task_0_20ms, RteUsedOsAlarmRef=Os/Rte_Al_TE2_Default_BSW_Async_Task_0_20ms
      Dcm_EcuSwComposition
        Timer_Dcm_MainFunction (RteEventToTaskMapping): RteUsedOsEventRef=Rte_Ev_Cyclic2_Default_BSW_Async_Task_0_10ms, RteUsedOsAlarmRef=Os/Rte_Al_TE2_Default_BSW_Async_Task_0_10ms
      DemMaster_0_EcuSwComposition
        Timer_Dem_MasterMainFunction (RteEventToTaskMapping): RteUsedOsEventRef=Rte_Ev_Cyclic2_Default_BSW_Async_Task_0_10ms, RteUsedOsAlarmRef=Os/Rte_Al_TE2_Default_BSW_Async_Task_0_10ms
      DemSatellite_0_EcuSwComposition
        Timer_Dem_SatelliteMainFunction (RteEventToTaskMapping): RteUsedOsEventRef=Rte_Ev_Cyclic2_Default_BSW_Async_Task_0_10ms, RteUsedOsAlarmRef=Os/Rte_Al_TE2_Default_BSW_Async_Task_0_10ms
      Det_EcuSwComposition
      EcuM_EcuSwComposition
        Timer_EcuM_MainFunction (RteEventToTaskMapping): RteUsedOsEventRef=Rte_Ev_Cyclic2_Default_BSW_Async_Task_0_10ms, RteUsedOsAlarmRef=Os/Rte_Al_TE2_Default_BSW_Async_Task_0_10ms
      IoHwAb_EcuSwComposition
      NvM_EcuSwComposition
        Timer_NvM_MainFunction (RteEventToTaskMapping): RteUsedOsEventRef=Rte_Ev_Cyclic2_Default_BSW_Async_Task_0_10ms, RteUsedOsAlarmRef=Os/Rte_Al_TE2_Default_BSW_Async_Task_0_10ms
      Os_OsCore_Core0_swc_EcuSwComposition
      StartApplication_EcuSwComposition
        6 x RteEventToTaskMapping:
          Timer_StartApplication_Cyclic1000ms: RteUsedOsEventRef=Rte_Ev_Run_StartApplication_StartApplication_Cyclic1000ms, RteUsedOsAlarmRef=Os/Rte_Al_TE_StartApplication_StartApplication_Cyclic1000ms
          Timer_StartApplication_Cyclic10ms: RteUsedOsEventRef=Rte_Ev_Run_StartApplication_StartApplication_Cyclic10ms, RteUsedOsAlarmRef=Os/Rte_Al_TE_StartApplication_StartApplication_Cyclic10ms
          Timer_StartApplication_Cyclic1ms: RteUsedOsEventRef=Rte_Ev_Run_StartApplication_StartApplication_Cyclic1ms, RteUsedOsAlarmRef=Os/Rte_Al_TE_StartApplication_StartApplication_Cyclic1ms
          Timer_StartApplication_Cyclic250ms: RteUsedOsEventRef=Rte_Ev_Run_StartApplication_StartApplication_Cyclic250ms, RteUsedOsAlarmRef=Os/Rte_Al_TE_StartApplication_StartApplication_Cyclic250ms
          DataReceivedEvent_StartApplication_OnDataRec_RxCtrl_PpRxCtrl_DeSignal_Rx16bit_Cyclic_a691adb3: RteUsedOsEventRef=Rte_Ev_Run_StartApplication_StartApplication_OnDataRec_RxCtrl
          DataReceivedEvent_StartApplication_OnDataRec_RxData_PpRxData_DeSignal_Rx15bit_OnWrite_a1df81ad: RteUsedOsEventRef=Rte_Ev_Run_StartApplication_StartApplication_OnDataRec_RxData
      WdgM_EcuSwComposition
        Timer_WdgM_MainFunction (RteEventToTaskMapping): RteUsedOsEventRef=Rte_Ev_Cyclic2_Default_BSW_Async_Task_0_10ms, RteUsedOsAlarmRef=Os/Rte_Al_TE2_Default_BSW_Async_Task_0_10ms
    RteOsInteraction
      7 x RteUsedOsActivation, all with RteExpectedActivationOffset=0:
        Rte_Al_TE_StartApplication_StartApplication_Cyclic1000ms: RteActivationOsAlarmRef=Os/Rte_Al_TE_StartApplication_StartApplication_Cyclic1000ms, RteActivationOsTaskRef=Default_Appl_Task
        Rte_Al_TE_StartApplication_StartApplication_Cyclic10ms: RteActivationOsAlarmRef=Os/Rte_Al_TE_StartApplication_StartApplication_Cyclic10ms, RteActivationOsTaskRef=Default_Appl_Task
        Rte_Al_TE_StartApplication_StartApplication_Cyclic1ms: RteActivationOsAlarmRef=Os/Rte_Al_TE_StartApplication_StartApplication_Cyclic1ms, RteActivationOsTaskRef=Default_Appl_Task
        Rte_Al_TE_StartApplication_StartApplication_Cyclic250ms: RteActivationOsAlarmRef=Os/Rte_Al_TE_StartApplication_StartApplication_Cyclic250ms, RteActivationOsTaskRef=Default_Appl_Task
        Rte_Al_TE2_Default_BSW_Async_Task_0_10ms: RteActivationOsAlarmRef=Os/Rte_Al_TE2_Default_BSW_Async_Task_0_10ms, RteActivationOsTaskRef=Default_BSW_Async_Task
        Rte_Al_TE2_Default_BSW_Async_Task_0_20ms: RteActivationOsAlarmRef=Os/Rte_Al_TE2_Default_BSW_Async_Task_0_20ms, RteActivationOsTaskRef=Default_BSW_Async_Task
        Rte_Al_TE2_Default_BSW_Async_Task_0_5ms: RteActivationOsAlarmRef=Os/Rte_Al_TE2_Default_BSW_Async_Task_0_5ms, RteActivationOsTaskRef=Default_BSW_Async_Task
  module config NvM
  module config Os
    Default_Appl_Init_Task (OsTask): OsTaskActivation=1, OsTaskPriority=45, OsTaskSchedule=NON
    Default_Appl_Task (OsTask):
      OsTaskActivation = 1
      OsTaskPriority = 5
      OsTaskSchedule = NON
      OsTaskEventRef = Rte_Ev_Run_StartApplication_StartApplication_Cyclic1000ms
      OsTaskEventRef = Rte_Ev_Run_StartApplication_StartApplication_Cyclic10ms
      OsTaskEventRef = Rte_Ev_Run_StartApplication_StartApplication_Cyclic1ms
      OsTaskEventRef = Rte_Ev_Run_StartApplication_StartApplication_Cyclic250ms
      OsTaskEventRef = Rte_Ev_Run_StartApplication_StartApplication_OnDataRec_RxCtrl
      OsTaskEventRef = Rte_Ev_Run_StartApplication_StartApplication_OnDataRec_RxData
    4 x OsAlarm, all with OsAlarmCounterRef=SystemTimer:
      Rte_Al_TE_StartApplication_StartApplication_Cyclic1000ms
        OsAlarmAction
          OsAlarmSetEvent: OsAlarmSetEventRef=Rte_Ev_Run_StartApplication_StartApplication_Cyclic1000ms, OsAlarmSetEventTaskRef=Default_Appl_Task
      Rte_Al_TE_StartApplication_StartApplication_Cyclic10ms
        OsAlarmAction
          OsAlarmSetEvent: OsAlarmSetEventRef=Rte_Ev_Run_StartApplication_StartApplication_Cyclic10ms, OsAlarmSetEventTaskRef=Default_Appl_Task
      Rte_Al_TE_StartApplication_StartApplication_Cyclic1ms
        OsAlarmAction
          OsAlarmSetEvent: OsAlarmSetEventRef=Rte_Ev_Run_StartApplication_StartApplication_Cyclic1ms, OsAlarmSetEventTaskRef=Default_Appl_Task
      Rte_Al_TE_StartApplication_StartApplication_Cyclic250ms
        OsAlarmAction
          OsAlarmSetEvent: OsAlarmSetEventRef=Rte_Ev_Run_StartApplication_StartApplication_Cyclic250ms, OsAlarmSetEventTaskRef=Default_Appl_Task
    Default_BSW_Async_Task (OsTask):
      OsTaskActivation = 1
      OsTaskPriority = 30
      OsTaskSchedule = NON
      OsTaskEventRef = Rte_Ev_Cyclic2_Default_BSW_Async_Task_0_10ms
      OsTaskEventRef = Rte_Ev_Cyclic2_Default_BSW_Async_Task_0_20ms
      OsTaskEventRef = Rte_Ev_Cyclic2_Default_BSW_Async_Task_0_5ms
    3 x OsAlarm, all with OsAlarmCounterRef=SystemTimer:
      Rte_Al_TE2_Default_BSW_Async_Task_0_10ms
        OsAlarmAction
          OsAlarmSetEvent: OsAlarmSetEventRef=Rte_Ev_Cyclic2_Default_BSW_Async_Task_0_10ms, OsAlarmSetEventTaskRef=Default_BSW_Async_Task
      Rte_Al_TE2_Default_BSW_Async_Task_0_20ms
        OsAlarmAction
          OsAlarmSetEvent: OsAlarmSetEventRef=Rte_Ev_Cyclic2_Default_BSW_Async_Task_0_20ms, OsAlarmSetEventTaskRef=Default_BSW_Async_Task
      Rte_Al_TE2_Default_BSW_Async_Task_0_5ms
        OsAlarmAction
          OsAlarmSetEvent: OsAlarmSetEventRef=Rte_Ev_Cyclic2_Default_BSW_Async_Task_0_5ms, OsAlarmSetEventTaskRef=Default_BSW_Async_Task
    9 x OsEvent:
      Rte_Ev_Cyclic2_Default_BSW_Async_Task_0_10ms
      Rte_Ev_Cyclic2_Default_BSW_Async_Task_0_20ms
      Rte_Ev_Cyclic2_Default_BSW_Async_Task_0_5ms
      Rte_Ev_Run_StartApplication_StartApplication_Cyclic1000ms
      Rte_Ev_Run_StartApplication_StartApplication_Cyclic10ms
      Rte_Ev_Run_StartApplication_StartApplication_Cyclic1ms
      Rte_Ev_Run_StartApplication_StartApplication_Cyclic250ms
      Rte_Ev_Run_StartApplication_StartApplication_OnDataRec_RxCtrl
      Rte_Ev_Run_StartApplication_StartApplication_OnDataRec_RxData
  module config Xcp
    XcpConfig
      3 x XcpEventChannel, all with XcpEventChannelTimeCycle=0, XcpEventChannelTimeUnit=TIMESTAMP_UNIT_1US, XcpEventChannelType=DAQ:
        Rte_Default_Appl_Init_Task
        Rte_Default_Appl_Task
        Rte_Default_BSW_Async_Task
  ecuc value collection DaVinci_Project: ecuc-values=[Com, Rte, Os, NvM, Xcp]
