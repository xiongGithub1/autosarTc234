[part 2 of 2: packages /ActiveEcuC to /Fee]
AUTOSAR XML (schema 4-2-1)
package /ActiveEcuC  (continued)
  module config BswM: implementation-config-variant=VARIANT-PRE-COMPILE, module-description=BswM_Impl
    BswMGeneral:
      BswMCanSMEnabled = true
      BswMComMEnabled = true
      BswMDcmEnabled = true
      BswMDevErrorDetect = true
      BswMEcuMEnabled = true
      BswMEthIfEnabled = false
      BswMEthSMEnabled = false
      BswMFrSMEnabled = false
      BswMGenericRequestEnabled = true
      BswMJ1939DcmEnabled = false
      BswMJ1939NmEnabled = false
      BswMLinSMEnabled = false
      BswMLinTPEnabled = false
      BswMNmEnabled = false
      BswMNvMEnabled = true
      BswMPduREnabled = false
      BswMRuleControlEnabled = false
      BswMSdEnabled = false
      BswMVersionInfoApi = false
      BswMWdgMEnabled = false
      BswMModeCheck = true
      BswMMainFunctionPeriod = 0.01
      BswMCommonData
      BswMGeneration:
        BswMOutOfBoundsWriteSanitizer = false
        BswMOutOfBoundsReadSanitizer = false
        BswMReduceConstantData2Define = true
        BswMReduceDataByStreaming = false
        BswMBoolDataInArrayOfStructStrategy = BITMASKING
        BswMInterfacesForDeactivatedData = false
    BswMConfig
      BswMArbitration
        CC_CAN_f26020e5_RX (BswMRule):
          BswMNestedExecutionOnly = false
          BswMRuleId = 0
          BswMRuleInitState = BSWM_FALSE
          BswMRuleExpressionRef = CC_LE_CAN_f26020e5_RX
          BswMRuleFalseActionList = CC_AL_CAN_f26020e5_RX_Disable
          BswMRuleTrueActionList = CC_AL_CAN_f26020e5_RX_EnableNoinit
        CC_LE_CAN_f26020e5_RX (BswMLogicalExpression): BswMLogicalOperator=BSWM_AND, BswMArgumentRef=CC_Cond_CanSMIndication_CAN_f26020e5_NEQ_CANSM_BSWM_NO_COMMUNICATION
        CC_Cond_CanSMIndication_CAN_f26020e5_NEQ_CANSM_BSWM_NO_COMMUNICATION (BswMModeCondition): BswMConditionType=BSWM_EQUALS_NOT, BswMConditionMode=CC_CanSMIndication_CAN_f26020e5
          BswMConditionValue
            BswMBswMode: BswMBswRequestedMode=CANSM_BSWM_NO_COMMUNICATION
        CC_CanSMIndication_CAN_f26020e5 (BswMModeRequestPort): BswMArbitrateOnInit=false, BswMRequestProcessing=BSWM_IMMEDIATE
          BswMModeRequestSource
            BswMCanSMIndication: BswMCanSMChannelRef=ComMConfigSet/CAN_f26020e5
          BswMModeInitValue
            BswMBswModeInitValue: BswMBswModeInitValueMode=CANSM_BSWM_NO_COMMUNICATION
        CC_CAN_f26020e5_TX (BswMRule):
          BswMNestedExecutionOnly = false
          BswMRuleId = 2
          BswMRuleInitState = BSWM_FALSE
          BswMRuleExpressionRef = CC_LE_CAN_f26020e5_TX
          BswMRuleFalseActionList = CC_AL_CAN_f26020e5_TX_Disable
          BswMRuleTrueActionList = CC_AL_CAN_f26020e5_TX_EnableNoinit
        CC_LE_CAN_f26020e5_TX (BswMLogicalExpression): BswMLogicalOperator=BSWM_AND, BswMArgumentRef=CC_Cond_CanSMIndication_CAN_f26020e5_EQ_CANSM_BSWM_FULL_COMMUNICATION
        CC_Cond_CanSMIndication_CAN_f26020e5_EQ_CANSM_BSWM_FULL_COMMUNICATION (BswMModeCondition): BswMConditionType=BSWM_EQUALS, BswMConditionMode=CC_CanSMIndication_CAN_f26020e5
          BswMConditionValue
            BswMBswMode: BswMBswRequestedMode=CANSM_BSWM_FULL_COMMUNICATION
        CC_CAN_f26020e5_RX_DM (BswMRule):
          BswMNestedExecutionOnly = false
          BswMRuleId = 1
          BswMRuleInitState = BSWM_FALSE
          BswMRuleExpressionRef = CC_LE_CAN_f26020e5_RX_DM
          BswMRuleFalseActionList = CC_AL_CAN_f26020e5_Disable_DM
          BswMRuleTrueActionList = CC_AL_CAN_f26020e5_Enable_DM
        CC_LE_CAN_f26020e5_RX_DM (BswMLogicalExpression): BswMLogicalOperator=BSWM_AND, BswMArgumentRef=CC_Cond_CanSMIndication_CAN_f26020e5_EQ_CANSM_BSWM_FULL_COMMUNICATION
        ESH_RunToPostRun (BswMRule):
          BswMNestedExecutionOnly = false
          BswMRuleId = 9
          BswMRuleInitState = BSWM_FALSE
          BswMRuleExpressionRef = ESH_LE_RunToPostRun
          BswMRuleTrueActionList = ESH_AL_ExitRun
        ESH_LE_RunToPostRun (BswMLogicalExpression):
          BswMLogicalOperator = BSWM_AND
          BswMArgumentRef = ESH_Cond_StateIsRun
          BswMArgumentRef = ESH_LE_AllChannelsNoCom
          BswMArgumentRef = ESH_LE_RunReleased
          BswMArgumentRef = ESH_Cond_SelfRunReqTimerExpired
          BswMArgumentRef = ESH_Cond_ModeIsRun
        ESH_Cond_StateIsRun (BswMModeCondition): BswMConditionType=BSWM_EQUALS, BswMConditionMode=ESH_State
          BswMConditionValue
            BswMBswMode: BswMBswRequestedMode=ESH_RUN
        ESH_State (BswMModeRequestPort): BswMArbitrateOnInit=true, BswMRequestProcessing=BSWM_IMMEDIATE
          BswMModeRequestSource
            BswMGenericRequest: BswMModeRequesterId=230, BswMRequestedModeMax=7
              7 x BswMGenericRequestMode:
                ESH_INIT: BswMGenericRequestModeValue=0
                ESH_RUN: BswMGenericRequestModeValue=1
                ESH_POST_RUN: BswMGenericRequestModeValue=2
                ESH_PREP_SHUTDOWN: BswMGenericRequestModeValue=3
                ESH_WAIT_FOR_NVM: BswMGenericRequestModeValue=4
                ESH_SHUTDOWN: BswMGenericRequestModeValue=5
                ESH_WAKEUP: BswMGenericRequestModeValue=6
          BswMModeInitValue
            BswMBswModeInitValue: BswMBswModeInitValueMode=ESH_INIT
        ESH_LE_AllChannelsNoCom (BswMLogicalExpression): BswMLogicalOperator=BSWM_AND, BswMArgumentRef=ESH_Cond_NoComOn_CAN_f26020e5
        ESH_Cond_NoComOn_CAN_f26020e5 (BswMModeCondition): BswMConditionType=BSWM_EQUALS, BswMConditionMode=ESH_ComMIndication_CAN_f26020e5
          BswMConditionValue
            BswMBswMode: BswMBswRequestedMode=COMM_NO_COMMUNICATION
        ESH_ComMIndication_CAN_f26020e5 (BswMModeRequestPort): BswMArbitrateOnInit=false, BswMRequestProcessing=BSWM_DEFERRED
          BswMModeRequestSource
            BswMComMIndication: BswMComMChannelRef=ComMConfigSet/CAN_f26020e5
          BswMModeInitValue
            BswMBswModeInitValue: BswMBswModeInitValueMode=COMM_NO_COMMUNICATION
        ESH_LE_RunReleased (BswMLogicalExpression): BswMLogicalOperator=BSWM_AND, BswMArgumentRef=ESH_Cond_RunRequest0IsReleased, BswMArgumentRef=ESH_Cond_RunRequest1IsReleased
        ESH_Cond_RunRequest0IsReleased (BswMModeCondition): BswMConditionType=BSWM_EQUALS, BswMConditionMode=ESH_RunRequest_0
          BswMConditionValue
            BswMModeDeclaration: BswMModeValueRef=RELEASED
        ESH_RunRequest_0 (BswMModeRequestPort): BswMArbitrateOnInit=false, BswMRequestProcessing=BSWM_DEFERRED
          BswMModeRequestSource
            BswMSwcModeRequest: BswMModeRequestDataElementPrototypeName=requestedMode, BswMSwcModeRequestModeDeclarationGroupPrototypeRef=BswM_MDGP_ESH_RunRequest
          BswMModeInitValue
            BswMSwcModeInitValue: BswMSwcModeInitValueRef=RELEASED
        ESH_Cond_RunRequest1IsReleased (BswMModeCondition): BswMConditionType=BSWM_EQUALS, BswMConditionMode=ESH_RunRequest_1
          BswMConditionValue
            BswMModeDeclaration: BswMModeValueRef=RELEASED
        ESH_RunRequest_1 (BswMModeRequestPort): BswMArbitrateOnInit=false, BswMRequestProcessing=BSWM_DEFERRED
          BswMModeRequestSource
            BswMSwcModeRequest: BswMModeRequestDataElementPrototypeName=requestedMode, BswMSwcModeRequestModeDeclarationGroupPrototypeRef=BswM_MDGP_ESH_RunRequest
          BswMModeInitValue
            BswMSwcModeInitValue: BswMSwcModeInitValueRef=RELEASED
        ESH_Cond_SelfRunReqTimerExpired (BswMModeCondition): BswMConditionType=BSWM_EQUALS, BswMConditionMode=ESH_SelfRunRequestTimer
          BswMConditionValue
            BswMBswMode: BswMBswRequestedMode=BSWM_TIMER_EXPIRED
        ESH_SelfRunRequestTimer (BswMModeRequestPort): BswMArbitrateOnInit=false, BswMRequestProcessing=BSWM_DEFERRED
          BswMModeRequestSource
            BswMTimer
          BswMModeInitValue
            BswMBswModeInitValue: BswMBswModeInitValueMode=BSWM_TIMER_STOPPED
        ESH_Cond_ModeIsRun (BswMModeCondition): BswMConditionType=BSWM_EQUALS, BswMConditionMode=ESH_ModeNotification
          BswMConditionValue
            BswMModeDeclaration: BswMModeValueRef=RUN
        ESH_ModeNotification (BswMModeRequestPort): BswMArbitrateOnInit=false, BswMRequestProcessing=BSWM_DEFERRED
          BswMModeRequestSource
            BswMSwcModeNotification: BswMSwcModeNotificationModeDeclarationGroupPrototypeRef=BswM_MDGP_ESH_Mode
          BswMModeInitValue
            BswMSwcModeInitValue: BswMSwcModeInitValueRef=STARTUP
        ESH_RunToPostRunNested (BswMRule):
          BswMNestedExecutionOnly = true
          BswMRuleId = 10
          BswMRuleInitState = BSWM_FALSE
          BswMRuleExpressionRef = ESH_LE_ComMNoPendingRequests
          BswMRuleTrueActionList = ESH_AL_RunToPostRun
        ESH_LE_ComMNoPendingRequests (BswMLogicalExpression): BswMLogicalOperator=BSWM_AND, BswMArgumentRef=ESH_Cond_ComMNoPendingRequests
        ESH_Cond_ComMNoPendingRequests (BswMModeCondition): BswMConditionType=BSWM_EQUALS, BswMConditionMode=ESH_ComMPendingRequests
          BswMConditionValue
            BswMBswMode: BswMBswRequestedMode=ESH_COMM_NO_REQUEST
        ESH_ComMPendingRequests (BswMModeRequestPort): BswMArbitrateOnInit=false, BswMRequestProcessing=BSWM_DEFERRED
          BswMModeRequestSource
            BswMGenericRequest: BswMModeRequesterId=232, BswMRequestedModeMax=2
              ESH_COMM_NO_REQUEST (BswMGenericRequestMode): BswMGenericRequestModeValue=0
              ESH_COMM_PENDING_REQUEST (BswMGenericRequestMode): BswMGenericRequestModeValue=1
          BswMModeInitValue
            BswMBswModeInitValue: BswMBswModeInitValueMode=ESH_COMM_NO_REQUEST
        ESH_WaitToShutdown (BswMRule):
          BswMNestedExecutionOnly = false
          BswMRuleId = 11
          BswMRuleInitState = BSWM_FALSE
          BswMRuleExpressionRef = ESH_LE_WaitForNvMToShutdown
          BswMRuleTrueActionList = ESH_AL_WaitForNvMToShutdown
        ESH_LE_WaitForNvMToShutdown (BswMLogicalExpression): BswMLogicalOperator=BSWM_AND, BswMArgumentRef=ESH_Cond_StateIsWaitForNvm, BswMArgumentRef=ESH_LE_WriteNotPending, BswMArgumentRef=ESH_LE_NoWakeup
        ESH_Cond_StateIsWaitForNvm (BswMModeCondition): BswMConditionType=BSWM_EQUALS, BswMConditionMode=ESH_State
          BswMConditionValue
            BswMBswMode: BswMBswRequestedMode=ESH_WAIT_FOR_NVM
        ESH_LE_WriteNotPending (BswMLogicalExpression): BswMLogicalOperator=BSWM_OR, BswMArgumentRef=ESH_Cond_NvMWAIsNotPending, BswMArgumentRef=ESH_Cond_NvWWriteAllTimerNotRunning
        ESH_Cond_NvMWAIsNotPending (BswMModeCondition): BswMConditionType=BSWM_EQUALS_NOT, BswMConditionMode=ESH_NvMIndication
          BswMConditionValue
            BswMBswMode: BswMBswRequestedMode=NVM_REQ_PENDING
        ESH_NvMIndication (BswMModeRequestPort): BswMArbitrateOnInit=false, BswMRequestProcessing=BSWM_DEFERRED
          BswMModeRequestSource
            BswMNvMJobModeIndication: BswMNvmService=NvmWriteAll
          BswMModeInitValue
            BswMBswModeInitValue: BswMBswModeInitValueMode=NVM_REQ_OK
        ESH_Cond_NvWWriteAllTimerNotRunning (BswMModeCondition): BswMConditionType=BSWM_EQUALS_NOT, BswMConditionMode=ESH_NvM_WriteAllTimer
          BswMConditionValue
            BswMBswMode: BswMBswRequestedMode=BSWM_TIMER_STARTED
        ESH_NvM_WriteAllTimer (BswMModeRequestPort): BswMArbitrateOnInit=false, BswMRequestProcessing=BSWM_DEFERRED
          BswMModeRequestSource
            BswMTimer
          BswMModeInitValue
            BswMBswModeInitValue: BswMBswModeInitValueMode=BSWM_TIMER_STOPPED
        ESH_LE_NoWakeup (BswMLogicalExpression): BswMLogicalOperator=BSWM_AND, BswMArgumentRef=ESH_Cond_NoValidatedWakeups, BswMArgumentRef=ESH_Cond_ComMNoPendingRequests
        ESH_Cond_NoValidatedWakeups (BswMModeCondition): BswMConditionType=BSWM_EQUALS, BswMConditionMode=ESH_EcuM_GetValidatedWakeupEvents
          BswMConditionValue
            BswMBswMode: BswMBswRequestedMode=0
        ESH_EcuM_GetValidatedWakeupEvents (BswMModeRequestPort): BswMArbitrateOnInit=false, BswMRequestProcessing=BSWM_DEFERRED
          BswMModeRequestSource
            BswMUserConditionRequest: BswMUserCondition=EcuM_GetValidatedWakeupEvents()
        ESH_WakeupToPrep (BswMRule):
          BswMNestedExecutionOnly = false
          BswMRuleId = 13
          BswMRuleInitState = BSWM_FALSE
          BswMRuleExpressionRef = ESH_LE_WakeupToPrepShutdown
          BswMRuleTrueActionList = ESH_AL_WakeupToPrep
        ESH_LE_WakeupToPrepShutdown (BswMLogicalExpression):
          BswMLogicalOperator = BSWM_AND
          BswMArgumentRef = ESH_Cond_StateIsWakeup
          BswMArgumentRef = ESH_LE_CancelNotPending
          BswMArgumentRef = ESH_Cond_NoPendingWakeups
          BswMArgumentRef = ESH_LE_NoWakeup
          BswMArgumentRef = ESH_Cond_ModeIsWakeup
        ESH_Cond_StateIsWakeup (BswMModeCondition): BswMConditionType=BSWM_EQUALS, BswMConditionMode=ESH_State
          BswMConditionValue
            BswMBswMode: BswMBswRequestedMode=ESH_WAKEUP
        ESH_LE_CancelNotPending (BswMLogicalExpression): BswMLogicalOperator=BSWM_OR, BswMArgumentRef=ESH_Cond_NvMWAIsNotPending, BswMArgumentRef=ESH_Cond_NvWCancelTimerNotRunning
        ESH_Cond_NvWCancelTimerNotRunning (BswMModeCondition): BswMConditionType=BSWM_EQUALS_NOT, BswMConditionMode=ESH_NvM_CancelWriteAllTimer
          BswMConditionValue
            BswMBswMode: BswMBswRequestedMode=BSWM_TIMER_STARTED
        ESH_NvM_CancelWriteAllTimer (BswMModeRequestPort): BswMArbitrateOnInit=false, BswMRequestProcessing=BSWM_DEFERRED
          BswMModeRequestSource
            BswMTimer
          BswMModeInitValue
            BswMBswModeInitValue: BswMBswModeInitValueMode=BSWM_TIMER_STOPPED
        ESH_Cond_NoPendingWakeups (BswMModeCondition): BswMConditionType=BSWM_EQUALS, BswMConditionMode=ESH_EcuM_GetPendingWakeupEvents
          BswMConditionValue
            BswMBswMode: BswMBswRequestedMode=0
        ESH_EcuM_GetPendingWakeupEvents (BswMModeRequestPort): BswMArbitrateOnInit=false, BswMRequestProcessing=BSWM_DEFERRED
          BswMModeRequestSource
            BswMUserConditionRequest: BswMUserCondition=EcuM_GetPendingWakeupEvents()
        ESH_Cond_ModeIsWakeup (BswMModeCondition): BswMConditionType=BSWM_EQUALS, BswMConditionMode=ESH_ModeNotification
          BswMConditionValue
            BswMModeDeclaration: BswMModeValueRef=WAKEUP
        ESH_WaitToWakeup (BswMRule):
          BswMNestedExecutionOnly = false
          BswMRuleId = 12
          BswMRuleInitState = BSWM_FALSE
          BswMRuleExpressionRef = ESH_LE_WaitForNvMToWakeup
          BswMRuleTrueActionList = ESH_AL_WaitForNvMWakeup
        ESH_LE_WaitForNvMToWakeup (BswMLogicalExpression): BswMLogicalOperator=BSWM_AND, BswMArgumentRef=ESH_Cond_StateIsWaitForNvm, BswMArgumentRef=ESH_LE_ValidWakeup
        ESH_LE_ValidWakeup (BswMLogicalExpression): BswMLogicalOperator=BSWM_OR, BswMArgumentRef=ESH_Cond_ValidatedWakeups, BswMArgumentRef=ESH_Cond_ComMPendingRequests
        ESH_Cond_ValidatedWakeups (BswMModeCondition): BswMConditionType=BSWM_EQUALS_NOT, BswMConditionMode=ESH_EcuM_GetValidatedWakeupEvents
          BswMConditionValue
            BswMBswMode: BswMBswRequestedMode=0
        ESH_Cond_ComMPendingRequests (BswMModeCondition): BswMConditionType=BSWM_EQUALS, BswMConditionMode=ESH_ComMPendingRequests
          BswMConditionValue
            BswMBswMode: BswMBswRequestedMode=ESH_COMM_PENDING_REQUEST
        ESH_WakeupToRun (BswMRule):
          BswMNestedExecutionOnly = false
          BswMRuleId = 14
          BswMRuleInitState = BSWM_FALSE
          BswMRuleExpressionRef = ESH_LE_WakeupToRun
          BswMRuleTrueActionList = ESH_AL_WakeupToRun
        ESH_LE_WakeupToRun (BswMLogicalExpression):
          BswMLogicalOperator = BSWM_AND
          BswMArgumentRef = ESH_Cond_StateIsWakeup
          BswMArgumentRef = ESH_LE_ValidWakeup
          BswMArgumentRef = ESH_LE_CancelNotPending
          BswMArgumentRef = ESH_Cond_ModeIsWakeup
        ESH_DemInit (BswMRule):
          BswMNestedExecutionOnly = true
          BswMRuleId = 3
          BswMRuleInitState = BSWM_FALSE
          BswMRuleExpressionRef = ESH_LE_DemNotInitialized
          BswMRuleTrueActionList = ESH_AL_DemInit
        ESH_LE_DemNotInitialized (BswMLogicalExpression): BswMLogicalOperator=BSWM_OR, BswMArgumentRef=ESH_Cond_DemNotInitialized
        ESH_Cond_DemNotInitialized (BswMModeCondition): BswMConditionType=BSWM_EQUALS, BswMConditionMode=ESH_DemInitStatus
          BswMConditionValue
            BswMBswMode: BswMBswRequestedMode=DEM_NOT_INITIALIZED
        ESH_DemInitStatus (BswMModeRequestPort): BswMArbitrateOnInit=false, BswMRequestProcessing=BSWM_IMMEDIATE
          BswMModeRequestSource
            BswMGenericRequest: BswMModeRequesterId=231, BswMRequestedModeMax=2
              DEM_INITIALIZED (BswMGenericRequestMode): BswMGenericRequestModeValue=0
              DEM_NOT_INITIALIZED (BswMGenericRequestMode): BswMGenericRequestModeValue=1
          BswMModeInitValue
            BswMBswModeInitValue: BswMBswModeInitValueMode=DEM_INITIALIZED
        ESH_InitToWakeup (BswMRule):
          BswMNestedExecutionOnly = false
          BswMRuleId = 4
          BswMRuleInitState = BSWM_FALSE
          BswMRuleExpressionRef = ESH_LE_InitToWakeup
          BswMRuleTrueActionList = ESH_AL_InitToWakeup
        ESH_LE_InitToWakeup (BswMLogicalExpression): BswMLogicalOperator=BSWM_AND, BswMArgumentRef=ESH_Cond_StateIsInit
        ESH_Cond_StateIsInit (BswMModeCondition): BswMConditionType=BSWM_EQUALS, BswMConditionMode=ESH_State
          BswMConditionValue
            BswMBswMode: BswMBswRequestedMode=ESH_INIT
        ESH_PostRunToPrepNested (BswMRule):
          BswMNestedExecutionOnly = true
          BswMRuleId = 7
          BswMRuleInitState = BSWM_FALSE
          BswMRuleExpressionRef = ESH_LE_PostRunToPrep
          BswMRuleTrueActionList = ESH_AL_PostRunToPrepShutdown
        ESH_LE_PostRunToPrep (BswMLogicalExpression): BswMLogicalOperator=BSWM_AND, BswMArgumentRef=ESH_LE_PostRunReleased
        ESH_LE_PostRunReleased (BswMLogicalExpression): BswMLogicalOperator=BSWM_AND, BswMArgumentRef=ESH_Cond_PostRunRequest0IsReleased, BswMArgumentRef=ESH_Cond_PostRunRequest1IsReleased
        ESH_Cond_PostRunRequest0IsReleased (BswMModeCondition): BswMConditionType=BSWM_EQUALS, BswMConditionMode=ESH_PostRunRequest_0
          BswMConditionValue
            BswMModeDeclaration: BswMModeValueRef=RELEASED
        ESH_PostRunRequest_0 (BswMModeRequestPort): BswMArbitrateOnInit=false, BswMRequestProcessing=BSWM_DEFERRED
          BswMModeRequestSource
            BswMSwcModeRequest: BswMModeRequestDataElementPrototypeName=requestedMode, BswMSwcModeRequestModeDeclarationGroupPrototypeRef=BswM_MDGP_ESH_RunRequest
          BswMModeInitValue
            BswMSwcModeInitValue: BswMSwcModeInitValueRef=RELEASED
        ESH_Cond_PostRunRequest1IsReleased (BswMModeCondition): BswMConditionType=BSWM_EQUALS, BswMConditionMode=ESH_PostRunRequest_1
          BswMConditionValue
            BswMModeDeclaration: BswMModeValueRef=RELEASED
        ESH_PostRunRequest_1 (BswMModeRequestPort): BswMArbitrateOnInit=false, BswMRequestProcessing=BSWM_DEFERRED
          BswMModeRequestSource
            BswMSwcModeRequest: BswMModeRequestDataElementPrototypeName=requestedMode, BswMSwcModeRequestModeDeclarationGroupPrototypeRef=BswM_MDGP_ESH_RunRequest
          BswMModeInitValue
            BswMSwcModeInitValue: BswMSwcModeInitValueRef=RELEASED
        ESH_PostRunNested (BswMRule):
          BswMNestedExecutionOnly = true
          BswMRuleId = 6
          BswMRuleInitState = BSWM_FALSE
          BswMRuleExpressionRef = ESH_LE_RunRequestsOrWakeup
          BswMRuleFalseActionList = ESH_AL_ESH_PostRunToPrepCheck
          BswMRuleTrueActionList = ESH_AL_PostRunToRun
        ESH_LE_RunRequestsOrWakeup (BswMLogicalExpression): BswMLogicalOperator=BSWM_OR, BswMArgumentRef=ESH_LE_RunRequested, BswMArgumentRef=ESH_LE_ValidWakeup
        ESH_LE_RunRequested (BswMLogicalExpression): BswMLogicalOperator=BSWM_OR, BswMArgumentRef=ESH_Cond_RunRequest0IsRequested, BswMArgumentRef=ESH_Cond_RunRequest1IsRequested
        ESH_Cond_RunRequest0IsRequested (BswMModeCondition): BswMConditionType=BSWM_EQUALS, BswMConditionMode=ESH_RunRequest_0
          BswMConditionValue
            BswMModeDeclaration: BswMModeValueRef=REQUESTED
        ESH_Cond_RunRequest1IsRequested (BswMModeCondition): BswMConditionType=BSWM_EQUALS, BswMConditionMode=ESH_RunRequest_1
          BswMConditionValue
            BswMModeDeclaration: BswMModeValueRef=REQUESTED
        ESH_PostRun (BswMRule):
          BswMNestedExecutionOnly = false
          BswMRuleId = 5
          BswMRuleInitState = BSWM_FALSE
          BswMRuleExpressionRef = ESH_LE_PostRun
          BswMRuleTrueActionList = ESH_AL_ExitPostRun
        ESH_LE_PostRun (BswMLogicalExpression): BswMLogicalOperator=BSWM_AND, BswMArgumentRef=ESH_Cond_StateIsPostRun, BswMArgumentRef=ESH_Cond_ModeIsPostRun
        ESH_Cond_StateIsPostRun (BswMModeCondition): BswMConditionType=BSWM_EQUALS, BswMConditionMode=ESH_State
          BswMConditionValue
            BswMBswMode: BswMBswRequestedMode=ESH_POST_RUN
        ESH_Cond_ModeIsPostRun (BswMModeCondition): BswMConditionType=BSWM_EQUALS, BswMConditionMode=ESH_ModeNotification
          BswMConditionValue
            BswMModeDeclaration: BswMModeValueRef=POSTRUN
        ESH_PrepToWait (BswMRule):
          BswMNestedExecutionOnly = false
          BswMRuleId = 8
          BswMRuleInitState = BSWM_FALSE
          BswMRuleExpressionRef = ESH_LE_PrepShutdownToWaitForNvM
          BswMRuleTrueActionList = ESH_AL_PrepShutdownToWaitForNvM
        ESH_LE_PrepShutdownToWaitForNvM (BswMLogicalExpression): BswMLogicalOperator=BSWM_AND, BswMArgumentRef=ESH_Cond_StateIsPrepShutdown, BswMArgumentRef=ESH_Cond_ModeIsShutdown
        ESH_Cond_StateIsPrepShutdown (BswMModeCondition): BswMConditionType=BSWM_EQUALS, BswMConditionMode=ESH_State
          BswMConditionValue
            BswMBswMode: BswMBswRequestedMode=ESH_PREP_SHUTDOWN
        ESH_Cond_ModeIsShutdown (BswMModeCondition): BswMConditionType=BSWM_EQUALS, BswMConditionMode=ESH_ModeNotification
          BswMConditionValue
            BswMModeDeclaration: BswMModeValueRef=SHUTDOWN
      BswMModeControl: BswMInitActionListRef=INIT_AL_Initialize
        CC_AL_CAN_f26020e5_RX_Disable (BswMActionList): BswMActionListExecution=BSWM_TRIGGER
          CC_DisablePDUGroup_MyECU_oCAN_Rx_fcef2243 (BswMActionListItem): BswMAbortOnFail=false, BswMActionListItemIndex=0, BswMActionListItemRef=BswMModeControl/CC_DisablePDUGroup_MyECU_oCAN_Rx_fcef2243
        CC_DisablePDUGroup_MyECU_oCAN_Rx_fcef2243 (BswMAction)
          BswMAvailableActions
            BswMPduGroupSwitch: BswMPduGroupSwitchReinit=false, BswMDisabledPduGroupRef=MyECU_oCAN_Rx_fcef2243
        CC_AL_CAN_f26020e5_RX_EnableNoinit (BswMActionList): BswMActionListExecution=BSWM_TRIGGER
          CC_EnablePDUGroup_MyECU_oCAN_Rx_fcef2243 (BswMActionListItem): BswMAbortOnFail=false, BswMActionListItemIndex=0, BswMActionListItemRef=BswMModeControl/CC_EnablePDUGroup_MyECU_oCAN_Rx_fcef2243
        CC_EnablePDUGroup_MyECU_oCAN_Rx_fcef2243 (BswMAction)
          BswMAvailableActions
            BswMPduGroupSwitch: BswMPduGroupSwitchReinit=false, BswMEnabledPduGroupRef=MyECU_oCAN_Rx_fcef2243
        CC_AL_CAN_f26020e5_TX_Disable (BswMActionList): BswMActionListExecution=BSWM_TRIGGER
          CC_DisablePDUGroup_MyECU_oCAN_Tx_fcef2243 (BswMActionListItem): BswMAbortOnFail=false, BswMActionListItemIndex=0, BswMActionListItemRef=BswMModeControl/CC_DisablePDUGroup_MyECU_oCAN_Tx_fcef2243
        CC_DisablePDUGroup_MyECU_oCAN_Tx_fcef2243 (BswMAction)
          BswMAvailableActions
            BswMPduGroupSwitch: BswMPduGroupSwitchReinit=false, BswMDisabledPduGroupRef=MyECU_oCAN_Tx_fcef2243
        CC_AL_CAN_f26020e5_TX_EnableNoinit (BswMActionList): BswMActionListExecution=BSWM_TRIGGER
          CC_EnablePDUGroup_MyECU_oCAN_Tx_fcef2243 (BswMActionListItem): BswMAbortOnFail=false, BswMActionListItemIndex=0, BswMActionListItemRef=BswMModeControl/CC_EnablePDUGroup_MyECU_oCAN_Tx_fcef2243
        CC_EnablePDUGroup_MyECU_oCAN_Tx_fcef2243 (BswMAction)
          BswMAvailableActions
            BswMPduGroupSwitch: BswMPduGroupSwitchReinit=false, BswMEnabledPduGroupRef=MyECU_oCAN_Tx_fcef2243
        CC_AL_CAN_f26020e5_Disable_DM (BswMActionList): BswMActionListExecution=BSWM_TRIGGER
          CC_DisableDM_MyECU_oCAN_Rx_fcef2243 (BswMActionListItem): BswMAbortOnFail=false, BswMActionListItemIndex=0, BswMActionListItemRef=BswMModeControl/CC_DisableDM_MyECU_oCAN_Rx_fcef2243
        CC_DisableDM_MyECU_oCAN_Rx_fcef2243 (BswMAction)
          BswMAvailableActions
            BswMDeadlineMonitoringControl: BswMDisabledDMPduGroupRef=MyECU_oCAN_Rx_fcef2243
        CC_AL_CAN_f26020e5_Enable_DM (BswMActionList): BswMActionListExecution=BSWM_TRIGGER
          CC_EnableDM_MyECU_oCAN_Rx_fcef2243 (BswMActionListItem): BswMAbortOnFail=false, BswMActionListItemIndex=0, BswMActionListItemRef=BswMModeControl/CC_EnableDM_MyECU_oCAN_Rx_fcef2243
        CC_EnableDM_MyECU_oCAN_Rx_fcef2243 (BswMAction)
          BswMAvailableActions
            BswMDeadlineMonitoringControl: BswMEnabledDMPduGroupRef=MyECU_oCAN_Rx_fcef2243
        ESH_AL_ExitRun (BswMActionList): BswMActionListExecution=BSWM_CONDITION
          4 x BswMActionListItem, all with BswMAbortOnFail=false:
            ESH_Action_EnterExclusiveArea: BswMActionListItemIndex=0, BswMActionListItemRef=BswMModeControl/ESH_Action_EnterExclusiveArea
            ESH_Action_ComMCheckPendingRequests: BswMActionListItemIndex=1, BswMActionListItemRef=BswMModeControl/ESH_Action_ComMCheckPendingRequests
            ESH_RunToPostRunNested: BswMActionListItemIndex=2, BswMActionListItemRef=BswMArbitration/ESH_RunToPostRunNested
            ESH_Action_ExitExclusiveArea: BswMActionListItemIndex=3, BswMActionListItemRef=BswMModeControl/ESH_Action_ExitExclusiveArea
        ESH_Action_EnterExclusiveArea (BswMAction)
          BswMAvailableActions
            BswMUserCallout: BswMUserCalloutFunction=SchM_Enter_BswM_BSWM_EXCLUSIVE_AREA_0(), BswMCreateCallout=false, BswMUserIncludeFile=SchM_BswM.h
        ESH_Action_ComMCheckPendingRequests (BswMAction)
          BswMAvailableActions
            BswMUserCallout:
              BswMUserCalloutFunction = ESH_ComM_CheckPendingRequests()
              BswMCreateCallout = true
              BswMUserCode = ComM_StateType CAN_f26020e5 = COMM_NO_COM_NO_PENDING_REQUEST; (void)ComM_GetState(ComMConf_ComMChannel_CAN_f26020e5, &CAN_f26020e5); /* SBSW_BSWM_FCTCALL_LOCALVAR */ if(CAN_f26020e5 != COMM_NO_COM_NO_PENDING_REQUEST) { BswM_RequestMode(BSWM_GENERIC_ESH_ComMPendingRequests, BSWM_GENERICVALUE_ESH_ComMPendingRequests_ESH_COMM_PENDING_REQUEST); } else { BswM_RequestMode(BSWM_GENERIC_ESH_ComMPendingRequests, BSWM_GENERICVALUE_ESH_ComMPendingRequests_ESH_COMM_NO_REQUEST); }
        ESH_AL_RunToPostRun (BswMActionList): BswMActionListExecution=BSWM_CONDITION
          5 x BswMActionListItem, all with BswMAbortOnFail=false:
            ESH_Action_ComMDisallow_CAN_f26020e5: BswMActionListItemIndex=0, BswMActionListItemRef=BswMModeControl/ESH_Action_ComMDisallow_CAN_f26020e5
            ESH_Action_EcuMClearValidatedWakeupEvents: BswMActionListItemIndex=1, BswMActionListItemRef=BswMModeControl/ESH_Action_EcuMClearValidatedWakeupEvents
            ESH_Action_OnEnterPostRun: BswMActionListItemIndex=2, BswMActionListItemRef=BswMModeControl/ESH_Action_OnEnterPostRun
            ESH_Action_SwitchPostRun: BswMActionListItemIndex=3, BswMActionListItemRef=BswMModeControl/ESH_Action_SwitchPostRun
            ESH_Action_ESH_PostRun: BswMActionListItemIndex=4, BswMActionListItemRef=BswMModeControl/ESH_Action_ESH_PostRun
        4 x BswMAction:
          ESH_Action_ComMDisallow_CAN_f26020e5
            BswMAvailableActions
              BswMComMAllowCom: BswMComAllowed=false, BswMComMAllowChannelRef=ComMConfigSet/CAN_f26020e5
          ESH_Action_EcuMClearValidatedWakeupEvents
            BswMAvailableActions
              BswMUserCallout: BswMUserCalloutFunction=EcuM_ClearValidatedWakeupEvent(ECUM_WKSOURCE_ALL_SOURCES), BswMCreateCallout=false, BswMUserIncludeFile=EcuM.h
          ESH_Action_OnEnterPostRun
            BswMAvailableActions
              BswMUserCallout: BswMUserCalloutFunction=BswM_ESH_OnEnterPostRun(), BswMCreateCallout=true
          ESH_Action_SwitchPostRun
            BswMAvailableActions
              BswMRteSwitch: BswMSwitchedMode=POSTRUN, BswMRteSwitchPortRef=ESH_ModeSwitch
        ESH_ModeSwitch (BswMSwitchPort): BswMModeSwitchInterfaceRef=BswM_MSI_ESH_Mode
        ESH_Action_ESH_PostRun (BswMAction)
          BswMAvailableActions
            BswMGenericModeSwitch: BswMGenericRequestRef=ESH_State, BswMGenericRequestModeRef=ESH_POST_RUN
        ESH_Action_ExitExclusiveArea (BswMAction)
          BswMAvailableActions
            BswMUserCallout: BswMUserCalloutFunction=SchM_Exit_BswM_BSWM_EXCLUSIVE_AREA_0(), BswMCreateCallout=false, BswMUserIncludeFile=SchM_BswM.h
        ESH_AL_WaitForNvMToShutdown (BswMActionList): BswMActionListExecution=BSWM_CONDITION
          3 x BswMActionListItem, all with BswMAbortOnFail=false:
            ESH_Action_WriteAllTimer_Stop: BswMActionListItemIndex=0, BswMActionListItemRef=BswMModeControl/ESH_Action_WriteAllTimer_Stop
            ESH_Action_OnEnterShutdown: BswMActionListItemIndex=1, BswMActionListItemRef=BswMModeControl/ESH_Action_OnEnterShutdown
            ESH_Action_EcuMGoToSelectedShutdownTarget: BswMActionListItemIndex=2, BswMActionListItemRef=BswMModeControl/ESH_Action_EcuMGoToSelectedShutdownTarget
        3 x BswMAction:
          ESH_Action_WriteAllTimer_Stop
            BswMAvailableActions
              BswMTimerControl: BswMTimerAction=BSWM_TIMER_STOP, BswMTimerValue=0, BswMTimerRef=ESH_NvM_WriteAllTimer
          ESH_Action_OnEnterShutdown
            BswMAvailableActions
              BswMUserCallout: BswMUserCalloutFunction=BswM_ESH_OnEnterShutdown(), BswMCreateCallout=true
          ESH_Action_EcuMGoToSelectedShutdownTarget
            BswMAvailableActions
              BswMUserCallout: BswMUserCalloutFunction=(void)EcuM_GoToSelectedShutdownTarget(), BswMCreateCallout=false, BswMUserIncludeFile=EcuM.h
        ESH_AL_WakeupToPrep (BswMActionList): BswMActionListExecution=BSWM_CONDITION
          3 x BswMActionListItem, all with BswMAbortOnFail=false:
            ESH_Action_OnEnterPrepShutdown: BswMActionListItemIndex=0, BswMActionListItemRef=BswMModeControl/ESH_Action_OnEnterPrepShutdown
            ESH_Action_SwitchShutdown: BswMActionListItemIndex=1, BswMActionListItemRef=BswMModeControl/ESH_Action_SwitchShutdown
            ESH_Action_ESH_PrepShutdown: BswMActionListItemIndex=2, BswMActionListItemRef=BswMModeControl/ESH_Action_ESH_PrepShutdown
        3 x BswMAction:
          ESH_Action_OnEnterPrepShutdown
            BswMAvailableActions
              BswMUserCallout: BswMUserCalloutFunction=BswM_ESH_OnEnterPrepShutdown(), BswMCreateCallout=true
          ESH_Action_SwitchShutdown
            BswMAvailableActions
              BswMRteSwitch: BswMSwitchedMode=SHUTDOWN, BswMRteSwitchPortRef=ESH_ModeSwitch
          ESH_Action_ESH_PrepShutdown
            BswMAvailableActions
              BswMGenericModeSwitch: BswMGenericRequestRef=ESH_State, BswMGenericRequestModeRef=ESH_PREP_SHUTDOWN
        ESH_AL_WaitForNvMWakeup (BswMActionList): BswMActionListExecution=BSWM_CONDITION
          6 x BswMActionListItem, all with BswMAbortOnFail=false:
            ESH_Action_WriteAllTimer_Stop: BswMActionListItemIndex=0, BswMActionListItemRef=BswMModeControl/ESH_Action_WriteAllTimer_Stop
            ESH_Action_CancelWriteAllTimer_Start: BswMActionListItemIndex=1, BswMActionListItemRef=BswMModeControl/ESH_Action_CancelWriteAllTimer_Start
            ESH_Action_CancelNvMWriteAll: BswMActionListItemIndex=2, BswMActionListItemRef=BswMModeControl/ESH_Action_CancelNvMWriteAll
            ESH_Action_OnEnterWakeup: BswMActionListItemIndex=3, BswMActionListItemRef=BswMModeControl/ESH_Action_OnEnterWakeup
            ESH_Action_SwitchWakeup: BswMActionListItemIndex=4, BswMActionListItemRef=BswMModeControl/ESH_Action_SwitchWakeup
            ESH_Action_ESH_Wakeup: BswMActionListItemIndex=5, BswMActionListItemRef=BswMModeControl/ESH_Action_ESH_Wakeup
        5 x BswMAction:
          ESH_Action_CancelWriteAllTimer_Start
            BswMAvailableActions
              BswMTimerControl: BswMTimerAction=BSWM_TIMER_START, BswMTimerValue=60, BswMTimerRef=ESH_NvM_CancelWriteAllTimer
          ESH_Action_CancelNvMWriteAll
            BswMAvailableActions
              BswMUserCallout: BswMUserCalloutFunction=NvM_CancelWriteAll(), BswMCreateCallout=false, BswMUserIncludeFile=NvM.h
          ESH_Action_OnEnterWakeup
            BswMAvailableActions
              BswMUserCallout: BswMUserCalloutFunction=BswM_ESH_OnEnterWakeup(), BswMCreateCallout=true
          ESH_Action_SwitchWakeup
            BswMAvailableActions
              BswMRteSwitch: BswMSwitchedMode=WAKEUP, BswMRteSwitchPortRef=ESH_ModeSwitch
          ESH_Action_ESH_Wakeup
            BswMAvailableActions
              BswMGenericModeSwitch: BswMGenericRequestRef=ESH_State, BswMGenericRequestModeRef=ESH_WAKEUP
        ESH_AL_WakeupToRun (BswMActionList): BswMActionListExecution=BSWM_CONDITION
          8 x BswMActionListItem, all with BswMAbortOnFail=false:
            ESH_Action_CancelWriteAllTimer_Stop: BswMActionListItemIndex=0, BswMActionListItemRef=BswMModeControl/ESH_Action_CancelWriteAllTimer_Stop
            ESH_DemInit: BswMActionListItemIndex=1, BswMActionListItemRef=BswMArbitration/ESH_DemInit
            ESH_Action_ComMAllow_CAN_f26020e5: BswMActionListItemIndex=2, BswMActionListItemRef=BswMModeControl/ESH_Action_ComMAllow_CAN_f26020e5
            ESH_Action_SelfRunRequestTimer_Start: BswMActionListItemIndex=3, BswMActionListItemRef=BswMModeControl/ESH_Action_SelfRunRequestTimer_Start
            ESH_Action_OnEnterRun: BswMActionListItemIndex=4, BswMActionListItemRef=BswMModeControl/ESH_Action_OnEnterRun
            ESH_Action_SwitchRun: BswMActionListItemIndex=5, BswMActionListItemRef=BswMModeControl/ESH_Action_SwitchRun
            ESH_Action_ESH_Run: BswMActionListItemIndex=6, BswMActionListItemRef=BswMModeControl/ESH_Action_ESH_Run
            RTE_REQUEST_BswMRteModeRequestPort_REQUESTED: BswMActionListItemIndex=7, BswMActionListItemRef=BswMModeControl/RTE_REQUEST_BswMRteModeRequestPort_REQUESTED
        ESH_Action_CancelWriteAllTimer_Stop (BswMAction)
          BswMAvailableActions
            BswMTimerControl: BswMTimerAction=BSWM_TIMER_STOP, BswMTimerValue=0, BswMTimerRef=ESH_NvM_CancelWriteAllTimer
        ESH_AL_DemInit (BswMActionList): BswMActionListExecution=BSWM_CONDITION
          ESH_Action_DemInit (BswMActionListItem): BswMAbortOnFail=false, BswMActionListItemIndex=0, BswMActionListItemRef=BswMModeControl/ESH_Action_DemInit
          ESH_Action_DemInitialized (BswMActionListItem): BswMAbortOnFail=false, BswMActionListItemIndex=1, BswMActionListItemRef=BswMModeControl/ESH_Action_DemInitialized
        7 x BswMAction:
          ESH_Action_DemInit
            BswMAvailableActions
              BswMUserCallout: BswMUserCalloutFunction=Dem_Init(Dem_Config_Ptr), BswMCreateCallout=false, BswMUserIncludeFile=Dem.h
          ESH_Action_DemInitialized
            BswMAvailableActions
              BswMGenericModeSwitch: BswMGenericRequestRef=ESH_DemInitStatus, BswMGenericRequestModeRef=DEM_INITIALIZED
          ESH_Action_ComMAllow_CAN_f26020e5
            BswMAvailableActions
              BswMComMAllowCom: BswMComAllowed=true, BswMComMAllowChannelRef=ComMConfigSet/CAN_f26020e5
          ESH_Action_SelfRunRequestTimer_Start
            BswMAvailableActions
              BswMTimerControl: BswMTimerAction=BSWM_TIMER_START, BswMTimerValue=0.1, BswMTimerRef=ESH_SelfRunRequestTimer
          ESH_Action_OnEnterRun
            BswMAvailableActions
              BswMUserCallout: BswMUserCalloutFunction=BswM_ESH_OnEnterRun(), BswMCreateCallout=true
          ESH_Action_SwitchRun
            BswMAvailableActions
              BswMRteSwitch: BswMSwitchedMode=RUN, BswMRteSwitchPortRef=ESH_ModeSwitch
          ESH_Action_ESH_Run
            BswMAvailableActions
              BswMGenericModeSwitch: BswMGenericRequestRef=ESH_State, BswMGenericRequestModeRef=ESH_RUN
        ESH_AL_InitToWakeup (BswMActionList): BswMActionListExecution=BSWM_CONDITION
          3 x BswMActionListItem, all with BswMAbortOnFail=false:
            ESH_Action_OnEnterWakeup: BswMActionListItemIndex=0, BswMActionListItemRef=BswMModeControl/ESH_Action_OnEnterWakeup
            ESH_Action_SwitchWakeup: BswMActionListItemIndex=1, BswMActionListItemRef=BswMModeControl/ESH_Action_SwitchWakeup
            ESH_Action_ESH_Wakeup: BswMActionListItemIndex=2, BswMActionListItemRef=BswMModeControl/ESH_Action_ESH_Wakeup
        ESH_AL_PostRunToPrepShutdown (BswMActionList): BswMActionListExecution=BSWM_CONDITION
          5 x BswMActionListItem, all with BswMAbortOnFail=false:
            ESH_Action_DemShutdown: BswMActionListItemIndex=0, BswMActionListItemRef=BswMModeControl/ESH_Action_DemShutdown
            ESH_Action_DemNotInitialized: BswMActionListItemIndex=1, BswMActionListItemRef=BswMModeControl/ESH_Action_DemNotInitialized
            ESH_Action_OnEnterPrepShutdown: BswMActionListItemIndex=2, BswMActionListItemRef=BswMModeControl/ESH_Action_OnEnterPrepShutdown
            ESH_Action_SwitchShutdown: BswMActionListItemIndex=3, BswMActionListItemRef=BswMModeControl/ESH_Action_SwitchShutdown
            ESH_Action_ESH_PrepShutdown: BswMActionListItemIndex=4, BswMActionListItemRef=BswMModeControl/ESH_Action_ESH_PrepShutdown
        ESH_Action_DemShutdown (BswMAction)
          BswMAvailableActions
            BswMUserCallout: BswMUserCalloutFunction=Dem_Shutdown(), BswMCreateCallout=false, BswMUserIncludeFile=Dem.h
        ESH_Action_DemNotInitialized (BswMAction)
          BswMAvailableActions
            BswMGenericModeSwitch: BswMGenericRequestRef=ESH_DemInitStatus, BswMGenericRequestModeRef=DEM_NOT_INITIALIZED
        4 x BswMActionList, all with BswMActionListExecution=BSWM_CONDITION:
          ESH_AL_ESH_PostRunToPrepCheck
            ESH_PostRunToPrepNested (BswMActionListItem): BswMAbortOnFail=false, BswMActionListItemIndex=0, BswMActionListItemRef=BswMArbitration/ESH_PostRunToPrepNested
          ESH_AL_PostRunToRun
            5 x BswMActionListItem, all with BswMAbortOnFail=false:
              ESH_Action_ComMAllow_CAN_f26020e5: BswMActionListItemIndex=0, BswMActionListItemRef=BswMModeControl/ESH_Action_ComMAllow_CAN_f26020e5
              ESH_Action_SelfRunRequestTimer_Start: BswMActionListItemIndex=1, BswMActionListItemRef=BswMModeControl/ESH_Action_SelfRunRequestTimer_Start
              ESH_Action_OnEnterRun: BswMActionListItemIndex=2, BswMActionListItemRef=BswMModeControl/ESH_Action_OnEnterRun
              ESH_Action_SwitchRun: BswMActionListItemIndex=3, BswMActionListItemRef=BswMModeControl/ESH_Action_SwitchRun
              ESH_Action_ESH_Run: BswMActionListItemIndex=4, BswMActionListItemRef=BswMModeControl/ESH_Action_ESH_Run
          ESH_AL_ExitPostRun
            4 x BswMActionListItem, all with BswMAbortOnFail=false:
              ESH_Action_EnterExclusiveArea: BswMActionListItemIndex=0, BswMActionListItemRef=BswMModeControl/ESH_Action_EnterExclusiveArea
              ESH_Action_ComMCheckPendingRequests: BswMActionListItemIndex=1, BswMActionListItemRef=BswMModeControl/ESH_Action_ComMCheckPendingRequests
              ESH_PostRunNested: BswMActionListItemIndex=2, BswMActionListItemRef=BswMArbitration/ESH_PostRunNested
              ESH_Action_ExitExclusiveArea: BswMActionListItemIndex=3, BswMActionListItemRef=BswMModeControl/ESH_Action_ExitExclusiveArea
          ESH_AL_PrepShutdownToWaitForNvM
            5 x BswMActionListItem, all with BswMAbortOnFail=false:
              ESH_Action_WriteAllTimer_Start: BswMActionListItemIndex=0, BswMActionListItemRef=BswMModeControl/ESH_Action_WriteAllTimer_Start
              ESH_Action_NvMWriteAll: BswMActionListItemIndex=1, BswMActionListItemRef=BswMModeControl/ESH_Action_NvMWriteAll
              ESH_Action_ComMCheckPendingRequests: BswMActionListItemIndex=2, BswMActionListItemRef=BswMModeControl/ESH_Action_ComMCheckPendingRequests
              ESH_Action_OnEnterWaitForNvm: BswMActionListItemIndex=3, BswMActionListItemRef=BswMModeControl/ESH_Action_OnEnterWaitForNvm
              ESH_Action_ESH_WaitForNvm: BswMActionListItemIndex=4, BswMActionListItemRef=BswMModeControl/ESH_Action_ESH_WaitForNvm
        4 x BswMAction:
          ESH_Action_WriteAllTimer_Start
            BswMAvailableActions
              BswMTimerControl: BswMTimerAction=BSWM_TIMER_START, BswMTimerValue=60, BswMTimerRef=ESH_NvM_WriteAllTimer
          ESH_Action_NvMWriteAll
            BswMAvailableActions
              BswMUserCallout: BswMUserCalloutFunction=NvM_WriteAll(), BswMCreateCallout=false, BswMUserIncludeFile=NvM.h
          ESH_Action_OnEnterWaitForNvm
            BswMAvailableActions
              BswMUserCallout: BswMUserCalloutFunction=BswM_ESH_OnEnterWaitForNvm(), BswMCreateCallout=true
          ESH_Action_ESH_WaitForNvm
            BswMAvailableActions
              BswMGenericModeSwitch: BswMGenericRequestRef=ESH_State, BswMGenericRequestModeRef=ESH_WAIT_FOR_NVM
        INIT_AL_Initialize (BswMActionList): BswMActionListExecution=BSWM_CONDITION
          19 x BswMActionListItem, all with BswMAbortOnFail=false:
            INIT_Action_Can_Init: BswMActionListItemIndex=0, BswMActionListItemRef=BswMModeControl/INIT_Action_Can_Init
            INIT_Action_CanIf_Init: BswMActionListItemIndex=1, BswMActionListItemRef=BswMModeControl/INIT_Action_CanIf_Init
            INIT_Action_WdgM_Init: BswMActionListItemIndex=2, BswMActionListItemRef=BswMModeControl/INIT_Action_WdgM_Init
            INIT_Action_Com_Init: BswMActionListItemIndex=3, BswMActionListItemRef=BswMModeControl/INIT_Action_Com_Init
            INIT_Action_PduR_Init: BswMActionListItemIndex=4, BswMActionListItemRef=BswMModeControl/INIT_Action_PduR_Init
            INIT_Action_CanSM_Init: BswMActionListItemIndex=5, BswMActionListItemRef=BswMModeControl/INIT_Action_CanSM_Init
            INIT_Action_CanNm_Init: BswMActionListItemIndex=6, BswMActionListItemRef=BswMModeControl/INIT_Action_CanNm_Init
            INIT_Action_Nm_Init: BswMActionListItemIndex=7, BswMActionListItemRef=BswMModeControl/INIT_Action_Nm_Init
            INIT_Action_CanTp_Init: BswMActionListItemIndex=8, BswMActionListItemRef=BswMModeControl/INIT_Action_CanTp_Init
            INIT_Action_CanXcp_Init: BswMActionListItemIndex=9, BswMActionListItemRef=BswMModeControl/INIT_Action_CanXcp_Init
            INIT_Action_Xcp_Init: BswMActionListItemIndex=10, BswMActionListItemRef=BswMModeControl/INIT_Action_Xcp_Init
            INIT_Action_NvM_Init: BswMActionListItemIndex=11, BswMActionListItemRef=BswMModeControl/INIT_Action_NvM_Init
            INIT_Action_NvMReadAll: BswMActionListItemIndex=12, BswMActionListItemRef=BswMModeControl/INIT_Action_NvMReadAll
            INIT_Action_EnableInterrupts: BswMActionListItemIndex=13, BswMActionListItemRef=BswMModeControl/INIT_Action_EnableInterrupts
            INIT_Action_ComM_Init: BswMActionListItemIndex=14, BswMActionListItemRef=BswMModeControl/INIT_Action_ComM_Init
            INIT_Action_Dcm_Init: BswMActionListItemIndex=15, BswMActionListItemRef=BswMModeControl/INIT_Action_Dcm_Init
            INIT_Action_Dem_Init: BswMActionListItemIndex=16, BswMActionListItemRef=BswMModeControl/INIT_Action_Dem_Init
            INIT_Action_IoHwAb_Init: BswMActionListItemIndex=17, BswMActionListItemRef=BswMModeControl/INIT_Action_IoHwAb_Init
            INIT_Action_RteStart: BswMActionListItemIndex=18, BswMActionListItemRef=BswMModeControl/INIT_Action_RteStart
        19 x BswMAction:
          INIT_Action_Can_Init
            BswMAvailableActions
              BswMUserCallout: BswMUserCalloutFunction=Can_Init(Can_Config_Ptr), BswMCreateCallout=false, BswMUserIncludeFile=Can.h
          INIT_Action_CanIf_Init
            BswMAvailableActions
              BswMUserCallout: BswMUserCalloutFunction=CanIf_Init(CanIf_Config_Ptr), BswMCreateCallout=false, BswMUserIncludeFile=CanIf.h
          INIT_Action_WdgM_Init
            BswMAvailableActions
              BswMUserCallout: BswMUserCalloutFunction=WdgM_Init(&WdgMConfig_Mode0_core0), BswMCreateCallout=false, BswMUserIncludeFile=WdgM.h
          INIT_Action_Com_Init
            BswMAvailableActions
              BswMUserCallout: BswMUserCalloutFunction=Com_Init(Com_Config_Ptr), BswMCreateCallout=false, BswMUserIncludeFile=Com.h
          INIT_Action_PduR_Init
            BswMAvailableActions
              BswMUserCallout: BswMUserCalloutFunction=PduR_Init(PduR_Config_Ptr), BswMCreateCallout=false, BswMUserIncludeFile=PduR.h
          INIT_Action_CanSM_Init
            BswMAvailableActions
              BswMUserCallout: BswMUserCalloutFunction=CanSM_Init(CanSM_Config_Ptr), BswMCreateCallout=false, BswMUserIncludeFile=CanSM_EcuM.h
          INIT_Action_CanNm_Init
            BswMAvailableActions
              BswMUserCallout: BswMUserCalloutFunction=CanNm_Init(CanNm_Config_Ptr), BswMCreateCallout=false, BswMUserIncludeFile=CanNm.h
          INIT_Action_Nm_Init
            BswMAvailableActions
              BswMUserCallout: BswMUserCalloutFunction=Nm_Init(), BswMCreateCallout=false, BswMUserIncludeFile=Nm.h
          INIT_Action_CanTp_Init
            BswMAvailableActions
              BswMUserCallout: BswMUserCalloutFunction=CanTp_Init(CanTp_Config_Ptr), BswMCreateCallout=false, BswMUserIncludeFile=CanTp.h
          INIT_Action_CanXcp_Init
            BswMAvailableActions
              BswMUserCallout: BswMUserCalloutFunction=CanXcp_Init(NULL_PTR), BswMCreateCallout=false, BswMUserIncludeFile=CanXcp.h
          INIT_Action_Xcp_Init
            BswMAvailableActions
              BswMUserCallout: BswMUserCalloutFunction=Xcp_Init(), BswMCreateCallout=false, BswMUserIncludeFile=Xcp.h
          INIT_Action_NvM_Init
            BswMAvailableActions
              BswMUserCallout: BswMUserCalloutFunction=NvM_Init(), BswMCreateCallout=false, BswMUserIncludeFile=NvM.h
          INIT_Action_NvMReadAll
            BswMAvailableActions
              BswMUserCallout: BswMUserCalloutFunction=BswM_INIT_NvMReadAll(), BswMCreateCallout=true
          INIT_Action_EnableInterrupts
            BswMAvailableActions
              BswMUserCallout: BswMUserCalloutFunction=BswM_AL_SetProgrammableInterrupts(), BswMCreateCallout=true
          INIT_Action_ComM_Init
            BswMAvailableActions
              BswMUserCallout: BswMUserCalloutFunction=ComM_Init(), BswMCreateCallout=false, BswMUserIncludeFile=ComM.h
          INIT_Action_Dcm_Init
            BswMAvailableActions
              BswMUserCallout: BswMUserCalloutFunction=Dcm_Init(NULL_PTR), BswMCreateCallout=false, BswMUserIncludeFile=Dcm.h
          INIT_Action_Dem_Init
            BswMAvailableActions
              BswMUserCallout: BswMUserCalloutFunction=Dem_Init(Dem_Config_Ptr), BswMCreateCallout=false, BswMUserIncludeFile=Dem.h
          INIT_Action_IoHwAb_Init
            BswMAvailableActions
              BswMUserCallout: BswMUserCalloutFunction=IoHwAb_Init(), BswMCreateCallout=false, BswMUserIncludeFile=IoHwAb.h
          INIT_Action_RteStart
            BswMAvailableActions
              BswMUserCallout: BswMUserCalloutFunction=(void)Rte_Start(), BswMCreateCallout=false, BswMUserIncludeFile=Rte_Main.h
        BswMRteModeRequestPort: BswMRteModeInitValue=REQUESTED, BswMRteModeRequestPortInterfaceRef=BswM.Request_ESH_RunRequest_0.requestedMode
        RTE_REQUEST_BswMRteModeRequestPort_REQUESTED (BswMAction)
          BswMAvailableActions
            BswMRteModeRequest: BswMRequestedMode=REQUESTED, BswMRteModeRequestPortRef=BswMRteModeRequestPort
      ESH_Mode (BswMRteModeDclGroup): BswMInitMode=STARTUP
        5 x BswMRteMode:
          STARTUP: BswMModePhysicalValue=0
          RUN: BswMModePhysicalValue=1
          POSTRUN: BswMModePhysicalValue=2
          WAKEUP: BswMModePhysicalValue=3
          SHUTDOWN: BswMModePhysicalValue=4
      ESH_RunRequest (BswMRteModeDclGroup): BswMInitMode=RELEASED
        RELEASED (BswMRteMode): BswMModePhysicalValue=0
        REQUESTED (BswMRteMode): BswMModePhysicalValue=1
      BswMDataTypeMappingSets: BswMDataTypeMappingSetRef=BswMMappingSet
  module config Nm: implementation-config-variant=VARIANT-PRE-COMPILE, module-description=Nm_Impl
    CAN_f26020e5 (NmChannelConfig):  # CN_CAN
      NmChannelId = 0
      NmChannelSleepMaster = false
      NmStateReportEnabled = false
      NmSynchronizingNetwork = false
      NmPassiveModeEnabled = false
      NmComMChannelRef = ComMConfigSet/CAN_f26020e5
      CAN_17d0077e (NmBusType)
        NmStandardBusNmConfig: NmStandardBusType=NM_BUSNM_CANNM  # CAN
    NmGlobalConfig
      NmGlobalFeatures:
        NmComUserDataSupport = true
        NmNodeIdEnabled = true
        NmUserDataEnabled = true
        NmBusSynchronizationEnabled = false
        NmCarWakeUpRxEnabled = false
        NmComControlEnabled = false
        NmCoordinatorSupportEnabled = false
        NmNodeDetectionEnabled = false
        NmPduRxIndicationEnabled = false
        NmRemoteSleepIndEnabled = false
        NmRepeatMsgIndEnabled = false
        NmStateChangeIndEnabled = false
        NmMacroLayerEnabled = false
        NmCoordinatorSyncSupport = false
        NmRuntimeMeasurementSupport = false
        NmCoordinatorRequestChannelsInBusSleep = false
        NmCoordinatorPassiveStartUpForwarding = false
      NmGeneration:
        NmOutOfBoundsWriteSanitizer = false
        NmOutOfBoundsReadSanitizer = false
        NmShortSymbols = false
        NmInterfacesForDeactivatedData = false
        NmReferringKeysInComments = false
      NmGlobalProperties: NmDevErrorDetect=true, NmVersionInfoApi=false, NmSafeBswChecks=false
      NmGlobalConstants
  module config Crc: implementation-config-variant=VARIANT-PRE-COMPILE, module-description=Crc_Impl
    CrcGeneral:
      Crc16Mode = CRC_16_RUNTIME
      Crc32Mode = CRC_32_RUNTIME
      Crc8H2FMode = CRC_8H2F_RUNTIME
      Crc8Mode = CRC_8_RUNTIME
      CrcVersionInfoApi = true
      Crc32P4Mode = CRC_32P4_RUNTIME
      Crc64Mode = CRC_64_RUNTIME
  module config IoHwAb: implementation-config-variant=VARIANT-PRE-COMPILE, module-description=IoHwAb_Impl
    IoHwAbDatatypes
      9 x IoHwAbBaseType:
        float64: IoHwAbBaseDataType=IOHWAB_FLOAT64
        float32: IoHwAbBaseDataType=IOHWAB_FLOAT32
        sint32: IoHwAbBaseDataType=IOHWAB_SINT32
        sint16: IoHwAbBaseDataType=IOHWAB_SINT16
        sint8: IoHwAbBaseDataType=IOHWAB_SINT8
        uint32: IoHwAbBaseDataType=IOHWAB_UINT32
        uint16: IoHwAbBaseDataType=IOHWAB_UINT16
        uint8: IoHwAbBaseDataType=IOHWAB_UINT8
        boolean: IoHwAbBaseDataType=IOHWAB_BOOL
      IoHwAbImplementationTypes
    IoHwAbGeneral: IoHwAbDevErrorDetect=true, IoHwAbVersionInfoApi=false, IoHwAbUseInitFunction=true
  module config MemIf: implementation-config-variant=VARIANT-PRE-COMPILE, module-description=MemIf_Impl
    MemIfGeneral: MemIfDevErrorDetect=true, MemIfVersionInfoApi=false, MemIfSafeBswChecks=false
    MemIfMemHwA: MemIfMemHwAId=0, MemIfMemHwARef=FeeGeneral
  module config NvM: implementation-config-variant=VARIANT-PRE-COMPILE, module-description=NvM_Impl
    NvMConfigBlock (NvMBlockDescriptor):
      NvMBlockCrcType = NVM_CRC16
      NvMBlockManagementType = NVM_BLOCK_REDUNDANT
      NvMInitBlockCallback = NULL_PTR
      NvMResistantToChangedSw = true
      NvMSelectBlockForReadAll = true
      NvMSelectBlockForWriteAll = true
      NvMUseInitCallback = false
      NvMUseJobendCallback = false
      NvMSingleBlockCallback = NULL_PTR
      NvMBswMBlockStatusInformation = false
      NvMBlockUseCrc = true
      NvMBlockUseSyncMechanism = false
      NvMCalcRamBlockCrc = false
      NvMUseServicePorts = false
      NvMNvramBlockIdentifier = 1
      NvMNvBlockNum = 2
      NvMNvBlockLength = 2
      NvMRomBlockDataAddress = NULL_PTR
      NvMBlockJobPriority = 127
      NvMBlockWriteProt = false
      NvMWriteBlockOnce = false
      NvMBlockUseCRCCompMechanism = false
      NvMTargetBlockReference
        NvMFeeRef: NvMNameOfFeeBlock=FeeConfigBlock
    NvMCommon:
      NvMDevErrorDetect = true
      NvMVersionInfoApi = false
      NvMApiConfigClass = NVM_API_CONFIG_CLASS_3
      NvMBswMMultiBlockJobStatusInformation = true
      NvMCompiledConfigId = 1
      NvMCrcNumOfBytes = 64
      NvMDatasetSelectionBits = 4
      NvMDrvModeSwitch = true
      NvMDynamicConfiguration = false
      NvMJobPrioritization = false
      NvMPollingMode = false
      NvMSetRamBlockStatusApi = true
      NvMSizeStandardJobQueue = 8
      NvMMaxNoOfWriteRetries = 1
      NvMMainFunctionPeriod = 0.01
      NvMUseBlockIdCheck = false
      NvMRepairRedundantBlocksApi = false
      NvMSafeBswChecks = false
    NvMCommonVendorParams: NvMMultiblockId=MultiBlockRequest, NvMCrcIntBuffer=true, NvMKillWriteAllApi=true, NvMCfgCbkIncludeList=Dem_Cbk.h
    11 x NvMBlockDescriptor, all with NvMBlockCrcType=NVM_CRC16, NvMBlockManagementType=NVM_BLOCK_NATIVE, NvMResistantToChangedSw=true, NvMUseJobendCallback=true, NvMBswMBlockStatusInformation=false, NvMBlockUseCrc=true, NvMBlockUseSyncMechanism=false, NvMCalcRamBlockCrc=false, NvMBlockJobPriority=127, NvMBlockWriteProt=false, NvMNvBlockNum=1, NvMWriteBlockOnce=false, NvMBlockUseCRCCompMechanism=false:
      DemAdminDataBlock: NvMInitBlockCallback=Dem_NvM_InitAdminData, NvMSelectBlockForReadAll=true, NvMSelectBlockForWriteAll=true, NvMUseInitCallback=true, NvMSingleBlockCallback=Dem_NvM_JobFinished, NvMNvBlockLength=14, NvMNvramBlockIdentifier=2, NvMUseServicePorts=false, NvMRamBlockDataAddress=Dem_Cfg_AdminData, NvMRomBlockDataAddress=NULL_PTR
        NvMTargetBlockReference
          NvMFeeRef: NvMNameOfFeeBlock=FeeDemAdminDataBlock
      DemStatusDataBlock: NvMInitBlockCallback=Dem_NvM_InitStatusData, NvMSelectBlockForReadAll=true, NvMSelectBlockForWriteAll=true, NvMUseInitCallback=true, NvMSingleBlockCallback=Dem_NvM_JobFinished, NvMNvBlockLength=16, NvMNvramBlockIdentifier=4, NvMUseServicePorts=false, NvMRamBlockDataAddress=Dem_Cfg_StatusData, NvMRomBlockDataAddress=NULL_PTR
        NvMTargetBlockReference
          NvMFeeRef: NvMNameOfFeeBlock=FeeDemStatusDataBlock
      DemPrimaryDataBlock0: NvMInitBlockCallback=NULL_PTR, NvMSelectBlockForReadAll=true, NvMSelectBlockForWriteAll=true, NvMUseInitCallback=false, NvMSingleBlockCallback=Dem_NvM_JobFinished, NvMNvBlockLength=20, NvMNvramBlockIdentifier=5, NvMUseServicePorts=false, NvMRamBlockDataAddress=Dem_Cfg_PrimaryEntry_0, NvMRomBlockDataAddress=Dem_Cfg_MemoryEntryInit
        NvMTargetBlockReference
          NvMFeeRef: NvMNameOfFeeBlock=FeeDemPrimaryDataBlock0
      DemPrimaryDataBlock1: NvMInitBlockCallback=NULL_PTR, NvMSelectBlockForReadAll=true, NvMSelectBlockForWriteAll=true, NvMUseInitCallback=false, NvMSingleBlockCallback=Dem_NvM_JobFinished, NvMNvBlockLength=20, NvMNvramBlockIdentifier=6, NvMUseServicePorts=false, NvMRamBlockDataAddress=Dem_Cfg_PrimaryEntry_1, NvMRomBlockDataAddress=Dem_Cfg_MemoryEntryInit
        NvMTargetBlockReference
          NvMFeeRef: NvMNameOfFeeBlock=FeeDemPrimaryDataBlock1
      DemPrimaryDataBlock2: NvMInitBlockCallback=NULL_PTR, NvMSelectBlockForReadAll=true, NvMSelectBlockForWriteAll=true, NvMUseInitCallback=false, NvMSingleBlockCallback=Dem_NvM_JobFinished, NvMNvBlockLength=20, NvMNvramBlockIdentifier=7, NvMUseServicePorts=false, NvMRamBlockDataAddress=Dem_Cfg_PrimaryEntry_2, NvMRomBlockDataAddress=Dem_Cfg_MemoryEntryInit
        NvMTargetBlockReference
          NvMFeeRef: NvMNameOfFeeBlock=FeeDemPrimaryDataBlock2
      DemPrimaryDataBlock3: NvMInitBlockCallback=NULL_PTR, NvMSelectBlockForReadAll=true, NvMSelectBlockForWriteAll=true, NvMUseInitCallback=false, NvMSingleBlockCallback=Dem_NvM_JobFinished, NvMNvBlockLength=20, NvMNvramBlockIdentifier=8, NvMUseServicePorts=false, NvMRamBlockDataAddress=Dem_Cfg_PrimaryEntry_3, NvMRomBlockDataAddress=Dem_Cfg_MemoryEntryInit
        NvMTargetBlockReference
          NvMFeeRef: NvMNameOfFeeBlock=FeeDemPrimaryDataBlock3
      DemPrimaryDataBlock4: NvMInitBlockCallback=NULL_PTR, NvMSelectBlockForReadAll=true, NvMSelectBlockForWriteAll=true, NvMUseInitCallback=false, NvMSingleBlockCallback=Dem_NvM_JobFinished, NvMNvBlockLength=20, NvMNvramBlockIdentifier=9, NvMUseServicePorts=false, NvMRamBlockDataAddress=Dem_Cfg_PrimaryEntry_4, NvMRomBlockDataAddress=Dem_Cfg_MemoryEntryInit
        NvMTargetBlockReference
          NvMFeeRef: NvMNameOfFeeBlock=FeeDemPrimaryDataBlock4
      DemPrimaryDataBlock5: NvMInitBlockCallback=NULL_PTR, NvMSelectBlockForReadAll=true, NvMSelectBlockForWriteAll=true, NvMUseInitCallback=false, NvMSingleBlockCallback=Dem_NvM_JobFinished, NvMNvBlockLength=20, NvMNvramBlockIdentifier=10, NvMUseServicePorts=false, NvMRamBlockDataAddress=Dem_Cfg_PrimaryEntry_5, NvMRomBlockDataAddress=Dem_Cfg_MemoryEntryInit
        NvMTargetBlockReference
          NvMFeeRef: NvMNameOfFeeBlock=FeeDemPrimaryDataBlock5
      DemPrimaryDataBlock6: NvMInitBlockCallback=NULL_PTR, NvMSelectBlockForReadAll=true, NvMSelectBlockForWriteAll=true, NvMUseInitCallback=false, NvMSingleBlockCallback=Dem_NvM_JobFinished, NvMNvBlockLength=20, NvMNvramBlockIdentifier=11, NvMUseServicePorts=false, NvMRamBlockDataAddress=Dem_Cfg_PrimaryEntry_6, NvMRomBlockDataAddress=Dem_Cfg_MemoryEntryInit
        NvMTargetBlockReference
          NvMFeeRef: NvMNameOfFeeBlock=FeeDemPrimaryDataBlock6
      DemPrimaryDataBlock7: NvMInitBlockCallback=NULL_PTR, NvMSelectBlockForReadAll=true, NvMSelectBlockForWriteAll=true, NvMUseInitCallback=false, NvMSingleBlockCallback=Dem_NvM_JobFinished, NvMNvBlockLength=20, NvMNvramBlockIdentifier=12, NvMUseServicePorts=false, NvMRamBlockDataAddress=Dem_Cfg_PrimaryEntry_7, NvMRomBlockDataAddress=Dem_Cfg_MemoryEntryInit
        NvMTargetBlockReference
          NvMFeeRef: NvMNameOfFeeBlock=FeeDemPrimaryDataBlock7
      NvMBlockDescriptor_StartApplication: NvMInitBlockCallback=NULL_PTR, NvMSelectBlockForReadAll=false, NvMSelectBlockForWriteAll=false, NvMUseInitCallback=false, NvMSingleBlockCallback=NULL_PTR, NvMNvBlockLength=1, NvMNvramBlockIdentifier=3, NvMUseServicePorts=true
        NvMTargetBlockReference
          NvMFeeRef: NvMNameOfFeeBlock=FeeBlockDescriptor_StartApplication
  module config WdgIf: implementation-config-variant=VARIANT-PRE-COMPILE, module-description=WdgIf_Impl
    WdgIfDevice:
      WdgIfDeviceIndex = 0
      WdgIfDeviceIncludeFile = Wdg_17_Scu.h
      WdgIfDeviceSetMode = Wdg_17_Scu_SetMode
      WdgIfDeviceSetTriggerCondition = Wdg_17_Scu_SetTriggerCondition
      WdgIfDriverRef = WdgGeneral
    WdgIfGeneral: WdgIfDevErrorDetect=true, WdgIfVersionInfoApi=false, WdgIfUseStateCombiner=false
  module config WdgM: implementation-config-variant=VARIANT-PRE-COMPILE, module-description=WdgM_Impl
    WdgMConfigSet: WdgMInitialMode=WdgMMode
      WdgMMode:
        WdgMExpiredSupervisionCycleTol = 10
        WdgMModeId = 0
        WdgMSupervisionCycle = 0.01
        WdgMInitialTriggerModeId = 0
        WdgMModeCoreAssignment = 0
        WdgMTicksPerSecond = 100
        WdgMAliveSupervision_StartApplication (WdgMAliveSupervision):
          WdgMExpectedAliveIndications = 10
          WdgMMaxMargin = 10
          WdgMMinMargin = 9
          WdgMSupervisionReferenceCycle = 10
          WdgMAliveSupervisionCheckpointRef = WdgMCheckpoint_StartApplication
        WdgMLocalStatusParams_StartApplication (WdgMLocalStatusParams):
          WdgMFailedAliveSupervisionRefCycleTol = 0
          WdgMSupervisedEntityInitialMode = WDGM_LOCAL_STATUS_OK
          WdgMFailedDeadlineRefCycleTol = 0
          WdgMDeadlineReferenceCycle = 0
          WdgMFailedProgramFlowRefCycleTol = 0
          WdgMProgramFlowReferenceCycle = 0
          WdgMLocalStatusSupervisedEntityRef = WdgMSupervisedEntity_StartApplication
        WdgMTrigger: WdgMWatchdogMode=WDGIF_OFF_MODE, WdgMTriggerConditionValue=1000, WdgMTriggerWindowStart=0, WdgMTriggerModeId=0, WdgMTriggerWatchdogRef=WdgMWatchdog
    WdgMGeneral:
      WdgMDevErrorDetect = true
      WdgMDemReport = false
      WdgMImmediateReset = true
      WdgMOffModeEnabled = true
      WdgMVersionInfoApi = false
      WdgMDefensiveBehavior = false
      WdgMUseRte = true
      WdgMDemSupervisionReport = false
      WdgMFirstCycleAliveCounterReset = false
      WdgMAutosarDebugging = false
      WdgMUseOsSuspendInterrupt = true
      WdgMTimebaseSource = WDGM_INTERNAL_SOFTWARE_TICK
      WdgMSecondResetPath = true
      WdgMTickOverrunCorrection = false
      WdgMEntityDeactivationEnabled = false
      WdgMGenerateCPIdAsPortDefinedArgument = false
      WdgMStatusReportingMechanism = WDGM_USE_NO_STATUS_REPORTING
      WdgMCallerIds: WdgMCallerId=0
      WdgMSupervisedEntity_StartApplication (WdgMSupervisedEntity): WdgMSupervisedEntityId=0, WdgMEnableEntityDeactivation=false, WdgMInternalCheckpointInitialRef=WdgMCheckpoint_StartApplication
        WdgMCheckpoint_StartApplication (WdgMCheckpoint): WdgMCheckpointId=0
      WdgMWatchdog: WdgMWatchdogName=, WdgMWatchdogDeviceRef=WdgIfDevice
  module config Cdd_Com: definition=Cdd, implementation-config-variant=VARIANT-PRE-COMPILE, module-description=Cdd_Impl
    CddComStackContribution
      CddPduRUpperLayerContribution
        PT_msg_diag_Response_MyECU_Slave3_PP_msg_diag_Response_MyECU_Slave3_Tx_346f2748_fe6ecc87 (CddPduRUpperLayerTxPdu):
          CddPduRUpperLayerHandleId = 0
          CddPduRUpperLayerPduRef = EcucPduCollection/PT_msg_diag_Response_MyECU_Slave3_PP_msg_diag_Response_MyECU_Slave3_Tx_346f2748_fe6ecc87
        PT_msg_diag_Request_MyECU_Slave3_PP_msg_diag_Request_MyECU_Slave3_Rx_346f2748_fe6ecc87 (CddPduRUpperLayerRxPdu):
          CddPduRUpperLayerHandleId = 0
          CddPduRUpperLayerPduRef = EcucPduCollection/PT_msg_diag_Request_MyECU_Slave3_PP_msg_diag_Request_MyECU_Slave3_Rx_346f2748_fe6ecc87
        PT_GlobalTimeMaster_PP_GlobalTimeMaster_Rx_346f2748_fe6ecc87 (CddPduRUpperLayerRxPdu): CddPduRUpperLayerHandleId=1, CddPduRUpperLayerPduRef=EcucPduCollection/PT_GlobalTimeMaster_PP_GlobalTimeMaster_Rx_346f2748_fe6ecc87
package /Resource
  module config Resource: implementation-config-variant=VARIANT-PRE-COMPILE
    ResourceGeneral: ResourceSubDerivative=TC234LP_32F200F
package /Dio
  module config Dio: implementation-config-variant=VARIANT-POST-BUILD-LOADABLE, module-description=Dio_Impl
    DioConfig_0 (DioConfig)
      DioPort_0 (DioPort): DioPortId=0
    DioGeneral:
      DioDevErrorDetect = true
      DioFlipChannelApi = false
      DioPBFixedAddress = false
      DioRunningInUser0Mode = false
      DioUserModeInitApiEnable = false
      DioUserModeRuntimeApiEnable = false
      DioVersionInfoApi = false
    DioSafety: DioInitCheckApi=false, DioSafetyEnable=false
    CommonPublishedInformation:
      ArMajorVersion = 2
      ArMinorVersion = 5
      ArPatchVersion = 0
      ModuleId = 120
      Release = _TRICORE_TC234
      SwMajorVersion = 3
      SwMinorVersion = 1
      SwPatchVersion = 0
      VendorId = 17
package /Fls
  module config Fls: implementation-config-variant=VARIANT-POST-BUILD-LOADABLE, module-description=Fls_Impl
    FlsConfigSet_0 (FlsConfigSet):
      FlsAcErase = 1880101320
      FlsAcWrite = 1880101120
      FlsCallCycle = 0.01
      FlsDefaultMode = MEMIF_MODE_FAST
      FlsMaxReadFastMode = 64
      FlsMaxReadNormalMode = 32
      FlsMaxWriteFastMode = 32
      FlsMaxWriteNormalMode = 32
      FlsWaitStateErrorCorrection = FLS_WAIT_STATE_ERRORCORRECTION1
      FlsWaitStateRead = FLS_WAIT_STATE_READACCESS9
      FlsJobEndNotification = Fee_JobEndNotification
      FlsJobErrorNotification = Fee_JobErrorNotification
      FlsSectorList
        FlsSector_0 (FlsSector): FlsNumberOfSectors=2, FlsPageSize=8, FlsSectorSize=65536, FlsSectorStartaddress=0
    FlsGeneral:
      FlsAcLoadOnJobStart = false
      FlsBaseAddress = 2936012800
      FlsCancelApi = false
      FlsCompareApi = false
      FlsDebugSupport = false
      FlsDevErrorDetect = true
      FlsDriverIndex = 0
      FlsGetJobResultApi = false
      FlsGetStatusApi = false
      FlsPBFixedAddress = false
      FlsResetSfrAtInit = false
      FlsRunningInUser0Mode = false
      FlsSetModeApi = false
      FlsTotalSize = 131072
      FlsUseInterrupts = false
      FlsUserModeInitApiEnable = false
      FlsUserModeRuntimeApiEnable = false
      FlsVersionInfoApi = false
    FlsPublishedInformation:
      FlsAcLocationErase = 0
      FlsAcLocationWrite = 0
      FlsAcSizeErase = 200
      FlsAcSizeWrite = 200
      FlsEraseTime = 1000000
      FlsErasedValue = 0
      FlsSpecifiedEraseCycles = 125000
      FlsWriteTime = 150
    FlsIfxSpecificConfig: FlsEraseSuspendTimeout=6000, FlsIllegalStateNotification=NULL_PTR, FlsStateVarStruct=FlsStateVar, FlsUseEraseSuspend=false
    CommonPublishedInformation:
      ArMajorVersion = 3
      ArMinorVersion = 2
      ArPatchVersion = 0
      ModuleId = 92
      Release = _TRICORE_TC234
      SwMajorVersion = 2
      SwMinorVersion = 4
      SwPatchVersion = 0
      VendorApiInfix = Pmu
      VendorId = 17
package /Wdg
  module config Wdg: implementation-config-variant=VARIANT-POST-BUILD-LOADABLE, module-description=Wdg_Impl
    WdgGeneral:
      WdgDebugSupport = false
      WdgDevErrorDetect = true
      WdgDisableAllowed = true
      WdgIndex = 0
      WdgInitialTimeout = 5
      WdgMaxTimeout = 32
      WdgPBFixedAddress = false
      WdgRunArea = ROM
      WdgRunningInUser0Mode = false
      WdgTriggerLocation = (unset)
      WdgUnlockRestriction = true
      WdgUserModeInitApiEnable = false
      WdgUserModeRuntimeApiEnable = false
      WdgVersionInfoApi = false
    WdgSettingsConfig_0 (WdgSettingsConfig): WdgDefaultMode=WDGIF_OFF_MODE, WdgSystemClockRef=McuClockReferencePoint
      WdgGtmSettings: Wdg0FastServiceGtmCbkTime=1.09224, Wdg0SlowServiceGtmCbkTime=1.09225, Wdg0ServiceGtmChannelRef=Tom_0/TomChannel_3
      WdgInitialPassword
      WdgSettingsFast: Wdg0FastModeTimeoutValue=10
      WdgSettingsOff
      WdgSettingsSlow: Wdg0SlowModeTimeoutValue=20
      WdgTimerCheckTolerance
    WdgSafety: Wdg0SafetyEnable=false, WdgEnableTimecheck=false, WdgSetOffModeApi=false
    WdgPublishedInformation
    CommonPublishedInformation:
      ArMajorVersion = 2
      ArMinorVersion = 5
      ArPatchVersion = 0
      ModuleId = 102
      Release = _TRICORE_TC234
      SwMajorVersion = 3
      SwMinorVersion = 4
      SwPatchVersion = 0
      VendorApiInfix = Scu
      VendorId = 17
package /Adc
  module config Adc: implementation-config-variant=VARIANT-POST-BUILD-LOADABLE, module-description=Adc_Impl
    AdcConfigSet_0 (AdcConfigSet):
      AdcAnalogClockDivider = 10
      AdcDigitalArbiterClockDivider = 0
      AdcLowPowerSupplyVoltage = POWER_SUPPLY_5V
      AdcRefPrechargeControl = USE_VDDM_PRECH_VAREF_ADJ
      AdcSleepMode = SLEEP_MODE_ACCEPT
      AdcCcu6ModuleRef = Ccu60
      AdcSystemClock = McuClockReferencePoint
      AdcGlobInputClass_0 (AdcGlobInputClass): AdcGlobChResolution=CH_RES_10BIT, AdcGlobChSampleTime=0
      AdcGlobInputClass_1 (AdcGlobInputClass): AdcGlobChResolution=CH_RES_10BIT, AdcGlobChSampleTime=0
      AdcHwUnit_0 (AdcHwUnit): AdcArbitrationRoundLength=ARBITRATION_SLOTS_4, AdcHwUnitId=HWUNIT_ADC0, AdcPostCal=POST_CAL_DISABLE, AdcSyncConvMode=ADC_STANDALONE
        AdcChannel_0 (AdcChannel):
          AdcAnChannelNum = 0
          AdcChannelHighLimit = 255
          AdcChannelId = 0
          AdcChannelLimitCheck = false
          AdcChannelLowLimit = 0
          AdcChannelRangeSelect = ADC_RANGE_ALWAYS
          AdcChannelRefVoltsrcHigh = REF_VOLTAGE_VAREF
          AdcChannelRefVoltsrcLow = REF_VOLTAGE_VAGND
          AdcSyncChannel = false
          AdcInputClassSelection = AdcGlobInputClass_0
        AdcGroup_0 (AdcGroup):
          AdcEmuxScanEnable = false
          AdcGroupAccessMode = ADC_ACCESS_MODE_SINGLE
          AdcGroupConversionMode = ADC_CONV_MODE_ONESHOT
          AdcGroupId = 0
          AdcGroupRequestSource = REQSRC0_8STG_QUE
          AdcGroupTriggSrc = ADC_TRIGG_SRC_SW
          AdcHwGateSignal = ADC_GATE_SIGNAL_NONE
          AdcStreamingBufferMode = ADC_STREAM_BUFFER_LINEAR
          AdcStreamingNumSamples = 1
          AdcGroupDefinition = AdcChannel_0
        AdcKernelInputClass_0 (AdcKernelInputClass): AdcKernelChResolution=CH_RES_10BIT, AdcKernelChSampleTime=0
        AdcKernelInputClass_1 (AdcKernelInputClass): AdcKernelChResolution=CH_RES_10BIT, AdcKernelChSampleTime=0
    AdcGeneral:
      AdcCcu6Synchronization = false
      AdcDeInitApi = false
      AdcDebugSupport = false
      AdcDevErrorDetect = true
      AdcEnableLimitCheck = false
      AdcEnableQueuing = false
      AdcEnableStartStopGroupApi = true
      AdcGrpNotifCapability = false
      AdcHwTriggerApi = false
      AdcMasterSlaveSync = false
      AdcMaxChConvTimeCount = 10000
      AdcNonAutosarDmaResultHandling = false
      AdcNonAutosarResultPolling = false
      AdcPBFixedAddress = false
      AdcPriorityImplementation = ADC_PRIORITY_NONE
      AdcReadGroupApi = false
      AdcResetSfrAtInit = false
      AdcResultAlignment = ADC_ALIGN_RIGHT
      AdcRunningInUser0Mode = false
      AdcSameChannelQueuing = false
      AdcUseEmux = false
      AdcUserModeDeInitApiEnable = false
      AdcUserModeInitApiEnable = false
      AdcUserModeRuntimeApiEnable = false
      AdcVersionInfoApi = false
    AdcSafety: AdcSafetyEnable=false
    AdcPublishedInformation: AdcChannelValueSigned=false, AdcGroupFirstChannelFixed=false, AdcMaxChannelResolution=12
    CommonPublishedInformation:
      ArMajorVersion = 4
      ArMinorVersion = 2
      ArPatchVersion = 0
      ModuleId = 123
      Release = _TRICORE_TC234
      SwMajorVersion = 3
      SwMinorVersion = 2
      SwPatchVersion = 1
      VendorId = 17
package /Port
  module config Port: implementation-config-variant=VARIANT-POST-BUILD-LOADABLE, module-description=Port_Impl
    PortConfigSet_0 (PortConfigSet)
      15 x PortContainer:
        PortContainer_0: PortNumber=0, PortNumberOfPortPins=11
          11 x PortPin, all with PortPinAnalogInput=DISABLE, PortPinControllerSelect=DISABLE, PortPinDirection=PORT_PIN_IN, PortPinDirectionChangeable=false, PortPinDriverStrength=PORT_CMOS_SPEED_GRADE1, PortPinInitialMode=PORT_PIN_MODE_GPIO, PortPinInputCharacteristic=PORT_PIN_IN_PULL_UP, PortPinLevelValue=PORT_PIN_LEVEL_LOW, PortPinMode=PORT_PIN_MODE_ALL, PortPinModeChangeable=false, PortPinPadLevel=PORT_PDR_CMOS_AUTOMOTIVE_LEVEL:
            PortPin_0: PortPinId=0, PortPinSymbolicName=PORT_0_PIN_0
            PortPin_1: PortPinId=1, PortPinSymbolicName=PORT_0_PIN_1
            PortPin_10: PortPinId=12, PortPinSymbolicName=PORT_0_PIN_12
            PortPin_{2..9}: PortPinId={2..9}, PortPinSymbolicName=PORT_0_PIN_{2..9}
        PortContainer_1: PortNumber=2, PortNumberOfPortPins=9
          9 x PortPin, all with PortPinAnalogInput=DISABLE, PortPinControllerSelect=DISABLE, PortPinDirection=PORT_PIN_IN, PortPinDirectionChangeable=false, PortPinDriverStrength=PORT_CMOS_SPEED_GRADE1, PortPinInitialMode=PORT_PIN_MODE_GPIO, PortPinInputCharacteristic=PORT_PIN_IN_PULL_UP, PortPinLevelValue=PORT_PIN_LEVEL_LOW, PortPinMode=PORT_PIN_MODE_ALL, PortPinModeChangeable=false, PortPinPadLevel=PORT_PDR_CMOS_AUTOMOTIVE_LEVEL:
            PortPin_0: PortPinId=32, PortPinSymbolicName=PORT_2_PIN_0
            PortPin_1: PortPinId=33, PortPinSymbolicName=PORT_2_PIN_1
            PortPin_2: PortPinId=34, PortPinSymbolicName=PORT_2_PIN_2
            PortPin_3: PortPinId=35, PortPinSymbolicName=PORT_2_PIN_3
            PortPin_4: PortPinId=36, PortPinSymbolicName=PORT_2_PIN_4
            PortPin_5: PortPinId=37, PortPinSymbolicName=PORT_2_PIN_5
            PortPin_6: PortPinId=38, PortPinSymbolicName=PORT_2_PIN_6
            PortPin_7: PortPinId=39, PortPinSymbolicName=PORT_2_PIN_7
            PortPin_8: PortPinId=40, PortPinSymbolicName=PORT_2_PIN_8
        PortContainer_10: PortNumber=23, PortNumberOfPortPins=1
          PortPin_0 (PortPin):
            PortPinAnalogInput = DISABLE
            PortPinControllerSelect = DISABLE
            PortPinDirection = PORT_PIN_IN
            PortPinDirectionChangeable = false
            PortPinDriverStrength = PORT_CMOS_SPEED_GRADE1
            PortPinId = 369
            PortPinInitialMode = PORT_PIN_MODE_GPIO
            PortPinInputCharacteristic = PORT_PIN_IN_PULL_UP
            PortPinLevelValue = PORT_PIN_LEVEL_LOW
            PortPinMode = PORT_PIN_MODE_ALL
            PortPinModeChangeable = false
            PortPinPadLevel = PORT_PDR_CMOS_AUTOMOTIVE_LEVEL
            PortPinSymbolicName = PORT_23_PIN_1
        PortContainer_P33: PortNumber=33, PortNumberOfPortPins=13
          13 x PortPin, all with PortPinAnalogInput=DISABLE, PortPinControllerSelect=DISABLE, PortPinDirectionChangeable=false, PortPinDriverStrength=PORT_CMOS_SPEED_GRADE1, PortPinLevelValue=PORT_PIN_LEVEL_LOW, PortPinModeChangeable=false, PortPinPadLevel=PORT_PDR_CMOS_AUTOMOTIVE_LEVEL:
            PortPin_0: PortPinDirection=PORT_PIN_IN, PortPinId=528, PortPinInitialMode=PORT_PIN_MODE_GPIO, PortPinInputCharacteristic=PORT_PIN_IN_PULL_UP, PortPinMode=PORT_PIN_MODE_ALL, PortPinSymbolicName=PORT_33_PIN_0
            PortPin_1: PortPinDirection=PORT_PIN_IN, PortPinId=529, PortPinInitialMode=PORT_PIN_MODE_GPIO, PortPinInputCharacteristic=PORT_PIN_IN_PULL_UP, PortPinMode=PORT_PIN_MODE_ALL, PortPinSymbolicName=PORT_33_PIN_1
            PortPin_10: PortPinDirection=PORT_PIN_IN, PortPinId=538, PortPinInitialMode=PORT_PIN_MODE_GPIO, PortPinInputCharacteristic=PORT_PIN_IN_PULL_UP, PortPinMode=PORT_PIN_MODE_ALL, PortPinSymbolicName=PORT_33_PIN_10
            PortPin_11: PortPinDirection=PORT_PIN_IN, PortPinId=539, PortPinInitialMode=PORT_PIN_MODE_GPIO, PortPinInputCharacteristic=PORT_PIN_IN_PULL_UP, PortPinMode=PORT_PIN_MODE_ALL, PortPinSymbolicName=PORT_33_PIN_11
            PortPin_12: PortPinDirection=PORT_PIN_IN, PortPinId=540, PortPinInitialMode=PORT_PIN_MODE_GPIO, PortPinInputCharacteristic=PORT_PIN_IN_PULL_UP, PortPinMode=PORT_PIN_MODE_ALL, PortPinSymbolicName=PORT_33_PIN_12
            PortPin_2: PortPinDirection=PORT_PIN_IN, PortPinId=530, PortPinInitialMode=PORT_PIN_MODE_GPIO, PortPinInputCharacteristic=PORT_PIN_IN_PULL_UP, PortPinMode=PORT_PIN_MODE_ALL, PortPinSymbolicName=PORT_33_PIN_2
            PortPin_3: PortPinDirection=PORT_PIN_IN, PortPinId=531, PortPinInitialMode=PORT_PIN_MODE_GPIO, PortPinInputCharacteristic=PORT_PIN_IN_PULL_UP, PortPinMode=PORT_PIN_MODE_ALL, PortPinSymbolicName=PORT_33_PIN_3
            PortPin_4: PortPinDirection=PORT_PIN_IN, PortPinId=532, PortPinInitialMode=PORT_PIN_MODE_GPIO, PortPinInputCharacteristic=PORT_PIN_IN_PULL_UP, PortPinMode=PORT_PIN_MODE_ALL, PortPinSymbolicName=PORT_33_PIN_4
            PortPin_5: PortPinDirection=PORT_PIN_IN, PortPinId=533, PortPinInitialMode=PORT_PIN_MODE_GPIO, PortPinInputCharacteristic=PORT_PIN_IN_PULL_UP, PortPinMode=PORT_PIN_MODE_ALL, PortPinSymbolicName=PORT_33_PIN_5
            PortPin_6: PortPinDirection=PORT_PIN_IN, PortPinId=534, PortPinInitialMode=PORT_PIN_MODE_GPIO, PortPinInputCharacteristic=PORT_PIN_IN_PULL_UP, PortPinMode=PORT_PIN_MODE_ALL, PortPinSymbolicName=PORT_33_PIN_6
            PortPin_P33_7_CAN0_RX: PortPinDirection=PORT_PIN_IN, PortPinId=535, PortPinInitialMode=PORT_PIN_MODE_GPIO, PortPinInputCharacteristic=PORT_PIN_IN_PULL_UP, PortPinMode=PORT_PIN_MODE_ALL, PortPinSymbolicName=PORT_33_PIN_7
            PortPin_P33_8_CAN0_TX: PortPinDirection=PORT_PIN_OUT, PortPinId=536, PortPinInitialMode=PORT_PIN_MODE_ALT5, PortPinInputCharacteristic=PORT_PIN_IN_NO_PULL, PortPinMode=PORT_PIN_MODE_ALT5, PortPinSymbolicName=PORT_33_PIN_8, PortPinOutputCharacteristic=PORT_PIN_OUT_PUSHPULL
            PortPin_9: PortPinDirection=PORT_PIN_IN, PortPinId=537, PortPinInitialMode=PORT_PIN_MODE_GPIO, PortPinInputCharacteristic=PORT_PIN_IN_PULL_UP, PortPinMode=PORT_PIN_MODE_ALL, PortPinSymbolicName=PORT_33_PIN_9
        PortContainer_12: PortNumber=34, PortNumberOfPortPins=4
          4 x PortPin, all with PortPinAnalogInput=DISABLE, PortPinControllerSelect=DISABLE, PortPinDirection=PORT_PIN_IN, PortPinDirectionChangeable=false, PortPinDriverStrength=PORT_CMOS_SPEED_GRADE1, PortPinInitialMode=PORT_PIN_MODE_GPIO, PortPinInputCharacteristic=PORT_PIN_IN_PULL_UP, PortPinLevelValue=PORT_PIN_LEVEL_LOW, PortPinMode=PORT_PIN_MODE_ALL, PortPinModeChangeable=false, PortPinPadLevel=PORT_PDR_CMOS_AUTOMOTIVE_LEVEL:
            PortPin_0: PortPinId=544, PortPinSymbolicName=PORT_34_PIN_0
            PortPin_1: PortPinId=545, PortPinSymbolicName=PORT_34_PIN_1
            PortPin_2: PortPinId=546, PortPinSymbolicName=PORT_34_PIN_2
            PortPin_3: PortPinId=547, PortPinSymbolicName=PORT_34_PIN_3
        PortContainer_13: PortNumber=40, PortNumberOfPortPins=12
          12 x PortPin, all with PortPinAnalogInput=DISABLE, PortPinControllerSelect=DISABLE, PortPinDirection=PORT_PIN_IN, PortPinDirectionChangeable=false, PortPinDriverStrength=PORT_CMOS_SPEED_GRADE1, PortPinInitialMode=PORT_PIN_MODE_GPIO, PortPinInputCharacteristic=PORT_PIN_IN_PULL_UP, PortPinLevelValue=PORT_PIN_LEVEL_LOW, PortPinModeChangeable=false, PortPinPadLevel=PORT_PDR_CMOS_AUTOMOTIVE_LEVEL:
            PortPin_0: PortPinId=640, PortPinSymbolicName=PORT_40_PIN_0
            PortPin_1: PortPinId=641, PortPinSymbolicName=PORT_40_PIN_1
            PortPin_10: PortPinId=650, PortPinSymbolicName=PORT_40_PIN_10
            PortPin_11: PortPinId=651, PortPinSymbolicName=PORT_40_PIN_11
            PortPin_2: PortPinId=642, PortPinSymbolicName=PORT_40_PIN_2
            PortPin_3: PortPinId=643, PortPinSymbolicName=PORT_40_PIN_3
            PortPin_4: PortPinId=644, PortPinSymbolicName=PORT_40_PIN_4
            PortPin_5: PortPinId=645, PortPinSymbolicName=PORT_40_PIN_5
            PortPin_6: PortPinId=646, PortPinSymbolicName=PORT_40_PIN_6
            PortPin_7: PortPinId=647, PortPinSymbolicName=PORT_40_PIN_7
            PortPin_8: PortPinId=648, PortPinSymbolicName=PORT_40_PIN_8
            PortPin_9: PortPinId=649, PortPinSymbolicName=PORT_40_PIN_9
        PortContainer_14: PortNumber=41, PortNumberOfPortPins=12
          12 x PortPin, all with PortPinAnalogInput=DISABLE, PortPinControllerSelect=DISABLE, PortPinDirection=PORT_PIN_IN, PortPinDirectionChangeable=false, PortPinDriverStrength=PORT_CMOS_SPEED_GRADE1, PortPinInitialMode=PORT_PIN_MODE_GPIO, PortPinInputCharacteristic=PORT_PIN_IN_PULL_UP, PortPinLevelValue=PORT_PIN_LEVEL_LOW, PortPinModeChangeable=false, PortPinPadLevel=PORT_PDR_CMOS_AUTOMOTIVE_LEVEL:
            PortPin_0: PortPinId=656, PortPinSymbolicName=PORT_41_PIN_0
            PortPin_1: PortPinId=657, PortPinSymbolicName=PORT_41_PIN_1
            PortPin_10: PortPinId=666, PortPinSymbolicName=PORT_41_PIN_10
            PortPin_11: PortPinId=667, PortPinSymbolicName=PORT_41_PIN_11
            PortPin_2: PortPinId=658, PortPinSymbolicName=PORT_41_PIN_2
            PortPin_3: PortPinId=659, PortPinSymbolicName=PORT_41_PIN_3
            PortPin_4: PortPinId=660, PortPinSymbolicName=PORT_41_PIN_4
            PortPin_5: PortPinId=661, PortPinSymbolicName=PORT_41_PIN_5
            PortPin_6: PortPinId=662, PortPinSymbolicName=PORT_41_PIN_6
            PortPin_7: PortPinId=663, PortPinSymbolicName=PORT_41_PIN_7
            PortPin_8: PortPinId=664, PortPinSymbolicName=PORT_41_PIN_8
            PortPin_9: PortPinId=665, PortPinSymbolicName=PORT_41_PIN_9
        PortContainer_2: PortNumber=10, PortNumberOfPortPins=5
          5 x PortPin, all with PortPinAnalogInput=DISABLE, PortPinControllerSelect=DISABLE, PortPinDirection=PORT_PIN_IN, PortPinDirectionChangeable=false, PortPinDriverStrength=PORT_CMOS_SPEED_GRADE1, PortPinInitialMode=PORT_PIN_MODE_GPIO, PortPinInputCharacteristic=PORT_PIN_IN_PULL_UP, PortPinLevelValue=PORT_PIN_LEVEL_LOW, PortPinMode=PORT_PIN_MODE_ALL, PortPinModeChangeable=false, PortPinPadLevel=PORT_PDR_CMOS_AUTOMOTIVE_LEVEL:
            PortPin_0: PortPinId=161, PortPinSymbolicName=PORT_10_PIN_1
            PortPin_1: PortPinId=162, PortPinSymbolicName=PORT_10_PIN_2
            PortPin_2: PortPinId=163, PortPinSymbolicName=PORT_10_PIN_3
            PortPin_3: PortPinId=165, PortPinSymbolicName=PORT_10_PIN_5
            PortPin_4: PortPinId=166, PortPinSymbolicName=PORT_10_PIN_6
        PortContainer_3: PortNumber=11, PortNumberOfPortPins=8
          8 x PortPin, all with PortPinAnalogInput=DISABLE, PortPinControllerSelect=DISABLE, PortPinDirection=PORT_PIN_IN, PortPinDirectionChangeable=false, PortPinDriverStrength=PORT_CMOS_SPEED_GRADE1, PortPinInitialMode=PORT_PIN_MODE_GPIO, PortPinInputCharacteristic=PORT_PIN_IN_PULL_UP, PortPinLevelValue=PORT_PIN_LEVEL_LOW, PortPinMode=PORT_PIN_MODE_ALL, PortPinModeChangeable=false, PortPinPadLevel=PORT_PDR_CMOS_AUTOMOTIVE_LEVEL:
            PortPin_0: PortPinId=178, PortPinSymbolicName=PORT_11_PIN_2
            PortPin_1: PortPinId=179, PortPinSymbolicName=PORT_11_PIN_3
            PortPin_2: PortPinId=182, PortPinSymbolicName=PORT_11_PIN_6
            PortPin_3: PortPinId=184, PortPinSymbolicName=PORT_11_PIN_8
            PortPin_4: PortPinId=185, PortPinSymbolicName=PORT_11_PIN_9
            PortPin_5: PortPinId=186, PortPinSymbolicName=PORT_11_PIN_10
            PortPin_6: PortPinId=187, PortPinSymbolicName=PORT_11_PIN_11
            PortPin_7: PortPinId=188, PortPinSymbolicName=PORT_11_PIN_12
        PortContainer_4: PortNumber=13, PortNumberOfPortPins=4
          4 x PortPin, all with PortPinAnalogInput=DISABLE, PortPinControllerSelect=DISABLE, PortPinDirection=PORT_PIN_IN, PortPinDirectionChangeable=false, PortPinDriverStrength=PORT_CMOS_SPEED_GRADE1, PortPinInitialMode=PORT_PIN_MODE_GPIO, PortPinInputCharacteristic=PORT_PIN_IN_PULL_UP, PortPinLevelValue=PORT_PIN_LEVEL_LOW, PortPinMode=PORT_PIN_MODE_ALL, PortPinModeChangeable=false, PortPinPadLevel=PORT_PDR_CMOS_AUTOMOTIVE_LEVEL:
            PortPin_0: PortPinId=208, PortPinSymbolicName=PORT_13_PIN_0
            PortPin_1: PortPinId=209, PortPinSymbolicName=PORT_13_PIN_1
            PortPin_2: PortPinId=210, PortPinSymbolicName=PORT_13_PIN_2
            PortPin_3: PortPinId=211, PortPinSymbolicName=PORT_13_PIN_3
        PortContainer_5: PortNumber=14, PortNumberOfPortPins=9
          9 x PortPin, all with PortPinAnalogInput=DISABLE, PortPinControllerSelect=DISABLE, PortPinDirection=PORT_PIN_IN, PortPinDirectionChangeable=false, PortPinDriverStrength=PORT_CMOS_SPEED_GRADE1, PortPinInitialMode=PORT_PIN_MODE_GPIO, PortPinInputCharacteristic=PORT_PIN_IN_PULL_UP, PortPinLevelValue=PORT_PIN_LEVEL_LOW, PortPinMode=PORT_PIN_MODE_ALL, PortPinModeChangeable=false, PortPinPadLevel=PORT_PDR_CMOS_AUTOMOTIVE_LEVEL:
            PortPin_0: PortPinId=224, PortPinSymbolicName=PORT_14_PIN_0
            PortPin_1: PortPinId=225, PortPinSymbolicName=PORT_14_PIN_1
            PortPin_2: PortPinId=226, PortPinSymbolicName=PORT_14_PIN_2
            PortPin_3: PortPinId=227, PortPinSymbolicName=PORT_14_PIN_3
            PortPin_4: PortPinId=228, PortPinSymbolicName=PORT_14_PIN_4
            PortPin_5: PortPinId=229, PortPinSymbolicName=PORT_14_PIN_5
            PortPin_6: PortPinId=230, PortPinSymbolicName=PORT_14_PIN_6
            PortPin_7: PortPinId=231, PortPinSymbolicName=PORT_14_PIN_7
            PortPin_8: PortPinId=232, PortPinSymbolicName=PORT_14_PIN_8
        PortContainer_6: PortNumber=15, PortNumberOfPortPins=9
          9 x PortPin, all with PortPinAnalogInput=DISABLE, PortPinControllerSelect=DISABLE, PortPinDirection=PORT_PIN_IN, PortPinDirectionChangeable=false, PortPinDriverStrength=PORT_CMOS_SPEED_GRADE1, PortPinInitialMode=PORT_PIN_MODE_GPIO, PortPinInputCharacteristic=PORT_PIN_IN_PULL_UP, PortPinLevelValue=PORT_PIN_LEVEL_LOW, PortPinMode=PORT_PIN_MODE_ALL, PortPinModeChangeable=false, PortPinPadLevel=PORT_PDR_CMOS_AUTOMOTIVE_LEVEL:
            PortPin_0: PortPinId=240, PortPinSymbolicName=PORT_15_PIN_0
            PortPin_1: PortPinId=241, PortPinSymbolicName=PORT_15_PIN_1
            PortPin_2: PortPinId=242, PortPinSymbolicName=PORT_15_PIN_2
            PortPin_3: PortPinId=243, PortPinSymbolicName=PORT_15_PIN_3
            PortPin_4: PortPinId=244, PortPinSymbolicName=PORT_15_PIN_4
            PortPin_5: PortPinId=245, PortPinSymbolicName=PORT_15_PIN_5
            PortPin_6: PortPinId=246, PortPinSymbolicName=PORT_15_PIN_6
            PortPin_7: PortPinId=247, PortPinSymbolicName=PORT_15_PIN_7
            PortPin_8: PortPinId=248, PortPinSymbolicName=PORT_15_PIN_8
        PortContainer_7: PortNumber=20, PortNumberOfPortPins=12
          12 x PortPin, all with PortPinAnalogInput=DISABLE, PortPinControllerSelect=DISABLE, PortPinDirection=PORT_PIN_IN, PortPinDirectionChangeable=false, PortPinDriverStrength=PORT_CMOS_SPEED_GRADE1, PortPinInitialMode=PORT_PIN_MODE_GPIO, PortPinInputCharacteristic=PORT_PIN_IN_PULL_UP, PortPinLevelValue=PORT_PIN_LEVEL_LOW, PortPinMode=PORT_PIN_MODE_ALL, PortPinModeChangeable=false, PortPinPadLevel=PORT_PDR_CMOS_AUTOMOTIVE_LEVEL:
            PortPin_0: PortPinId=320, PortPinSymbolicName=PORT_20_PIN_0
            PortPin_1: PortPinId=322, PortPinSymbolicName=PORT_20_PIN_2
            PortPin_10: PortPinId=333, PortPinSymbolicName=PORT_20_PIN_13
            PortPin_11: PortPinId=334, PortPinSymbolicName=PORT_20_PIN_14
            PortPin_2: PortPinId=323, PortPinSymbolicName=PORT_20_PIN_3
            PortPin_3: PortPinId=326, PortPinSymbolicName=PORT_20_PIN_6
            PortPin_4: PortPinId=327, PortPinSymbolicName=PORT_20_PIN_7
            PortPin_5: PortPinId=328, PortPinSymbolicName=PORT_20_PIN_8
            PortPin_6: PortPinId=329, PortPinSymbolicName=PORT_20_PIN_9
            PortPin_7: PortPinId=330, PortPinSymbolicName=PORT_20_PIN_10
            PortPin_8: PortPinId=331, PortPinSymbolicName=PORT_20_PIN_11
            PortPin_9: PortPinId=332, PortPinSymbolicName=PORT_20_PIN_12
        PortContainer_8: PortNumber=21, PortNumberOfPortPins=6
          6 x PortPin, all with PortPinAnalogInput=DISABLE, PortPinControllerSelect=DISABLE, PortPinDirection=PORT_PIN_IN, PortPinDirectionChangeable=false, PortPinDriverStrength=PORT_CMOS_SPEED_GRADE1, PortPinInitialMode=PORT_PIN_MODE_GPIO, PortPinInputCharacteristic=PORT_PIN_IN_PULL_UP, PortPinLevelValue=PORT_PIN_LEVEL_LOW, PortPinMode=PORT_PIN_MODE_ALL, PortPinModeChangeable=false, PortPinPadLevel=PORT_PDR_CMOS_AUTOMOTIVE_LEVEL:
            PortPin_0: PortPinId=338, PortPinSymbolicName=PORT_21_PIN_2
            PortPin_1: PortPinId=339, PortPinSymbolicName=PORT_21_PIN_3
            PortPin_2: PortPinId=340, PortPinSymbolicName=PORT_21_PIN_4
            PortPin_3: PortPinId=341, PortPinSymbolicName=PORT_21_PIN_5
            PortPin_4: PortPinId=342, PortPinSymbolicName=PORT_21_PIN_6
            PortPin_5: PortPinId=343, PortPinSymbolicName=PORT_21_PIN_7
        PortContainer_9: PortNumber=22, PortNumberOfPortPins=5
          5 x PortPin, all with PortPinAnalogInput=DISABLE, PortPinControllerSelect=DISABLE, PortPinDirection=PORT_PIN_IN, PortPinDirectionChangeable=false, PortPinDriverStrength=PORT_CMOS_SPEED_GRADE1, PortPinInitialMode=PORT_PIN_MODE_GPIO, PortPinInputCharacteristic=PORT_PIN_IN_PULL_UP, PortPinLevelValue=PORT_PIN_LEVEL_LOW, PortPinMode=PORT_PIN_MODE_ALL, PortPinModeChangeable=false, PortPinPadLevel=PORT_PDR_CMOS_AUTOMOTIVE_LEVEL:
            PortPin_0: PortPinId=352, PortPinSymbolicName=PORT_22_PIN_0
            PortPin_1: PortPinId=353, PortPinSymbolicName=PORT_22_PIN_1
            PortPin_2: PortPinId=354, PortPinSymbolicName=PORT_22_PIN_2
            PortPin_3: PortPinId=355, PortPinSymbolicName=PORT_22_PIN_3
            PortPin_4: PortPinId=356, PortPinSymbolicName=PORT_22_PIN_4
    PortSafety: PortInitCheckApi=false, PortSafetyEnable=false
    PortGeneral:
      PortDevErrorDetect = true
      PortPBFixedAddress = false
      PortRunningInUser0Mode = false
      PortSetPinDirectionApi = false
      PortSetPinModeApi = false
      PortUserModeInitApiEnable = false
      PortUserModeRuntimeApiEnable = false
      PortVersionInfoApi = false
    CommonPublishedInformation:
      ArMajorVersion = 3
      ArMinorVersion = 2
      ArPatchVersion = 0
      ModuleId = 124
      Release = _TRICORE_TC234
      SwMajorVersion = 3
      SwMinorVersion = 1
      SwPatchVersion = 0
      VendorId = 17
package /Icu
  module config Icu: implementation-config-variant=VARIANT-POST-BUILD-LOADABLE, module-description=Icu_Impl
    IcuConfigSet_0 (IcuConfigSet): IcuMaxChannel=1
      IcuChannel_0 (IcuChannel):
        IcuChannelId = 0
        IcuDefaultStartEdge = ICU_RISING_EDGE
        IcuMeasurementMode = ICU_MODE_SIGNAL_EDGE_DETECT
        IcuSignalType = ICU_QM_SIGNAL
        IcuWakeupCapability = false
        IcuAssignedHwUnit = TimChannel_1
    IcuGeneral:
      IcuDebugSupport = false
      IcuDevErrorDetect = true
      IcuIndex = 0
      IcuPBFixedAddress = false
      IcuReportWakeupSource = false
      IcuResetSfrAtInit = false
      IcuRunningInUser0Mode = false
      IcuUserModeDeInitApiEnable = false
      IcuUserModeInitApiEnable = false
      IcuUserModeRuntimeApiEnable = false
    IcuOptionalApis:
      IcuDeInitApi = false
      IcuDisableWakeupApi = false
      IcuEdgeCountApi = false
      IcuEdgeDetectApi = true
      IcuEnableWakeupApi = false
      IcuGetDutyCycleValuesApi = false
      IcuGetInputStateApi = false
      IcuGetTimeElapsedApi = false
      IcuGetVersionInfoApi = false
      IcuSetModeApi = false
      IcuSignalMeasurementApi = false
      IcuTimestampApi = false
      IcuWakeupFunctionalityApi = false
    IcuSafety: IcuGetModeApi=false, IcuInitCheckApi=false, IcuSafetyEnable=false
    CommonPublishedInformation:
      ArMajorVersion = 4
      ArMinorVersion = 2
      ArPatchVersion = 0
      ModuleId = 122
      Release = _TRICORE_TC234
      SwMajorVersion = 3
      SwMinorVersion = 11
      SwPatchVersion = 0
      VendorApiInfix = GtmCcu6
      VendorId = 17
package /Spi
  module config Spi: implementation-config-variant=VARIANT-POST-BUILD-LOADABLE, module-description=Spi_Impl
    SpiGeneral:
      SpiAsyncParallelTransmit = false
      SpiBaudrateConfigAtRuntime = false
      SpiCancelApi = false
      SpiChannelBuffersAllowed = 1
      SpiDebugSupport = false
      SpiDevErrorDetect = true
      SpiHwStatusApi = false
      SpiInterruptibleSeqAllowed = false
      SpiLevelDelivered = 2
      SpiMaxJobTriggerQueueLength = 2
      SpiPBFixedAddress = false
      SpiResetSfrAtInit = false
      SpiRunningInUser0Mode = false
      SpiSyncTransmitTimeoutDuration = 1048575
      SpiUserModeDeInitApiEnable = false
      SpiUserModeInitApiEnable = false
      SpiUserModeRuntimeApiEnable = false
      SpiVersionInfoApi = false
    SpiSafety: SpiSafetyEnable=false
    SpiDriver_0 (SpiDriver): SpiMaxChannel=1, SpiMaxJob=1, SpiMaxSequence=1, SpiSystemClock=McuClockReferencePoint
      SpiChannel_0 (SpiChannel): SpiChannelType=EB, SpiDataWidth=8, SpiDefaultData=0, SpiEbMaxLength=511, SpiTransferStart=LSB, SpiChannelId=0
      SpiExternalDevice_0 (SpiExternalDevice):
        SpiAutoCalcBaudParams = false
        SpiAutoCalcDelayParams = false
        SpiCsPolarity = LOW
        SpiCsSelection = CS_VIA_PERIPHERAL_ENGINE
        SpiDataShiftEdge = LEADING
        SpiEnableCs = true
        SpiParitySupport = Unused
        SpiQSpiParamA = 1
        SpiQSpiParamB = 0
        SpiQSpiParamC = 1
        SpiQSpiParamIPre = 1
        SpiQSpiParamIdle = 1
        SpiQSpiParamLPre = 0
        SpiQSpiParamLead = 1
        SpiQSpiParamQ = 10
        SpiQSpiParamTPre = 0
        SpiQSpiParamTq = 2
        SpiQSpiParamTrail = 1
        SpiShiftClockIdleLevel = LOW
        SpiCsGpio
        SpiHwUnit: SpiAssignedHwChannel=Channel0, SpiAssignedHwModule=QSPI0
      SpiJob_0 (SpiJob): SpiChannelBasedCS=Disabled, SpiJobEndNotification=NULL_PTR, SpiJobPriority=0, SpiJobId=0, SpiDeviceAssignment=SpiExternalDevice_0
        SpiChannelList_0 (SpiChannelList): SpiChannelIndex=0, SpiChannelAssignment=SpiChannel_0
      SpiSequence_0 (SpiSequence): SpiSeqEndNotification=NULL_PTR, SpiSequenceId=0, SpiJobAssignment=SpiJob_0
    SpiHwConfiguration
      SpiHwConfigurationQspi0
        SpiClockConfiguration: SpiSleepEnable=false
        SpiHwDmaConfiguration: SpiHwDmaChannelReceptionRef=DmaChannel_0, SpiHwDmaChannelTransmissionRef=DmaChannel_1
        SpiHwPinConfiguration: SpiHWPinMISO=MRST0A_PORT20_PIN12
      SpiHwConfigurationQspi1
        SpiClockConfiguration: SpiSleepEnable=false
        SpiHwDmaConfiguration: SpiHwDmaChannelReceptionRef=DmaChannel_2, SpiHwDmaChannelTransmissionRef=DmaChannel_3
        SpiHwPinConfiguration: SpiHWPinMISO=MRST1A_PORT10_PIN1
      SpiHwConfigurationQspi2
        SpiClockConfiguration: SpiSleepEnable=false
        SpiHwDmaConfiguration: SpiHwDmaChannelReceptionRef=DmaChannel_4, SpiHwDmaChannelTransmissionRef=DmaChannel_5
        SpiHwPinConfiguration: SpiHWPinMISO=MRST2A_PORT15_PIN4
      SpiHwConfigurationQspi3
        SpiClockConfiguration: SpiSleepEnable=false
        SpiHwDmaConfiguration: SpiHwDmaChannelReceptionRef=DmaChannel_6, SpiHwDmaChannelTransmissionRef=DmaChannel_7
        SpiHwPinConfiguration: SpiHWPinMISO=MRST3A_PORT02_PIN5
    SpiPublishedInformation
    CommonPublishedInformation: ArMajorVersion=3, ArMinorVersion=2, ArPatchVersion=0, ModuleId=83, Release=_TRICORE_TC234, SwMajorVersion=4, SwMinorVersion=8, SwPatchVersion=0, VendorId=17
package /Gpt
  module config Gpt: implementation-config-variant=VARIANT-POST-BUILD-LOADABLE, module-description=Gpt_Impl
    GptChannelConfigSet_0 (GptChannelConfigSet)
      GptChannelConfiguration_0 (GptChannelConfiguration):
        GptChannelId = 0
        GptChannelMode = GPT_CH_MODE_CONTINUOUS
        GptChannelTickFrequency = 0
        GptChannelTickValueMax = 0
        GptEnableWakeup = false
        GptSignalType = GPT_QM_SIGNAL
        GptAssignedHwUnit = Tom_0/TomChannel_0
    GptConfigurationOfOptApiServices:
      GptDeinitApi = false
      GptEnableDisableNotificationApi = false
      GptRunningInUser0Mode = false
      GptTimeElapsedApi = false
      GptTimeRemainingApi = false
      GptUserModeDeInitApiEnable = false
      GptUserModeInitApiEnable = false
      GptUserModeRuntimeApiEnable = false
      GptVersionInfoApi = false
      GptWakeupFunctionalityApi = false
    GptDriverConfiguration: GptDebugSupport=false, GptDevErrorDetect=true, GptPBFixedAddress=false, GptReportWakeupSource=false
      GptClockReferencePoint_0 (GptClockReferencePoint)
    CommonPublishedInformation:
      ArMajorVersion = 3
      ArMinorVersion = 2
      ArPatchVersion = 0
      ModuleId = 100
      Release = _TRICORE_TC234
      SwMajorVersion = 3
      SwMinorVersion = 2
      SwPatchVersion = 0
      VendorId = 17
    GptSafety: GptGetModeApi=true, GptInitCheckApi=true, GptSafetyEnable=false
package /Pwm
  module config Pwm: implementation-config-variant=VARIANT-POST-BUILD-LOADABLE, module-description=Pwm_Impl
    PwmChannelConfigSet_0 (PwmChannelConfigSet)
      PwmChannel_0 (PwmChannel):
        PwmChannelClass = PWM_FIXED_PERIOD
        PwmChannelId = 0
        PwmDutycycleDefault = 0
        PwmIdleState = PWM_LOW
        PwmPeriodDefault = 0
        PwmPolarity = PWM_LOW
        PwmSafetySignal = PWM_QM_TYPE
        PwmAssignedHwUnit = Tom_0/TomChannel_1
    PwmConfigurationOfOptApiServices:
      PwmDeInitApi = false
      PwmGetOutputState = false
      PwmSetDutyCycle = false
      PwmSetOutputToIdle = false
      PwmSetPeriodAndDuty = false
      PwmSyncGrpUpdateDutiesApi = false
      PwmVersionInfoApi = false
    PwmGeneral:
      PwmChannelCoherentSelection = false
      PwmDevErrorDetect = true
      PwmDutyShiftInTicks = false
      PwmDutycycleUpdatedEndperiod = false
      PwmHandleShiftByOffset = false
      PwmIndex = 0
      PwmNotificationSupported = false
      PwmPBFixedAddress = false
      PwmPeriodUpdatedEndperiod = false
      PwmRunningInUser0Mode = false
      PwmUserModeDeInitApiEnable = false
      PwmUserModeInitApiEnable = false
      PwmUserModeRuntimeApiEnable = false
    CommonPublishedInformation:
      ArMajorVersion = 2
      ArMinorVersion = 5
      ArPatchVersion = 0
      ModuleId = 121
      Release = _TRICORE_TC234
      SwMajorVersion = 5
      SwMinorVersion = 1
      SwPatchVersion = 0
      VendorApiInfix = Gtm
      VendorId = 17
    PwmSafety: PwmSafetyEnable=false
package /Irq
  module config Irq: implementation-config-variant=VARIANT-PRE-COMPILE, module-description=Irq_Impl
    IrqGeneral: IrqOsekEnable=false
      IrqGeneral: IrqOsekEnable=false
    IrqAscLinConfig_0 (IrqAscLinConfig)
      IrqAscLinCatConfig
        IrqAscLinErrCatConfig: IrqAscLin0ErrorCat=CAT1, IrqAscLin1ErrorCat=CAT1
        IrqAscLinRxCatConfig: IrqAscLin0RxCat=CAT1, IrqAscLin1RxCat=CAT1
        IrqAscLinTxCatConfig: IrqAscLin0TxCat=CAT1, IrqAscLin1TxCat=CAT1
      IrqAscLinPrioConfig
        IrqAscLinErrPrioConfig: IrqAscLin0ErrorPrio=0, IrqAscLin1ErrorPrio=0
        IrqAscLinRxPrioConfig: IrqAscLin0RxPrio=0, IrqAscLin1RxPrio=0
        IrqAscLinTxPrioConfig: IrqAscLin0TxPrio=0, IrqAscLin1TxPrio=0
      IrqAscLinTosConfig
        IrqAscLinErrTosConfig: IrqAscLin0ErrTos=CPU0, IrqAscLin1ErrTos=CPU0
        IrqAscLinRxTosConfig: IrqAscLin0RxTos=CPU0, IrqAscLin1RxTos=CPU0
        IrqAscLinTxTosConfig: IrqAscLin0TxTos=CPU0, IrqAscLin1TxTos=CPU0
    IrqQspiConfig_0 (IrqQspiConfig)
      IrqQspiCatConfig
        IrqQspiErrCatConfig: IrqQspi0ErrCat=CAT1, IrqQspi1ErrCat=CAT1, IrqQspi2ErrCat=CAT1, IrqQspi3ErrCat=CAT1
        IrqQspiHCCatConfig: IrqQspi2HCCat=CAT1, IrqQspi3HCCat=CAT1
        IrqQspiPTCatConfig: IrqQspi0PTCat=CAT1, IrqQspi1PTCat=CAT1, IrqQspi2PTCat=CAT1, IrqQspi3PTCat=CAT1
        IrqQspiRxCatConfig: IrqQspi0RxCat=CAT1, IrqQspi1RxCat=CAT1, IrqQspi2RxCat=CAT1, IrqQspi3RxCat=CAT1
        IrqQspiTxCatConfig: IrqQspi0TxCat=CAT1, IrqQspi1TxCat=CAT1, IrqQspi2TxCat=CAT1, IrqQspi3TxCat=CAT1
        IrqQspiUDCatConfig: IrqQspi0UDCat=CAT1, IrqQspi1UDCat=CAT1, IrqQspi2UDCat=CAT1, IrqQspi3UDCat=CAT1
      IrqQspiPrioConfig
        IrqQspiErrPrioConfig: IrqQspi0ErrPrio=0, IrqQspi1ErrPrio=0, IrqQspi2ErrPrio=0, IrqQspi3ErrPrio=0
        IrqQspiHCPrioConfig: IrqQspi2HCPrio=0, IrqQspi3HCPrio=0
        IrqQspiPTPrioConfig: IrqQspi0PTPrio=0, IrqQspi1PTPrio=0, IrqQspi2PTPrio=0, IrqQspi3PTPrio=0
        IrqQspiRxPrioConfig: IrqQspi0RxPrio=0, IrqQspi1RxPrio=0, IrqQspi2RxPrio=0, IrqQspi3RxPrio=0
        IrqQspiTxPrioConfig: IrqQspi0TxPrio=0, IrqQspi1TxPrio=0, IrqQspi2TxPrio=0, IrqQspi3TxPrio=0
        IrqQspiUDPrioConfig: IrqQspi0UDPrio=0, IrqQspi1UDPrio=0, IrqQspi2UDPrio=0, IrqQspi3UDPrio=0
      IrqQspiTosConfig
        IrqQspiErrTosConfig: IrqQspi0ErrTos=CPU0, IrqQspi1ErrTos=CPU0, IrqQspi2ErrTos=CPU0, IrqQspi3ErrTos=CPU0
        IrqQspiHCTosConfig: IrqQspi2HCTos=CPU0, IrqQspi3HCTos=CPU0
        IrqQspiPTTosConfig: IrqQspi0PTTos=CPU0, IrqQspi1PTTos=CPU0, IrqQspi2PTTos=CPU0, IrqQspi3PTTos=CPU0
        IrqQspiRxTosConfig: IrqQspi0RxTos=CPU0, IrqQspi1RxTos=CPU0, IrqQspi2RxTos=CPU0, IrqQspi3RxTos=CPU0
        IrqQspiTxTosConfig: IrqQspi0TxTos=CPU0, IrqQspi1TxTos=CPU0, IrqQspi2TxTos=CPU0, IrqQspi3TxTos=CPU0
        IrqQspiUDTosConfig: IrqQspi0UDTos=CPU0, IrqQspi1UDTos=CPU0, IrqQspi2UDTos=CPU0, IrqQspi3UDTos=CPU0
    IrqCCU6Config_0 (IrqCCU6Config)
      IrqCCU60Config
        IrqCCU60CatConfig: IrqCCU60SR0Cat=CAT1, IrqCCU60SR1Cat=CAT1, IrqCCU60SR2Cat=CAT1, IrqCCU60SR3Cat=CAT1
        IrqCCU60PrioConfig: IrqCCU60SR0Prio=0, IrqCCU60SR1Prio=0, IrqCCU60SR2Prio=0, IrqCCU60SR3Prio=0
        IrqCCU60TosConfig: IrqCCU60SR0Tos=CPU0, IrqCCU60SR1Tos=CPU0, IrqCCU60SR2Tos=CPU0, IrqCCU60SR3Tos=CPU0
      IrqCCU61Config
        IrqCCU61CatConfig: IrqCCU61SR0Cat=CAT1, IrqCCU61SR1Cat=CAT1, IrqCCU61SR2Cat=CAT1, IrqCCU61SR3Cat=CAT1
        IrqCCU61PrioConfig: IrqCCU61SR0Prio=0, IrqCCU61SR1Prio=0, IrqCCU61SR2Prio=0, IrqCCU61SR3Prio=0
        IrqCCU61TosConfig: IrqCCU61SR0Tos=CPU0, IrqCCU61SR1Tos=CPU0, IrqCCU61SR2Tos=CPU0, IrqCCU61SR3Tos=CPU0
    IrqGptConfig_0 (IrqGptConfig)
      IrqGpt120Config
        IrqGpt120CatConfig: IrqGpt120CARPELCat=CAT1, IrqGpt120T2Cat=CAT1, IrqGpt120T3Cat=CAT1, IrqGpt120T4Cat=CAT1, IrqGpt120T5Cat=CAT1, IrqGpt120T6Cat=CAT1
        IrqGpt120PrioConfig: IrqGpt120CARPELPrio=0, IrqGpt120T2Prio=0, IrqGpt120T3Prio=0, IrqGpt120T4Prio=0, IrqGpt120T5Prio=0, IrqGpt120T6Prio=0
        IrqGpt120TosConfig: IrqGpt120CARPELTos=CPU0, IrqGpt120T2Tos=CPU0, IrqGpt120T3Tos=CPU0, IrqGpt120T4Tos=CPU0, IrqGpt120T5Tos=CPU0, IrqGpt120T6Tos=CPU0
    IrqStmConfig_0 (IrqStmConfig)
      IrqStm0Config
        IrqStm0CatConfig: IrqStm0SR0Cat=CAT1, IrqStm0SR1Cat=CAT1
        IrqStm0PrioConfig: IrqStm0SR0Prio=0, IrqStm0SR1Prio=0
        IrqStm0TosConfig: IrqStm0SR0Tos=CPU0, IrqStm0SR1Tos=CPU0
    IrqDmaConfig_0 (IrqDmaConfig)
      IrqDmaCatConfig:
        IrqDmaCh0SRCat = CAT1
        IrqDmaCh{10..15}SRCat = CAT1
        IrqDmaCh{1..9}SRCat = CAT1
        IrqDmaErrSRCat = CAT1
      IrqDmaPrioConfig:
        IrqDmaCh0SRPrio = 0
        IrqDmaCh{10..15}SRPrio = 0
        IrqDmaCh{1..9}SRPrio = 0
        IrqDmaErrSRPrio = 0
      IrqDmaTosConfig:
        IrqDmaCh0SRTos = CPU0
        IrqDmaCh{10..15}SRTos = CPU0
        IrqDmaCh{1..9}SRTos = CPU0
        IrqDmaErrSRTos = CPU0
    IrqETHConfig_0 (IrqETHConfig)
      IrqETHCatConfig: IrqETHSRCat=CAT1
      IrqETHPrioConfig: IrqETHSRPrio=0
      IrqETHTosConfig: IrqETHSRTos=CPU0
    IrqCanConfig_0 (IrqCanConfig)
      IrqCanCatConfig:
        IrqCanSR0Cat = CAT1
        IrqCanSR{10..19}Cat = CAT1
        IrqCanSR1Cat = CAT1
        IrqCanSR{20..23}Cat = CAT1
        IrqCanSR{2..9}Cat = CAT1
      IrqCanPrioConfig:
        IrqCanSR0Prio = 0
        IrqCanSR{10..19}Prio = 0
        IrqCanSR1Prio = 0
        IrqCanSR{20..23}Prio = 0
        IrqCanSR{2..9}Prio = 0
      IrqCanTosConfig:
        IrqCanSR0Tos = CPU0
        IrqCanSR{10..19}Tos = CPU0
        IrqCanSR1Tos = CPU0
        IrqCanSR{20..23}Tos = CPU0
        IrqCanSR{2..9}Tos = CPU0
    IrqAdcConfig_0 (IrqAdcConfig)
      IrqAdc0Config
        IrqAdc0CatConfig: IrqAdc0SR0Cat=CAT1, IrqAdc0SR1Cat=CAT1, IrqAdc0SR2Cat=CAT1, IrqAdc0SR3Cat=CAT1
        IrqAdc0PrioConfig: IrqAdc0SR0Prio=0, IrqAdc0SR1Prio=0, IrqAdc0SR2Prio=0, IrqAdc0SR3Prio=0
        IrqAdc0TosConfig: IrqAdc0SR0Tos=CPU0, IrqAdc0SR1Tos=CPU0, IrqAdc0SR2Tos=CPU0, IrqAdc0SR3Tos=CPU0
      IrqAdc1Config
        IrqAdc1CatConfig: IrqAdc1SR0Cat=CAT1, IrqAdc1SR1Cat=CAT1, IrqAdc1SR2Cat=CAT1, IrqAdc1SR3Cat=CAT1
        IrqAdc1PrioConfig: IrqAdc1SR0Prio=0, IrqAdc1SR1Prio=0, IrqAdc1SR2Prio=0, IrqAdc1SR3Prio=0
        IrqAdc1TosConfig: IrqAdc1SR0Tos=CPU0, IrqAdc1SR1Tos=CPU0, IrqAdc1SR2Tos=CPU0, IrqAdc1SR3Tos=CPU0
      IrqAdc2Config
        IrqAdc2CatConfig: IrqAdc2SR0Cat=CAT1, IrqAdc2SR1Cat=CAT1, IrqAdc2SR2Cat=CAT1, IrqAdc2SR3Cat=CAT1
        IrqAdc2PrioConfig: IrqAdc2SR0Prio=0, IrqAdc2SR1Prio=0, IrqAdc2SR2Prio=0, IrqAdc2SR3Prio=0
        IrqAdc2TosConfig: IrqAdc2SR0Tos=CPU0, IrqAdc2SR1Tos=CPU0, IrqAdc2SR2Tos=CPU0, IrqAdc2SR3Tos=CPU0
      IrqAdc3Config
        IrqAdc3CatConfig: IrqAdc3SR0Cat=CAT1, IrqAdc3SR1Cat=CAT1, IrqAdc3SR2Cat=CAT1, IrqAdc3SR3Cat=CAT1
        IrqAdc3PrioConfig: IrqAdc3SR0Prio=0, IrqAdc3SR1Prio=0, IrqAdc3SR2Prio=0, IrqAdc3SR3Prio=0
        IrqAdc3TosConfig: IrqAdc3SR0Tos=CPU0, IrqAdc3SR1Tos=CPU0, IrqAdc3SR2Tos=CPU0, IrqAdc3SR3Tos=CPU0
      IrqAdcCG0Config
        IrqAdcCG0CatConfig: IrqAdcCG0SR0Cat=CAT1, IrqAdcCG0SR1Cat=CAT1, IrqAdcCG0SR2Cat=CAT1, IrqAdcCG0SR3Cat=CAT1
        IrqAdcCG0PrioConfig: IrqAdcCG0SR0Prio=0, IrqAdcCG0SR1Prio=0, IrqAdcCG0SR2Prio=0, IrqAdcCG0SR3Prio=0
        IrqAdcCG0TosConfig: IrqAdcCG0SR0Tos=CPU0, IrqAdcCG0SR1Tos=CPU0, IrqAdcCG0SR2Tos=CPU0, IrqAdcCG0SR3Tos=CPU0
    IrqFlexRayConfig_0 (IrqFlexRayConfig)
      IrqFlexRay0Config
        IrqFlexRay0CatConfig:
          IrqFlexRay0IBBusyCat = CAT1
          IrqFlexRay0MBSC0Cat = CAT1
          IrqFlexRay0MBSC1Cat = CAT1
          IrqFlexRay0NewData0Cat = CAT1
          IrqFlexRay0NewData1Cat = CAT1
          IrqFlexRay0OBBusyCat = CAT1
          IrqFlexRay0SR0Cat = CAT1
          IrqFlexRay0SR1Cat = CAT1
          IrqFlexRay0TimerInt0Cat = CAT1
          IrqFlexRay0TimerInt1Cat = CAT1
        IrqFlexRay0PrioConfig:
          IrqFlexRay0IBBusyPrio = 0
          IrqFlexRay0MBSC0Prio = 0
          IrqFlexRay0MBSC1Prio = 0
          IrqFlexRay0NewData0Prio = 0
          IrqFlexRay0NewData1Prio = 0
          IrqFlexRay0OBBusyPrio = 0
          IrqFlexRay0SR0Prio = 0
          IrqFlexRay0SR1Prio = 0
          IrqFlexRay0TimerInt0Prio = 0
          IrqFlexRay0TimerInt1Prio = 0
        IrqFlexRay0TosConfig:
          IrqFlexRay0IBBusyTos = CPU0
          IrqFlexRay0MBSC0Tos = CPU0
          IrqFlexRay0MBSC1Tos = CPU0
          IrqFlexRay0NewData0Tos = CPU0
          IrqFlexRay0NewData1Tos = CPU0
          IrqFlexRay0OBBusyTos = CPU0
          IrqFlexRay0SR0Tos = CPU0
          IrqFlexRay0SR1Tos = CPU0
          IrqFlexRay0TimerInt0Tos = CPU0
          IrqFlexRay0TimerInt1Tos = CPU0
    IrqPMU0Config_0 (IrqPMU0Config)
      IrqPMU0CatConfig: IrqPMU0SR0Cat=CAT1, IrqPMU0SR1Cat=CAT1
      IrqPMU0PrioConfig: IrqPMU0SR0Prio=0, IrqPMU0SR1Prio=0
      IrqPMU0TosConfig: IrqPMU0SR0Tos=CPU0, IrqPMU0SR1Tos=CPU0
    IrqScuConfig_0 (IrqScuConfig)
      IrqScuCatConfig: IrqScuDtsSRCat=CAT1, IrqScuEruSR0Cat=CAT1, IrqScuEruSR1Cat=CAT1, IrqScuEruSR2Cat=CAT1, IrqScuEruSR3Cat=CAT1
      IrqScuPrioConfig: IrqScuDtsSRPrio=0, IrqScuEruSR0Prio=0, IrqScuEruSR1Prio=0, IrqScuEruSR2Prio=0, IrqScuEruSR3Prio=0
      IrqScuTosConfig: IrqScuDtsSRTos=CPU0, IrqScuEruSR0Tos=CPU0, IrqScuEruSR1Tos=CPU0, IrqScuEruSR2Tos=CPU0, IrqScuEruSR3Tos=CPU0
    IrqGPSRGroupConfig_0 (IrqGPSRGroupConfig)
      IrqGPSRGroup0Config
        IrqGPSRGroup0CatConfig: IrqGPSRGroup0SR0Cat=CAT1, IrqGPSRGroup0SR1Cat=CAT1, IrqGPSRGroup0SR2Cat=CAT1, IrqGPSRGroup0SR3Cat=CAT1
        IrqGPSRGroup0PrioConfig: IrqGPSRGroup0SR0Prio=0, IrqGPSRGroup0SR1Prio=0, IrqGPSRGroup0SR2Prio=0, IrqGPSRGroup0SR3Prio=0
        IrqGPSRGroup0TosConfig: IrqGPSRGroup0SR0Tos=CPU0, IrqGPSRGroup0SR1Tos=CPU0, IrqGPSRGroup0SR2Tos=CPU0, IrqGPSRGroup0SR3Tos=CPU0
    IrqGtmConfig_0 (IrqGtmConfig)
      IrqGtmAEIConfig
        IrqGtmAEICatConfig: IrqGtmAEICat=CAT1
        IrqGtmAEIPrioConfig: IrqGtmAEIPrio=0
        IrqGtmAEITosConfig: IrqGtmAEITos=CPU0
      IrqGtmERRConfig
        IrqGtmERRCatConfig: IrqGtmERRSRCat=CAT1
        IrqGtmERRPrioConfig: IrqGtmERRSRPrio=0
        IrqGtmERRTosConfig: IrqGtmERRSRTos=CPU0
      IrqGtmTIM0Config
        IrqGtmTIM0CatConfig:
          IrqGtmTIM0SR{0..7}Cat = CAT1
        IrqGtmTIM0PrioConfig:
          IrqGtmTIM0SR{0..7}Prio = 0
        IrqGtmTIM0TosConfig:
          IrqGtmTIM0SR{0..7}Tos = CPU0
      IrqGtmTOM0Config
        IrqGtmTOM0CatConfig:
          IrqGtmTOM0SR{0..7}Cat = CAT1
        IrqGtmTOM0PrioConfig:
          IrqGtmTOM0SR{0..7}Prio = 0
        IrqGtmTOM0TosConfig:
          IrqGtmTOM0SR{0..7}Tos = CPU0
      IrqGtmTOM1Config
        IrqGtmTOM1CatConfig:
          IrqGtmTOM1SR{0..7}Cat = CAT1
        IrqGtmTOM1PrioConfig:
          IrqGtmTOM1SR{0..7}Prio = 0
        IrqGtmTOM1TosConfig:
          IrqGtmTOM1SR{0..7}Tos = CPU0
    IrqSentConfig_0 (IrqSentConfig)
      IrqSentCatConfig: IrqSentSR0Cat=CAT1, IrqSentSR1Cat=CAT1, IrqSentSR2Cat=CAT1, IrqSentSR3Cat=CAT1
      IrqSentPrioConfig: IrqSentSR0Prio=0, IrqSentSR1Prio=0, IrqSentSR2Prio=0, IrqSentSR3Prio=0
      IrqSentTosConfig: IrqSentSR0Tos=CPU0, IrqSentSR1Tos=CPU0, IrqSentSR2Tos=CPU0, IrqSentSR3Tos=CPU0
    IrqHSMConfig_0 (IrqHSMConfig)
      IrqHSMCatConfig: IrqHSMSR0Cat=CAT1, IrqHSMSR1Cat=CAT1
      IrqHSMPrioConfig: IrqHSMSR0Prio=0, IrqHSMSR1Prio=0
      IrqHSMTosConfig: IrqHSMSR0Tos=CPU0, IrqHSMSR1Tos=CPU0
    CommonPublishedInformation:
      ArMajorVersion = 0
      ArMinorVersion = 0
      ArPatchVersion = 0
      ModuleId = 255
      Release = _TRICORE_TC234
      SwMajorVersion = 2
      SwMinorVersion = 1
      SwPatchVersion = 0
      VendorId = 17
package /Mcu
  module config Mcu: implementation-config-variant=VARIANT-POST-BUILD-LOADABLE, module-description=Mcu_Impl
    McuPublishedInformation
      16 x McuResetReasonConf, all with McuResetReason=0:
        MCU_CB0_RESET
        MCU_CB1_RESET
        MCU_CB3_RESET
        MCU_ESR0_RESET
        MCU_ESR1_RESET
        MCU_EVR13_RESET
        MCU_EVR33_RESET
        MCU_POWER_ON_RESET
        MCU_RESET_MULTIPLE
        MCU_RESET_UNDEFINED
        MCU_SMU_RESET
        MCU_STBYR_RESET
        MCU_STM0_RESET
        MCU_SUPPLY_WDOG_RESET
        MCU_SW_RESET
        MCU_TP_RESET
    McuGeneralConfiguration:
      McuClearColdResetApi = false
      McuDeInitApi = false
      McuDevErrorDetect = true
      McuErayPllInitDelay = 10
      McuFmPllEnable = false
      McuGetRamStateApi = false
      McuInitClock = true
      McuMainOscillatorFrequency = 20
      McuNoPll = false
      McuPBFixedAddress = false
      McuPerformResetApi = true
      McuPllInitDelay = 10
      McuResetSfrAtInit = false
      McuRunningInUser0Mode = false
      McuUserModeDeInitApiEnable = false
      McuUserModeInitApiEnable = false
      McuUserModeRuntimeApiEnable = false
      McuVersionInfoApi = false
    McuModuleConfiguration_0 (McuModuleConfiguration): McuClockSrcFailureNotification=DISABLED, McuNumberOfMcuModes=1, McuRamSectors=0, McuResetSetting=1, McuStm0ResetDisable=false
      AscLinConfiguration: AscLin0=USE_FOR_NONE, AscLin1=USE_FOR_NONE
      CcuConfiguration_0 (CcuConfiguration)
        Ccu60 (Ccu6)
          General: Ccu6ModuleUsage=UNUSED
          T12
            3 x Cc6:
              Cc60: CCChannelInputSelection=CCINA_PORT2_PIN0
              Cc61: CCChannelInputSelection=CCINA_PORT2_PIN2
              Cc62: CCChannelInputSelection=CCINA_PORT2_PIN4
            General: T12ClkSelection=0, T12PrescalerEnabled=false
          T13
            General: T13ClkSelection=0, T13PrescalerEnabled=false
        Ccu61 (Ccu6)
          General: Ccu6ModuleUsage=UNUSED
          T12
            3 x Cc6:
              Cc60: CCChannelInputSelection=CCINA_PORT0_PIN1
              Cc61: CCChannelInputSelection=CCINA_PORT0_PIN3
              Cc62: CCChannelInputSelection=CCINA_PORT0_PIN5
            General: T12ClkSelection=0, T12PrescalerEnabled=false
          T13
            General: T13ClkSelection=0, T13PrescalerEnabled=false
      DmaConfiguration_0 (DmaConfiguration)
        16 x DmaChannel:
          DmaChannel_0: ChannelId=0, ChannelUsed=USE_FOR_SPI_DRIVER
          DmaChannel_1: ChannelId=1, ChannelUsed=USE_FOR_SPI_DRIVER
          DmaChannel_{10..15}: ChannelId={10..15}, ChannelUsed=USE_FOR_NONE
          DmaChannel_{2..7}: ChannelId={2..7}, ChannelUsed=USE_FOR_SPI_DRIVER
          DmaChannel_8: ChannelId=8, ChannelUsed=USE_FOR_NONE
          DmaChannel_9: ChannelId=9, ChannelUsed=USE_FOR_NONE
      EruConfiguration_0 (EruConfiguration)
        ERU{0..7}: EruChannelUsage=UNUSED
      GtmConfiguration_0 (GtmConfiguration)
        Cmu_0 (Cmu)
          CmuConfigurableClock:
            CmuClk6SourceSelect = CMU_CLK_6_DIVIDER
            CmuClk7SourceSelect = CMU_CLK_7_DIVIDER
            CmuConfigurableClk{0..7}Div = 0
            CmuEnableConfigurableClk{0..7} = false
          CmuExternalClock:
            CmuEnableExternalClk{0..2} = false
            CmuExternalClk0Denominator = 1
            CmuExternalClk0Numerator = 1
            CmuExternalClk1Denominator = 1
            CmuExternalClk1Numerator = 1
            CmuExternalClk2Denominator = 1
            CmuExternalClk2Numerator = 1
          CmuFixedClock: CmuEnableAllFixedClocks=true, CmuFxdClkSourceSelect=GTM_GLOBAL_CLOCK
        GtmAeiInterface:
          GtmAeiIllegalModuleAddErrIntEn = false
          GtmAeiIllegalModuleAddIntEn = false
          GtmAeiInterruptMode = GTM_INTERRUPT_LEVEL_MODE
          GtmAeiTimeOutMode = OBSERVE
          GtmAeiTimeOutValue = 0
          GtmAeiTimeoutExceptionErrIntEn = false
          GtmAeiTimeoutExceptionIntEn = false
          GtmAeiUnsupportedAddressErrIntEn = false
          GtmAeiUnsupportedAddressIntEn = false
          GtmAeiUnsupportedByteEnErrIntEn = false
          GtmAeiUnsupportedByteEnIntEn = false
        GtmConnections_0 (GtmConnections)
          4 x GtmTriggerForAdc, all with GtmTrigger0Select=TRIG_0_NONE, GtmTrigger1Select=TRIG_0_NONE:
            GtmTriggerForAdc_{0..3}
          4 x GtmTtcanTrigger:
            GtmTtcanTrigger_0: GtmTriggerSelect=SEL0_TOM0_CH0
            GtmTtcanTrigger_1: GtmTriggerSelect=SEL0_TOM1_CH0
            GtmTtcanTrigger_2: GtmTriggerSelect=SEL0_TOM0_CH0
            GtmTtcanTrigger_3: GtmTriggerSelect=SEL0_TOM1_CH0
        GtmGeneral: GtmEnRstAndForceIntFunctionality=false, GtmGlobalClkDivDenominator=1, GtmGlobalClkDivNumerator=1, GtmSleepMode=GTM_SLEEP_ENABLE
        Tbu_0 (Tbu)
          3 x TbuChannel, all with TbuChannelClockSource=GTM_CONFIGURABLE_CLOCK_0, TbuChannelModeSelect=FREE_RUNNING_COUNTER_MODE, TbuChannelResolution=BITS_0_TO_23, TbuChannelUsage=USED_BY_OTHER_DRIVERS_OR_UNUSED, TbuEnableChannel=false, TbuTimebaseValue=0:
            TbuChannel_{0..2}
        Tim_0 (Tim)
          8 x TimChannel:
            TimChannel_0
              TimChannelErrorInterrupt:
                TimInterruptEnableOnCntOflErr = false
                TimInterruptEnableOnEcntOflErr = false
                TimInterruptEnableOnGlitchDetErr = false
                TimInterruptEnableOnGprxOflErr = false
                TimInterruptEnableOnNewValErr = false
                TimInterruptEnableOnToDetErr = false
              TimChannelFilterConfig:
                TimChFilterCounterFreqSelect = GTM_CONFIGURABLE_CLOCK_0
                TimChFilterModeForFallingEdge = IMMEDIATE_EDGE_PROPAGATION_MODE
                TimChFilterModeForRisingEdge = IMMEDIATE_EDGE_PROPAGATION_MODE
                TimChFilterTimeForFallingEdge = 0
                TimChFilterTimeForRisingEdge = 0
                TimChannelFilterEnable = false
              TimChannelGeneral:
                TimChannelClockSelect = GTM_CONFIGURABLE_CLOCK_0
                TimChannelCntsInputSelect = CNT_VALUE
                TimChannelCntsValue = 0
                TimChannelEcntOvflwSetting = SEL0_OVRFLOW_SIG_ON_ECNT_BITWIDTH_8
                TimChannelEcntResetSetting = SEL0_ECNT_IN_WRAP_AROUND_MODE
                TimChannelEnable = false
                TimChannelExtCaptureModeEnable = false
                TimChannelExtCaptureSrc = SEL0_NEW_VAL_IRQ
                TimChannelGpr0InputSelect = TIMEBASE_TBU_TS0
                TimChannelGpr1InputSelect = TIMEBASE_TBU_TS0
                TimChannelInputSelect = INPUT_OF_CURRENT_TIM_CHANNEL
                TimChannelModeSelect = PWM_MEASUREMENT_MODE_TPWM
                TimChannelOneShotMode = false
                TimChannelPortPinSelect = NONE_SEL0
                TimChannelSignalEdgeSelect = FALLING_EDGE
                TimChannelTbu0Ts0BitsSelect = BITS_0_TO_23
                TimChannelUsage = USED_BY_OTHER_DRIVERS_OR_UNUSED
                TimChannelValInitSignal = VAL_LOW
              TimChannelInterrupt:
                TimInterruptEnableOnCntOfl = false
                TimInterruptEnableOnEcntOfl = false
                TimInterruptEnableOnGlitchDet = false
                TimInterruptEnableOnGprxOfl = false
                TimInterruptEnableOnNewVal = false
                TimInterruptEnableOnToDet = false
                TimInterruptMode = GTM_INTERRUPT_LEVEL_MODE
                TimNotification = NULL_PTR
              TimChannelTimeoutDetection: TimChTimeoutClockSelect=GTM_CONFIGURABLE_CLOCK_0, TimChTimeoutDetectionEnable=SEL0_TIMOUT_DISABLED, TimChTimeoutDuration=0
            TimChannel_1
              TimChannelErrorInterrupt:
                TimInterruptEnableOnCntOflErr = false
                TimInterruptEnableOnEcntOflErr = false
                TimInterruptEnableOnGlitchDetErr = false
                TimInterruptEnableOnGprxOflErr = false
                TimInterruptEnableOnNewValErr = false
                TimInterruptEnableOnToDetErr = false
              TimChannelFilterConfig:
                TimChFilterCounterFreqSelect = GTM_CONFIGURABLE_CLOCK_0
                TimChFilterModeForFallingEdge = IMMEDIATE_EDGE_PROPAGATION_MODE
                TimChFilterModeForRisingEdge = IMMEDIATE_EDGE_PROPAGATION_MODE
                TimChFilterTimeForFallingEdge = 0
                TimChFilterTimeForRisingEdge = 0
                TimChannelFilterEnable = false
              TimChannelGeneral:
                TimChannelClockSelect = GTM_CONFIGURABLE_CLOCK_0
                TimChannelCntsInputSelect = CNT_VALUE
                TimChannelCntsValue = 0
                TimChannelEcntOvflwSetting = SEL0_OVRFLOW_SIG_ON_ECNT_BITWIDTH_8
                TimChannelEcntResetSetting = SEL0_ECNT_IN_WRAP_AROUND_MODE
                TimChannelEnable = false
                TimChannelExtCaptureModeEnable = false
                TimChannelExtCaptureSrc = SEL0_NEW_VAL_IRQ
                TimChannelGpr0InputSelect = TIMEBASE_TBU_TS0
                TimChannelGpr1InputSelect = TIMEBASE_TBU_TS0
                TimChannelInputSelect = INPUT_OF_CURRENT_TIM_CHANNEL
                TimChannelModeSelect = PWM_MEASUREMENT_MODE_TPWM
                TimChannelOneShotMode = false
                TimChannelPortPinSelect = NONE_SEL0
                TimChannelSignalEdgeSelect = FALLING_EDGE
                TimChannelTbu0Ts0BitsSelect = BITS_0_TO_23
                TimChannelUsage = USED_BY_OTHER_DRIVERS_OR_UNUSED
                TimChannelValInitSignal = VAL_LOW
              TimChannelInterrupt:
                TimInterruptEnableOnCntOfl = false
                TimInterruptEnableOnEcntOfl = false
                TimInterruptEnableOnGlitchDet = false
                TimInterruptEnableOnGprxOfl = false
                TimInterruptEnableOnNewVal = false
                TimInterruptEnableOnToDet = false
                TimInterruptMode = GTM_INTERRUPT_LEVEL_MODE
                TimNotification = NULL_PTR
              TimChannelTimeoutDetection: TimChTimeoutClockSelect=GTM_CONFIGURABLE_CLOCK_0, TimChTimeoutDetectionEnable=SEL0_TIMOUT_DISABLED, TimChTimeoutDuration=0
            TimChannel_2
              TimChannelErrorInterrupt:
                TimInterruptEnableOnCntOflErr = false
                TimInterruptEnableOnEcntOflErr = false
                TimInterruptEnableOnGlitchDetErr = false
                TimInterruptEnableOnGprxOflErr = false
                TimInterruptEnableOnNewValErr = false
                TimInterruptEnableOnToDetErr = false
              TimChannelFilterConfig:
                TimChFilterCounterFreqSelect = GTM_CONFIGURABLE_CLOCK_0
                TimChFilterModeForFallingEdge = IMMEDIATE_EDGE_PROPAGATION_MODE
                TimChFilterModeForRisingEdge = IMMEDIATE_EDGE_PROPAGATION_MODE
                TimChFilterTimeForFallingEdge = 0
                TimChFilterTimeForRisingEdge = 0
                TimChannelFilterEnable = false
              TimChannelGeneral:
                TimChannelClockSelect = GTM_CONFIGURABLE_CLOCK_0
                TimChannelCntsInputSelect = CNT_VALUE
                TimChannelCntsValue = 0
                TimChannelEcntOvflwSetting = SEL0_OVRFLOW_SIG_ON_ECNT_BITWIDTH_8
                TimChannelEcntResetSetting = SEL0_ECNT_IN_WRAP_AROUND_MODE
                TimChannelEnable = false
                TimChannelExtCaptureModeEnable = false
                TimChannelExtCaptureSrc = SEL0_NEW_VAL_IRQ
                TimChannelGpr0InputSelect = TIMEBASE_TBU_TS0
                TimChannelGpr1InputSelect = TIMEBASE_TBU_TS0
                TimChannelInputSelect = INPUT_OF_CURRENT_TIM_CHANNEL
                TimChannelModeSelect = PWM_MEASUREMENT_MODE_TPWM
                TimChannelOneShotMode = false
                TimChannelPortPinSelect = NONE_SEL0
                TimChannelSignalEdgeSelect = FALLING_EDGE
                TimChannelTbu0Ts0BitsSelect = BITS_0_TO_23
                TimChannelUsage = USED_BY_OTHER_DRIVERS_OR_UNUSED
                TimChannelValInitSignal = VAL_LOW
              TimChannelInterrupt:
                TimInterruptEnableOnCntOfl = false
                TimInterruptEnableOnEcntOfl = false
                TimInterruptEnableOnGlitchDet = false
                TimInterruptEnableOnGprxOfl = false
                TimInterruptEnableOnNewVal = false
                TimInterruptEnableOnToDet = false
                TimInterruptMode = GTM_INTERRUPT_LEVEL_MODE
                TimNotification = NULL_PTR
              TimChannelTimeoutDetection: TimChTimeoutClockSelect=GTM_CONFIGURABLE_CLOCK_0, TimChTimeoutDetectionEnable=SEL0_TIMOUT_DISABLED, TimChTimeoutDuration=0
            TimChannel_3
              TimChannelErrorInterrupt:
                TimInterruptEnableOnCntOflErr = false
                TimInterruptEnableOnEcntOflErr = false
                TimInterruptEnableOnGlitchDetErr = false
                TimInterruptEnableOnGprxOflErr = false
                TimInterruptEnableOnNewValErr = false
                TimInterruptEnableOnToDetErr = false
              TimChannelFilterConfig:
                TimChFilterCounterFreqSelect = GTM_CONFIGURABLE_CLOCK_0
                TimChFilterModeForFallingEdge = IMMEDIATE_EDGE_PROPAGATION_MODE
                TimChFilterModeForRisingEdge = IMMEDIATE_EDGE_PROPAGATION_MODE
                TimChFilterTimeForFallingEdge = 0
                TimChFilterTimeForRisingEdge = 0
                TimChannelFilterEnable = false
              TimChannelGeneral:
                TimChannelClockSelect = GTM_CONFIGURABLE_CLOCK_0
                TimChannelCntsInputSelect = CNT_VALUE
                TimChannelCntsValue = 0
                TimChannelEcntOvflwSetting = SEL0_OVRFLOW_SIG_ON_ECNT_BITWIDTH_8
                TimChannelEcntResetSetting = SEL0_ECNT_IN_WRAP_AROUND_MODE
                TimChannelEnable = false
                TimChannelExtCaptureModeEnable = false
                TimChannelExtCaptureSrc = SEL0_NEW_VAL_IRQ
                TimChannelGpr0InputSelect = TIMEBASE_TBU_TS0
                TimChannelGpr1InputSelect = TIMEBASE_TBU_TS0
                TimChannelInputSelect = INPUT_OF_CURRENT_TIM_CHANNEL
                TimChannelModeSelect = PWM_MEASUREMENT_MODE_TPWM
                TimChannelOneShotMode = false
                TimChannelPortPinSelect = NONE_SEL0
                TimChannelSignalEdgeSelect = FALLING_EDGE
                TimChannelTbu0Ts0BitsSelect = BITS_0_TO_23
                TimChannelUsage = USED_BY_OTHER_DRIVERS_OR_UNUSED
                TimChannelValInitSignal = VAL_LOW
              TimChannelInterrupt:
                TimInterruptEnableOnCntOfl = false
                TimInterruptEnableOnEcntOfl = false
                TimInterruptEnableOnGlitchDet = false
                TimInterruptEnableOnGprxOfl = false
                TimInterruptEnableOnNewVal = false
                TimInterruptEnableOnToDet = false
                TimInterruptMode = GTM_INTERRUPT_LEVEL_MODE
                TimNotification = NULL_PTR
              TimChannelTimeoutDetection: TimChTimeoutClockSelect=GTM_CONFIGURABLE_CLOCK_0, TimChTimeoutDetectionEnable=SEL0_TIMOUT_DISABLED, TimChTimeoutDuration=0
            TimChannel_4
              TimChannelErrorInterrupt:
                TimInterruptEnableOnCntOflErr = false
                TimInterruptEnableOnEcntOflErr = false
                TimInterruptEnableOnGlitchDetErr = false
                TimInterruptEnableOnGprxOflErr = false
                TimInterruptEnableOnNewValErr = false
                TimInterruptEnableOnToDetErr = false
              TimChannelFilterConfig:
                TimChFilterCounterFreqSelect = GTM_CONFIGURABLE_CLOCK_0
                TimChFilterModeForFallingEdge = IMMEDIATE_EDGE_PROPAGATION_MODE
                TimChFilterModeForRisingEdge = IMMEDIATE_EDGE_PROPAGATION_MODE
                TimChFilterTimeForFallingEdge = 0
                TimChFilterTimeForRisingEdge = 0
                TimChannelFilterEnable = false
              TimChannelGeneral:
                TimChannelClockSelect = GTM_CONFIGURABLE_CLOCK_0
                TimChannelCntsInputSelect = CNT_VALUE
                TimChannelCntsValue = 0
                TimChannelEcntOvflwSetting = SEL0_OVRFLOW_SIG_ON_ECNT_BITWIDTH_8
                TimChannelEcntResetSetting = SEL0_ECNT_IN_WRAP_AROUND_MODE
                TimChannelEnable = false
                TimChannelExtCaptureModeEnable = false
                TimChannelExtCaptureSrc = SEL0_NEW_VAL_IRQ
                TimChannelGpr0InputSelect = TIMEBASE_TBU_TS0
                TimChannelGpr1InputSelect = TIMEBASE_TBU_TS0
                TimChannelInputSelect = INPUT_OF_CURRENT_TIM_CHANNEL
                TimChannelModeSelect = PWM_MEASUREMENT_MODE_TPWM
                TimChannelOneShotMode = false
                TimChannelPortPinSelect = NONE_SEL0
                TimChannelSignalEdgeSelect = FALLING_EDGE
                TimChannelTbu0Ts0BitsSelect = BITS_0_TO_23
                TimChannelUsage = USED_BY_OTHER_DRIVERS_OR_UNUSED
                TimChannelValInitSignal = VAL_LOW
              TimChannelInterrupt:
                TimInterruptEnableOnCntOfl = false
                TimInterruptEnableOnEcntOfl = false
                TimInterruptEnableOnGlitchDet = false
                TimInterruptEnableOnGprxOfl = false
                TimInterruptEnableOnNewVal = false
                TimInterruptEnableOnToDet = false
                TimInterruptMode = GTM_INTERRUPT_LEVEL_MODE
                TimNotification = NULL_PTR
              TimChannelTimeoutDetection: TimChTimeoutClockSelect=GTM_CONFIGURABLE_CLOCK_0, TimChTimeoutDetectionEnable=SEL0_TIMOUT_DISABLED, TimChTimeoutDuration=0
            TimChannel_5
              TimChannelErrorInterrupt:
                TimInterruptEnableOnCntOflErr = false
                TimInterruptEnableOnEcntOflErr = false
                TimInterruptEnableOnGlitchDetErr = false
                TimInterruptEnableOnGprxOflErr = false
                TimInterruptEnableOnNewValErr = false
                TimInterruptEnableOnToDetErr = false
              TimChannelFilterConfig:
                TimChFilterCounterFreqSelect = GTM_CONFIGURABLE_CLOCK_0
                TimChFilterModeForFallingEdge = IMMEDIATE_EDGE_PROPAGATION_MODE
                TimChFilterModeForRisingEdge = IMMEDIATE_EDGE_PROPAGATION_MODE
                TimChFilterTimeForFallingEdge = 0
                TimChFilterTimeForRisingEdge = 0
                TimChannelFilterEnable = false
              TimChannelGeneral:
                TimChannelClockSelect = GTM_CONFIGURABLE_CLOCK_0
                TimChannelCntsInputSelect = CNT_VALUE
                TimChannelCntsValue = 0
                TimChannelEcntOvflwSetting = SEL0_OVRFLOW_SIG_ON_ECNT_BITWIDTH_8
                TimChannelEcntResetSetting = SEL0_ECNT_IN_WRAP_AROUND_MODE
                TimChannelEnable = false
                TimChannelExtCaptureModeEnable = false
                TimChannelExtCaptureSrc = SEL0_NEW_VAL_IRQ
                TimChannelGpr0InputSelect = TIMEBASE_TBU_TS0
                TimChannelGpr1InputSelect = TIMEBASE_TBU_TS0
                TimChannelInputSelect = INPUT_OF_CURRENT_TIM_CHANNEL
                TimChannelModeSelect = PWM_MEASUREMENT_MODE_TPWM
                TimChannelOneShotMode = false
                TimChannelPortPinSelect = NONE_SEL0
                TimChannelSignalEdgeSelect = FALLING_EDGE
                TimChannelTbu0Ts0BitsSelect = BITS_0_TO_23
                TimChannelUsage = USED_BY_OTHER_DRIVERS_OR_UNUSED
                TimChannelValInitSignal = VAL_LOW
              TimChannelInterrupt:
                TimInterruptEnableOnCntOfl = false
                TimInterruptEnableOnEcntOfl = false
                TimInterruptEnableOnGlitchDet = false
                TimInterruptEnableOnGprxOfl = false
                TimInterruptEnableOnNewVal = false
                TimInterruptEnableOnToDet = false
                TimInterruptMode = GTM_INTERRUPT_LEVEL_MODE
                TimNotification = NULL_PTR
              TimChannelTimeoutDetection: TimChTimeoutClockSelect=GTM_CONFIGURABLE_CLOCK_0, TimChTimeoutDetectionEnable=SEL0_TIMOUT_DISABLED, TimChTimeoutDuration=0
            TimChannel_6
              TimChannelErrorInterrupt:
                TimInterruptEnableOnCntOflErr = false
                TimInterruptEnableOnEcntOflErr = false
                TimInterruptEnableOnGlitchDetErr = false
                TimInterruptEnableOnGprxOflErr = false
                TimInterruptEnableOnNewValErr = false
                TimInterruptEnableOnToDetErr = false
              TimChannelFilterConfig:
                TimChFilterCounterFreqSelect = GTM_CONFIGURABLE_CLOCK_0
                TimChFilterModeForFallingEdge = IMMEDIATE_EDGE_PROPAGATION_MODE
                TimChFilterModeForRisingEdge = IMMEDIATE_EDGE_PROPAGATION_MODE
                TimChFilterTimeForFallingEdge = 0
                TimChFilterTimeForRisingEdge = 0
                TimChannelFilterEnable = false
              TimChannelGeneral:
                TimChannelClockSelect = GTM_CONFIGURABLE_CLOCK_0
                TimChannelCntsInputSelect = CNT_VALUE
                TimChannelCntsValue = 0
                TimChannelEcntOvflwSetting = SEL0_OVRFLOW_SIG_ON_ECNT_BITWIDTH_8
                TimChannelEcntResetSetting = SEL0_ECNT_IN_WRAP_AROUND_MODE
                TimChannelEnable = false
                TimChannelExtCaptureModeEnable = false
                TimChannelExtCaptureSrc = SEL0_NEW_VAL_IRQ
                TimChannelGpr0InputSelect = TIMEBASE_TBU_TS0
                TimChannelGpr1InputSelect = TIMEBASE_TBU_TS0
                TimChannelInputSelect = INPUT_OF_CURRENT_TIM_CHANNEL
                TimChannelModeSelect = PWM_MEASUREMENT_MODE_TPWM
                TimChannelOneShotMode = false
                TimChannelPortPinSelect = NONE_SEL0
                TimChannelSignalEdgeSelect = FALLING_EDGE
                TimChannelTbu0Ts0BitsSelect = BITS_0_TO_23
                TimChannelUsage = USED_BY_OTHER_DRIVERS_OR_UNUSED
                TimChannelValInitSignal = VAL_LOW
              TimChannelInterrupt:
                TimInterruptEnableOnCntOfl = false
                TimInterruptEnableOnEcntOfl = false
                TimInterruptEnableOnGlitchDet = false
                TimInterruptEnableOnGprxOfl = false
                TimInterruptEnableOnNewVal = false
                TimInterruptEnableOnToDet = false
                TimInterruptMode = GTM_INTERRUPT_LEVEL_MODE
                TimNotification = NULL_PTR
              TimChannelTimeoutDetection: TimChTimeoutClockSelect=GTM_CONFIGURABLE_CLOCK_0, TimChTimeoutDetectionEnable=SEL0_TIMOUT_DISABLED, TimChTimeoutDuration=0
            TimChannel_7
              TimChannelErrorInterrupt:
                TimInterruptEnableOnCntOflErr = false
                TimInterruptEnableOnEcntOflErr = false
                TimInterruptEnableOnGlitchDetErr = false
                TimInterruptEnableOnGprxOflErr = false
                TimInterruptEnableOnNewValErr = false
                TimInterruptEnableOnToDetErr = false
              TimChannelFilterConfig:
                TimChFilterCounterFreqSelect = GTM_CONFIGURABLE_CLOCK_0
                TimChFilterModeForFallingEdge = IMMEDIATE_EDGE_PROPAGATION_MODE
                TimChFilterModeForRisingEdge = IMMEDIATE_EDGE_PROPAGATION_MODE
                TimChFilterTimeForFallingEdge = 0
                TimChFilterTimeForRisingEdge = 0
                TimChannelFilterEnable = false
              TimChannelGeneral:
                TimChannelClockSelect = GTM_CONFIGURABLE_CLOCK_0
                TimChannelCntsInputSelect = CNT_VALUE
                TimChannelCntsValue = 0
                TimChannelEcntOvflwSetting = SEL0_OVRFLOW_SIG_ON_ECNT_BITWIDTH_8
                TimChannelEcntResetSetting = SEL0_ECNT_IN_WRAP_AROUND_MODE
                TimChannelEnable = false
                TimChannelExtCaptureModeEnable = false
                TimChannelExtCaptureSrc = SEL0_NEW_VAL_IRQ
                TimChannelGpr0InputSelect = TIMEBASE_TBU_TS0
                TimChannelGpr1InputSelect = TIMEBASE_TBU_TS0
                TimChannelInputSelect = INPUT_OF_CURRENT_TIM_CHANNEL
                TimChannelModeSelect = PWM_MEASUREMENT_MODE_TPWM
                TimChannelOneShotMode = false
                TimChannelPortPinSelect = NONE_SEL0
                TimChannelSignalEdgeSelect = FALLING_EDGE
                TimChannelTbu0Ts0BitsSelect = BITS_0_TO_23
                TimChannelUsage = USED_BY_OTHER_DRIVERS_OR_UNUSED
                TimChannelValInitSignal = VAL_LOW
              TimChannelInterrupt:
                TimInterruptEnableOnCntOfl = false
                TimInterruptEnableOnEcntOfl = false
                TimInterruptEnableOnGlitchDet = false
                TimInterruptEnableOnGprxOfl = false
                TimInterruptEnableOnNewVal = false
                TimInterruptEnableOnToDet = false
                TimInterruptMode = GTM_INTERRUPT_LEVEL_MODE
                TimNotification = NULL_PTR
              TimChannelTimeoutDetection: TimChTimeoutClockSelect=GTM_CONFIGURABLE_CLOCK_0, TimChTimeoutDetectionEnable=SEL0_TIMOUT_DISABLED, TimChTimeoutDuration=0
        Tom_0 (Tom)
          16 x TomChannel:
            TomChannel_0
              TomChannelEnable: TomChDisableOnTgcTrigger=false, TomChannelEnable=AT_START
              TomChannelInterrupt: TomIntEnableOnDutyCycleMatchCcu1=false, TomIntEnableOnPeriodMatchCcu0=false, TomInterruptMode=GTM_INTERRUPT_LEVEL_MODE, TomNotification=NULL_PTR
              TomChannelOutput:
                TomChOutputDisableOnTgcTrig = false
                TomChannelOutputControl = DONT_ENABLE_CHANNEL_OUTPUT
                TomChannelOutputSignalLevel = LOW
                TomChannelPortPinSelect = TOUT18_SELA_PORT0_PIN9
              TomChannelTimerParameters:
                TomChDCycCompareShadowValSr1 = 0
                TomChEnableForceUpdate = false
                TomChPeriodCompareShadowValSr0 = 0
                TomChResetCn0OnForceUpdate = false
                TomChUpdateEnableOnCn0Reset = false
                TomChannelBitReversalMode = false
                TomChannelClockSelect = GTM_FIXED_CLOCK_0
                TomChannelCounterCn0Reset = ON_COMPARE_MATCH_ON_CHANNEL
                TomChannelCounterValCn0 = 0
                TomChannelDutyCycleCompareValCm1 = 0
                TomChannelExtCounterCn0Reset = TRIG_ON_PREV_COMPARE_MATCH
                TomChannelExtTriggerOutput = EXT_TRIG_FROM_PREVIOUS_CHANNEL
                TomChannelOneShotMode = false
                TomChannelPeriodCompareValCm0 = 0
                TomChannelTrigOneShotMode = false
                TomChannelTriggerOutput = TRIG_FROM_PREVIOUS_CHANNEL
              TomChannelUsage: TomChannelUsage=USED_BY_OTHER_DRIVERS_OR_UNUSED
            TomChannel_1
              TomChannelEnable: TomChDisableOnTgcTrigger=false, TomChannelEnable=AT_START
              TomChannelInterrupt: TomIntEnableOnDutyCycleMatchCcu1=false, TomIntEnableOnPeriodMatchCcu0=false, TomInterruptMode=GTM_INTERRUPT_LEVEL_MODE, TomNotification=NULL_PTR
              TomChannelOutput:
                TomChOutputDisableOnTgcTrig = false
                TomChannelOutputControl = DONT_ENABLE_CHANNEL_OUTPUT
                TomChannelOutputSignalLevel = LOW
                TomChannelPortPinSelect = TOUT103_SELA_PORT10_PIN1
              TomChannelTimerParameters:
                TomChDCycCompareShadowValSr1 = 0
                TomChEnableForceUpdate = false
                TomChPeriodCompareShadowValSr0 = 0
                TomChResetCn0OnForceUpdate = false
                TomChUpdateEnableOnCn0Reset = false
                TomChannelBitReversalMode = false
                TomChannelClockSelect = GTM_FIXED_CLOCK_0
                TomChannelCounterCn0Reset = ON_COMPARE_MATCH_ON_CHANNEL
                TomChannelCounterValCn0 = 0
                TomChannelDutyCycleCompareValCm1 = 0
                TomChannelExtCounterCn0Reset = TRIG_ON_PREV_COMPARE_MATCH
                TomChannelExtTriggerOutput = EXT_TRIG_FROM_PREVIOUS_CHANNEL
                TomChannelOneShotMode = false
                TomChannelPeriodCompareValCm0 = 0
                TomChannelTrigOneShotMode = false
                TomChannelTriggerOutput = TRIG_FROM_PREVIOUS_CHANNEL
              TomChannelUsage: TomChannelUsage=USED_BY_OTHER_DRIVERS_OR_UNUSED
            TomChannel_10
              TomChannelEnable: TomChDisableOnTgcTrigger=false, TomChannelEnable=AT_START
              TomChannelInterrupt: TomIntEnableOnDutyCycleMatchCcu1=false, TomIntEnableOnPeriodMatchCcu0=false, TomInterruptMode=GTM_INTERRUPT_LEVEL_MODE, TomNotification=NULL_PTR
              TomChannelOutput:
                TomChOutputDisableOnTgcTrig = false
                TomChannelOutputControl = DONT_ENABLE_CHANNEL_OUTPUT
                TomChannelOutputSignalLevel = LOW
                TomChannelPortPinSelect = TOUT12_SELA_PORT0_PIN3
              TomChannelTimerParameters:
                TomChDCycCompareShadowValSr1 = 0
                TomChEnableForceUpdate = false
                TomChPeriodCompareShadowValSr0 = 0
                TomChResetCn0OnForceUpdate = false
                TomChUpdateEnableOnCn0Reset = false
                TomChannelBitReversalMode = false
                TomChannelClockSelect = GTM_FIXED_CLOCK_0
                TomChannelCounterCn0Reset = ON_COMPARE_MATCH_ON_CHANNEL
                TomChannelCounterValCn0 = 0
                TomChannelDutyCycleCompareValCm1 = 0
                TomChannelExtCounterCn0Reset = TRIG_ON_PREV_COMPARE_MATCH
                TomChannelExtTriggerOutput = EXT_TRIG_FROM_PREVIOUS_CHANNEL
                TomChannelOneShotMode = false
                TomChannelPeriodCompareValCm0 = 0
                TomChannelTrigOneShotMode = false
                TomChannelTriggerOutput = TRIG_FROM_PREVIOUS_CHANNEL
              TomChannelUsage: TomChannelUsage=USED_BY_OTHER_DRIVERS_OR_UNUSED
            TomChannel_11
              TomChannelEnable: TomChDisableOnTgcTrigger=false, TomChannelEnable=AT_START
              TomChannelInterrupt: TomIntEnableOnDutyCycleMatchCcu1=false, TomIntEnableOnPeriodMatchCcu0=false, TomInterruptMode=GTM_INTERRUPT_LEVEL_MODE, TomNotification=NULL_PTR
              TomChannelOutput:
                TomChOutputDisableOnTgcTrig = false
                TomChannelOutputControl = DONT_ENABLE_CHANNEL_OUTPUT
                TomChannelOutputSignalLevel = LOW
                TomChannelPortPinSelect = TOUT13_SELA_PORT0_PIN4
              TomChannelTimerParameters:
                TomChDCycCompareShadowValSr1 = 0
                TomChEnableForceUpdate = false
                TomChPeriodCompareShadowValSr0 = 0
                TomChResetCn0OnForceUpdate = false
                TomChUpdateEnableOnCn0Reset = false
                TomChannelBitReversalMode = false
                TomChannelClockSelect = GTM_FIXED_CLOCK_0
                TomChannelCounterCn0Reset = ON_COMPARE_MATCH_ON_CHANNEL
                TomChannelCounterValCn0 = 0
                TomChannelDutyCycleCompareValCm1 = 0
                TomChannelExtCounterCn0Reset = TRIG_ON_PREV_COMPARE_MATCH
                TomChannelExtTriggerOutput = EXT_TRIG_FROM_PREVIOUS_CHANNEL
                TomChannelOneShotMode = false
                TomChannelPeriodCompareValCm0 = 0
                TomChannelTrigOneShotMode = false
                TomChannelTriggerOutput = TRIG_FROM_PREVIOUS_CHANNEL
              TomChannelUsage: TomChannelUsage=USED_BY_OTHER_DRIVERS_OR_UNUSED
            TomChannel_12
              TomChannelEnable: TomChDisableOnTgcTrigger=false, TomChannelEnable=AT_START
              TomChannelInterrupt: TomIntEnableOnDutyCycleMatchCcu1=false, TomIntEnableOnPeriodMatchCcu0=false, TomInterruptMode=GTM_INTERRUPT_LEVEL_MODE, TomNotification=NULL_PTR
              TomChannelOutput:
                TomChOutputDisableOnTgcTrig = false
                TomChannelOutputControl = DONT_ENABLE_CHANNEL_OUTPUT
                TomChannelOutputSignalLevel = LOW
                TomChannelPortPinSelect = TOUT14_SELA_PORT0_PIN5
              TomChannelTimerParameters:
                TomChDCycCompareShadowValSr1 = 0
                TomChEnableForceUpdate = false
                TomChPeriodCompareShadowValSr0 = 0
                TomChResetCn0OnForceUpdate = false
                TomChUpdateEnableOnCn0Reset = false
                TomChannelBitReversalMode = false
                TomChannelClockSelect = GTM_FIXED_CLOCK_0
                TomChannelCounterCn0Reset = ON_COMPARE_MATCH_ON_CHANNEL
                TomChannelCounterValCn0 = 0
                TomChannelDutyCycleCompareValCm1 = 0
                TomChannelExtCounterCn0Reset = TRIG_ON_PREV_COMPARE_MATCH
                TomChannelExtTriggerOutput = EXT_TRIG_FROM_PREVIOUS_CHANNEL
                TomChannelOneShotMode = false
                TomChannelPeriodCompareValCm0 = 0
                TomChannelTrigOneShotMode = false
                TomChannelTriggerOutput = TRIG_FROM_PREVIOUS_CHANNEL
              TomChannelUsage: TomChannelUsage=USED_BY_OTHER_DRIVERS_OR_UNUSED
            TomChannel_13
              TomChannelEnable: TomChDisableOnTgcTrigger=false, TomChannelEnable=AT_START
              TomChannelInterrupt: TomIntEnableOnDutyCycleMatchCcu1=false, TomIntEnableOnPeriodMatchCcu0=false, TomInterruptMode=GTM_INTERRUPT_LEVEL_MODE, TomNotification=NULL_PTR
              TomChannelOutput:
                TomChOutputDisableOnTgcTrig = false
                TomChannelOutputControl = DONT_ENABLE_CHANNEL_OUTPUT
                TomChannelOutputSignalLevel = LOW
                TomChannelPortPinSelect = TOUT15_SELA_PORT0_PIN6
              TomChannelTimerParameters:
                TomChDCycCompareShadowValSr1 = 0
                TomChEnableForceUpdate = false
                TomChPeriodCompareShadowValSr0 = 0
                TomChResetCn0OnForceUpdate = false
                TomChUpdateEnableOnCn0Reset = false
                TomChannelBitReversalMode = false
                TomChannelClockSelect = GTM_FIXED_CLOCK_0
                TomChannelCounterCn0Reset = ON_COMPARE_MATCH_ON_CHANNEL
                TomChannelCounterValCn0 = 0
                TomChannelDutyCycleCompareValCm1 = 0
                TomChannelExtCounterCn0Reset = TRIG_ON_PREV_COMPARE_MATCH
                TomChannelExtTriggerOutput = EXT_TRIG_FROM_PREVIOUS_CHANNEL
                TomChannelOneShotMode = false
                TomChannelPeriodCompareValCm0 = 0
                TomChannelTrigOneShotMode = false
                TomChannelTriggerOutput = TRIG_FROM_PREVIOUS_CHANNEL
              TomChannelUsage: TomChannelUsage=USED_BY_OTHER_DRIVERS_OR_UNUSED
            TomChannel_14
              TomChannelEnable: TomChDisableOnTgcTrigger=false, TomChannelEnable=AT_START
              TomChannelInterrupt: TomIntEnableOnDutyCycleMatchCcu1=false, TomIntEnableOnPeriodMatchCcu0=false, TomInterruptMode=GTM_INTERRUPT_LEVEL_MODE, TomNotification=NULL_PTR
              TomChannelOutput:
                TomChOutputDisableOnTgcTrig = false
                TomChannelOutputControl = DONT_ENABLE_CHANNEL_OUTPUT
                TomChannelOutputSignalLevel = LOW
                TomChannelPortPinSelect = TOUT16_SELA_PORT0_PIN7
              TomChannelTimerParameters:
                TomChDCycCompareShadowValSr1 = 0
                TomChEnableForceUpdate = false
                TomChPeriodCompareShadowValSr0 = 0
                TomChResetCn0OnForceUpdate = false
                TomChUpdateEnableOnCn0Reset = false
                TomChannelBitReversalMode = false
                TomChannelClockSelect = GTM_FIXED_CLOCK_0
                TomChannelCounterCn0Reset = ON_COMPARE_MATCH_ON_CHANNEL
                TomChannelCounterValCn0 = 0
                TomChannelDutyCycleCompareValCm1 = 0
                TomChannelExtCounterCn0Reset = TRIG_ON_PREV_COMPARE_MATCH
                TomChannelExtTriggerOutput = EXT_TRIG_FROM_PREVIOUS_CHANNEL
                TomChannelOneShotMode = false
                TomChannelPeriodCompareValCm0 = 0
                TomChannelTrigOneShotMode = false
                TomChannelTriggerOutput = TRIG_FROM_PREVIOUS_CHANNEL
              TomChannelUsage: TomChannelUsage=USED_BY_OTHER_DRIVERS_OR_UNUSED
            TomChannel_15
              TomChannelEnable: TomChDisableOnTgcTrigger=false, TomChannelEnable=AT_START
              TomChannelInterrupt: TomIntEnableOnDutyCycleMatchCcu1=false, TomIntEnableOnPeriodMatchCcu0=false, TomInterruptMode=GTM_INTERRUPT_LEVEL_MODE, TomNotification=NULL_PTR
              TomChannelOutput:
                TomChOutputDisableOnTgcTrig = false
                TomChannelOutputControl = DONT_ENABLE_CHANNEL_OUTPUT
                TomChannelOutputSignalLevel = LOW
                TomChannelPortPinSelect = TOUT17_SELA_PORT0_PIN8
              TomChannelTimerParameters:
                TomChDCycCompareShadowValSr1 = 0
                TomChEnableForceUpdate = false
                TomChPeriodCompareShadowValSr0 = 0
                TomChResetCn0OnForceUpdate = false
                TomChUpdateEnableOnCn0Reset = false
                TomChannelBitReversalMode = false
                TomChannelClockSelect = GTM_FIXED_CLOCK_0
                TomChannelCounterCn0Reset = ON_COMPARE_MATCH_ON_CHANNEL
                TomChannelCounterValCn0 = 0
                TomChannelDutyCycleCompareValCm1 = 0
                TomChannelExtCounterCn0Reset = TRIG_ON_PREV_COMPARE_MATCH
                TomChannelExtTriggerOutput = EXT_TRIG_FROM_PREVIOUS_CHANNEL
                TomChannelOneShotMode = false
                TomChannelPeriodCompareValCm0 = 0
                TomChannelTrigOneShotMode = false
                TomChannelTriggerOutput = TRIG_FROM_PREVIOUS_CHANNEL
              TomChannelUsage: TomChannelUsage=USED_BY_OTHER_DRIVERS_OR_UNUSED
            TomChannel_2
              TomChannelEnable: TomChDisableOnTgcTrigger=false, TomChannelEnable=AT_START
              TomChannelInterrupt: TomIntEnableOnDutyCycleMatchCcu1=false, TomIntEnableOnPeriodMatchCcu0=false, TomInterruptMode=GTM_INTERRUPT_LEVEL_MODE, TomNotification=NULL_PTR
              TomChannelOutput:
                TomChOutputDisableOnTgcTrig = false
                TomChannelOutputControl = DONT_ENABLE_CHANNEL_OUTPUT
                TomChannelOutputSignalLevel = LOW
                TomChannelPortPinSelect = TOUT104_SELA_PORT10_PIN2
              TomChannelTimerParameters:
                TomChDCycCompareShadowValSr1 = 0
                TomChEnableForceUpdate = false
                TomChPeriodCompareShadowValSr0 = 0
                TomChResetCn0OnForceUpdate = false
                TomChUpdateEnableOnCn0Reset = false
                TomChannelBitReversalMode = false
                TomChannelClockSelect = GTM_FIXED_CLOCK_0
                TomChannelCounterCn0Reset = ON_COMPARE_MATCH_ON_CHANNEL
                TomChannelCounterValCn0 = 0
                TomChannelDutyCycleCompareValCm1 = 0
                TomChannelExtCounterCn0Reset = TRIG_ON_PREV_COMPARE_MATCH
                TomChannelExtTriggerOutput = EXT_TRIG_FROM_PREVIOUS_CHANNEL
                TomChannelOneShotMode = false
                TomChannelPeriodCompareValCm0 = 0
                TomChannelTrigOneShotMode = false
                TomChannelTriggerOutput = TRIG_FROM_PREVIOUS_CHANNEL
              TomChannelUsage: TomChannelUsage=USED_BY_OTHER_DRIVERS_OR_UNUSED
            TomChannel_3
              TomChannelEnable: TomChDisableOnTgcTrigger=false, TomChannelEnable=AT_START
              TomChannelInterrupt: TomIntEnableOnDutyCycleMatchCcu1=false, TomIntEnableOnPeriodMatchCcu0=false, TomInterruptMode=GTM_INTERRUPT_LEVEL_MODE, TomNotification=NULL_PTR
              TomChannelOutput:
                TomChOutputDisableOnTgcTrig = false
                TomChannelOutputControl = DONT_ENABLE_CHANNEL_OUTPUT
                TomChannelOutputSignalLevel = LOW
                TomChannelPortPinSelect = TOUT21_SELA_PORT0_PIN12
              TomChannelTimerParameters:
                TomChDCycCompareShadowValSr1 = 0
                TomChEnableForceUpdate = false
                TomChPeriodCompareShadowValSr0 = 0
                TomChResetCn0OnForceUpdate = false
                TomChUpdateEnableOnCn0Reset = false
                TomChannelBitReversalMode = false
                TomChannelClockSelect = GTM_FIXED_CLOCK_0
                TomChannelCounterCn0Reset = ON_COMPARE_MATCH_ON_CHANNEL
                TomChannelCounterValCn0 = 0
                TomChannelDutyCycleCompareValCm1 = 0
                TomChannelExtCounterCn0Reset = TRIG_ON_PREV_COMPARE_MATCH
                TomChannelExtTriggerOutput = EXT_TRIG_FROM_PREVIOUS_CHANNEL
                TomChannelOneShotMode = false
                TomChannelPeriodCompareValCm0 = 0
                TomChannelTrigOneShotMode = false
                TomChannelTriggerOutput = TRIG_FROM_PREVIOUS_CHANNEL
              TomChannelUsage: TomChannelUsage=USED_BY_OTHER_DRIVERS_OR_UNUSED
            TomChannel_4
              TomChannelEnable: TomChDisableOnTgcTrigger=false, TomChannelEnable=AT_START
              TomChannelInterrupt: TomIntEnableOnDutyCycleMatchCcu1=false, TomIntEnableOnPeriodMatchCcu0=false, TomInterruptMode=GTM_INTERRUPT_LEVEL_MODE, TomNotification=NULL_PTR
              TomChannelOutput:
                TomChOutputDisableOnTgcTrig = false
                TomChannelOutputControl = DONT_ENABLE_CHANNEL_OUTPUT
                TomChannelOutputSignalLevel = LOW
                TomChannelPortPinSelect = TOUT81_SELA_PORT14_PIN1
              TomChannelTimerParameters:
                TomChDCycCompareShadowValSr1 = 0
                TomChEnableForceUpdate = false
                TomChPeriodCompareShadowValSr0 = 0
                TomChResetCn0OnForceUpdate = false
                TomChUpdateEnableOnCn0Reset = false
                TomChannelBitReversalMode = false
                TomChannelClockSelect = GTM_FIXED_CLOCK_0
                TomChannelCounterCn0Reset = ON_COMPARE_MATCH_ON_CHANNEL
                TomChannelCounterValCn0 = 0
                TomChannelDutyCycleCompareValCm1 = 0
                TomChannelExtCounterCn0Reset = TRIG_ON_PREV_COMPARE_MATCH
                TomChannelExtTriggerOutput = EXT_TRIG_FROM_PREVIOUS_CHANNEL
                TomChannelOneShotMode = false
                TomChannelPeriodCompareValCm0 = 0
                TomChannelTrigOneShotMode = false
                TomChannelTriggerOutput = TRIG_FROM_PREVIOUS_CHANNEL
              TomChannelUsage: TomChannelUsage=USED_BY_OTHER_DRIVERS_OR_UNUSED
            TomChannel_5
              TomChannelEnable: TomChDisableOnTgcTrigger=false, TomChannelEnable=AT_START
              TomChannelInterrupt: TomIntEnableOnDutyCycleMatchCcu1=false, TomIntEnableOnPeriodMatchCcu0=false, TomInterruptMode=GTM_INTERRUPT_LEVEL_MODE, TomNotification=NULL_PTR
              TomChannelOutput:
                TomChOutputDisableOnTgcTrig = false
                TomChannelOutputControl = DONT_ENABLE_CHANNEL_OUTPUT
                TomChannelOutputSignalLevel = LOW
                TomChannelPortPinSelect = TOUT91_SELA_PORT13_PIN0
              TomChannelTimerParameters:
                TomChDCycCompareShadowValSr1 = 0
                TomChEnableForceUpdate = false
                TomChPeriodCompareShadowValSr0 = 0
                TomChResetCn0OnForceUpdate = false
                TomChUpdateEnableOnCn0Reset = false
                TomChannelBitReversalMode = false
                TomChannelClockSelect = GTM_FIXED_CLOCK_0
                TomChannelCounterCn0Reset = ON_COMPARE_MATCH_ON_CHANNEL
                TomChannelCounterValCn0 = 0
                TomChannelDutyCycleCompareValCm1 = 0
                TomChannelExtCounterCn0Reset = TRIG_ON_PREV_COMPARE_MATCH
                TomChannelExtTriggerOutput = EXT_TRIG_FROM_PREVIOUS_CHANNEL
                TomChannelOneShotMode = false
                TomChannelPeriodCompareValCm0 = 0
                TomChannelTrigOneShotMode = false
                TomChannelTriggerOutput = TRIG_FROM_PREVIOUS_CHANNEL
              TomChannelUsage: TomChannelUsage=USED_BY_OTHER_DRIVERS_OR_UNUSED
            TomChannel_6
              TomChannelEnable: TomChDisableOnTgcTrigger=false, TomChannelEnable=AT_START
              TomChannelInterrupt: TomIntEnableOnDutyCycleMatchCcu1=false, TomIntEnableOnPeriodMatchCcu0=false, TomInterruptMode=GTM_INTERRUPT_LEVEL_MODE, TomNotification=NULL_PTR
              TomChannelOutput:
                TomChOutputDisableOnTgcTrig = false
                TomChannelOutputControl = DONT_ENABLE_CHANNEL_OUTPUT
                TomChannelOutputSignalLevel = LOW
                TomChannelPortPinSelect = TOUT92_SELA_PORT13_PIN1
              TomChannelTimerParameters:
                TomChDCycCompareShadowValSr1 = 0
                TomChEnableForceUpdate = false
                TomChPeriodCompareShadowValSr0 = 0
                TomChResetCn0OnForceUpdate = false
                TomChUpdateEnableOnCn0Reset = false
                TomChannelBitReversalMode = false
                TomChannelClockSelect = GTM_FIXED_CLOCK_0
                TomChannelCounterCn0Reset = ON_COMPARE_MATCH_ON_CHANNEL
                TomChannelCounterValCn0 = 0
                TomChannelDutyCycleCompareValCm1 = 0
                TomChannelExtCounterCn0Reset = TRIG_ON_PREV_COMPARE_MATCH
                TomChannelExtTriggerOutput = EXT_TRIG_FROM_PREVIOUS_CHANNEL
                TomChannelOneShotMode = false
                TomChannelPeriodCompareValCm0 = 0
                TomChannelTrigOneShotMode = false
                TomChannelTriggerOutput = TRIG_FROM_PREVIOUS_CHANNEL
              TomChannelUsage: TomChannelUsage=USED_BY_OTHER_DRIVERS_OR_UNUSED
            TomChannel_7
              TomChannelEnable: TomChDisableOnTgcTrigger=false, TomChannelEnable=AT_START
              TomChannelInterrupt: TomIntEnableOnDutyCycleMatchCcu1=false, TomIntEnableOnPeriodMatchCcu0=false, TomInterruptMode=GTM_INTERRUPT_LEVEL_MODE, TomNotification=NULL_PTR
              TomChannelOutput:
                TomChOutputDisableOnTgcTrig = false
                TomChannelOutputControl = DONT_ENABLE_CHANNEL_OUTPUT
                TomChannelOutputSignalLevel = LOW
                TomChannelPortPinSelect = TOUT93_SELA_PORT13_PIN2
              TomChannelTimerParameters:
                TomChDCycCompareShadowValSr1 = 0
                TomChEnableForceUpdate = false
                TomChPeriodCompareShadowValSr0 = 0
                TomChResetCn0OnForceUpdate = false
                TomChUpdateEnableOnCn0Reset = false
                TomChannelBitReversalMode = false
                TomChannelClockSelect = GTM_FIXED_CLOCK_0
                TomChannelCounterCn0Reset = ON_COMPARE_MATCH_ON_CHANNEL
                TomChannelCounterValCn0 = 0
                TomChannelDutyCycleCompareValCm1 = 0
                TomChannelExtCounterCn0Reset = TRIG_ON_PREV_COMPARE_MATCH
                TomChannelExtTriggerOutput = EXT_TRIG_FROM_PREVIOUS_CHANNEL
                TomChannelOneShotMode = false
                TomChannelPeriodCompareValCm0 = 0
                TomChannelTrigOneShotMode = false
                TomChannelTriggerOutput = TRIG_FROM_PREVIOUS_CHANNEL
              TomChannelUsage: TomChannelUsage=USED_BY_OTHER_DRIVERS_OR_UNUSED
            TomChannel_8
              TomChannelEnable: TomChDisableOnTgcTrigger=false, TomChannelEnable=AT_START
              TomChannelInterrupt: TomIntEnableOnDutyCycleMatchCcu1=false, TomIntEnableOnPeriodMatchCcu0=false, TomInterruptMode=GTM_INTERRUPT_LEVEL_MODE, TomNotification=NULL_PTR
              TomChannelOutput:
                TomChOutputDisableOnTgcTrig = false
                TomChannelOutputControl = DONT_ENABLE_CHANNEL_OUTPUT
                TomChannelOutputSignalLevel = LOW
                TomChannelPortPinSelect = TOUT9_SELA_PORT0_PIN0
              TomChannelTimerParameters:
                TomChDCycCompareShadowValSr1 = 0
                TomChEnableForceUpdate = false
                TomChPeriodCompareShadowValSr0 = 0
                TomChResetCn0OnForceUpdate = false
                TomChUpdateEnableOnCn0Reset = false
                TomChannelBitReversalMode = false
                TomChannelClockSelect = GTM_FIXED_CLOCK_0
                TomChannelCounterCn0Reset = ON_COMPARE_MATCH_ON_CHANNEL
                TomChannelCounterValCn0 = 0
                TomChannelDutyCycleCompareValCm1 = 0
                TomChannelExtCounterCn0Reset = TRIG_ON_PREV_COMPARE_MATCH
                TomChannelExtTriggerOutput = EXT_TRIG_FROM_PREVIOUS_CHANNEL
                TomChannelOneShotMode = false
                TomChannelPeriodCompareValCm0 = 0
                TomChannelTrigOneShotMode = false
                TomChannelTriggerOutput = TRIG_FROM_PREVIOUS_CHANNEL
              TomChannelUsage: TomChannelUsage=USED_BY_OTHER_DRIVERS_OR_UNUSED
            TomChannel_9
              TomChannelEnable: TomChDisableOnTgcTrigger=false, TomChannelEnable=AT_START
              TomChannelInterrupt: TomIntEnableOnDutyCycleMatchCcu1=false, TomIntEnableOnPeriodMatchCcu0=false, TomInterruptMode=GTM_INTERRUPT_LEVEL_MODE, TomNotification=NULL_PTR
              TomChannelOutput:
                TomChOutputDisableOnTgcTrig = false
                TomChannelOutputControl = DONT_ENABLE_CHANNEL_OUTPUT
                TomChannelOutputSignalLevel = LOW
                TomChannelPortPinSelect = TOUT10_SELA_PORT0_PIN1
              TomChannelTimerParameters:
                TomChDCycCompareShadowValSr1 = 0
                TomChEnableForceUpdate = false
                TomChPeriodCompareShadowValSr0 = 0
                TomChResetCn0OnForceUpdate = false
                TomChUpdateEnableOnCn0Reset = false
                TomChannelBitReversalMode = false
                TomChannelClockSelect = GTM_FIXED_CLOCK_0
                TomChannelCounterCn0Reset = ON_COMPARE_MATCH_ON_CHANNEL
                TomChannelCounterValCn0 = 0
                TomChannelDutyCycleCompareValCm1 = 0
                TomChannelExtCounterCn0Reset = TRIG_ON_PREV_COMPARE_MATCH
                TomChannelExtTriggerOutput = EXT_TRIG_FROM_PREVIOUS_CHANNEL
                TomChannelOneShotMode = false
                TomChannelPeriodCompareValCm0 = 0
                TomChannelTrigOneShotMode = false
                TomChannelTriggerOutput = TRIG_FROM_PREVIOUS_CHANNEL
              TomChannelUsage: TomChannelUsage=USED_BY_OTHER_DRIVERS_OR_UNUSED
          TomTriggersForTgc_0 (TomTriggersForTgc)
            TomTgcInternalTriggerSelect:
              TomTgcIntTriggerFromChannel{0..7} = false
            TomTgcTriggerByTimebase: TomTgcTbuTimebaseSelect=TBU_TS0_TIMEBASE, TomTgcTimeBaseTriggerEnable=false, TomTgcTimebaseMatchValue=0
          TomTriggersForTgc_1 (TomTriggersForTgc)
            TomTgcInternalTriggerSelect:
              TomTgcIntTriggerFromChannel{0..7} = false
            TomTgcTriggerByTimebase: TomTgcTbuTimebaseSelect=TBU_TS0_TIMEBASE, TomTgcTimeBaseTriggerEnable=false, TomTgcTimebaseMatchValue=0
        Tom_1 (Tom)
          16 x TomChannel:
            TomChannel_0
              TomChannelEnable: TomChDisableOnTgcTrigger=false, TomChannelEnable=AT_START
              TomChannelInterrupt: TomIntEnableOnDutyCycleMatchCcu1=false, TomIntEnableOnPeriodMatchCcu0=false, TomInterruptMode=GTM_INTERRUPT_LEVEL_MODE, TomNotification=NULL_PTR
              TomChannelOutput:
                TomChOutputDisableOnTgcTrig = false
                TomChannelOutputControl = DONT_ENABLE_CHANNEL_OUTPUT
                TomChannelOutputSignalLevel = LOW
                TomChannelPortPinSelect = TOUT9_SELB_PORT0_PIN0
              TomChannelTimerParameters:
                TomChDCycCompareShadowValSr1 = 0
                TomChEnableForceUpdate = false
                TomChPeriodCompareShadowValSr0 = 0
                TomChResetCn0OnForceUpdate = false
                TomChUpdateEnableOnCn0Reset = false
                TomChannelBitReversalMode = false
                TomChannelClockSelect = GTM_FIXED_CLOCK_0
                TomChannelCounterCn0Reset = ON_COMPARE_MATCH_ON_CHANNEL
                TomChannelCounterValCn0 = 0
                TomChannelDutyCycleCompareValCm1 = 0
                TomChannelExtCounterCn0Reset = TRIG_ON_PREV_COMPARE_MATCH
                TomChannelExtTriggerOutput = EXT_TRIG_FROM_PREVIOUS_CHANNEL
                TomChannelOneShotMode = false
                TomChannelPeriodCompareValCm0 = 0
                TomChannelTrigOneShotMode = false
                TomChannelTriggerOutput = TRIG_FROM_PREVIOUS_CHANNEL
              TomChannelUsage: TomChannelUsage=USED_BY_OTHER_DRIVERS_OR_UNUSED
            TomChannel_1
              TomChannelEnable: TomChDisableOnTgcTrigger=false, TomChannelEnable=AT_START
              TomChannelInterrupt: TomIntEnableOnDutyCycleMatchCcu1=false, TomIntEnableOnPeriodMatchCcu0=false, TomInterruptMode=GTM_INTERRUPT_LEVEL_MODE, TomNotification=NULL_PTR
              TomChannelOutput:
                TomChOutputDisableOnTgcTrig = false
                TomChannelOutputControl = DONT_ENABLE_CHANNEL_OUTPUT
                TomChannelOutputSignalLevel = LOW
                TomChannelPortPinSelect = TOUT10_SELB_PORT0_PIN1
              TomChannelTimerParameters:
                TomChDCycCompareShadowValSr1 = 0
                TomChEnableForceUpdate = false
                TomChPeriodCompareShadowValSr0 = 0
                TomChResetCn0OnForceUpdate = false
                TomChUpdateEnableOnCn0Reset = false
                TomChannelBitReversalMode = false
                TomChannelClockSelect = GTM_FIXED_CLOCK_0
                TomChannelCounterCn0Reset = ON_COMPARE_MATCH_ON_CHANNEL
                TomChannelCounterValCn0 = 0
                TomChannelDutyCycleCompareValCm1 = 0
                TomChannelExtCounterCn0Reset = TRIG_ON_PREV_COMPARE_MATCH
                TomChannelExtTriggerOutput = EXT_TRIG_FROM_PREVIOUS_CHANNEL
                TomChannelOneShotMode = false
                TomChannelPeriodCompareValCm0 = 0
                TomChannelTrigOneShotMode = false
                TomChannelTriggerOutput = TRIG_FROM_PREVIOUS_CHANNEL
              TomChannelUsage: TomChannelUsage=USED_BY_OTHER_DRIVERS_OR_UNUSED
            TomChannel_10
              TomChannelEnable: TomChDisableOnTgcTrigger=false, TomChannelEnable=AT_START
              TomChannelInterrupt: TomIntEnableOnDutyCycleMatchCcu1=false, TomIntEnableOnPeriodMatchCcu0=false, TomInterruptMode=GTM_INTERRUPT_LEVEL_MODE, TomNotification=NULL_PTR
              TomChannelOutput:
                TomChOutputDisableOnTgcTrig = false
                TomChannelOutputControl = DONT_ENABLE_CHANNEL_OUTPUT
                TomChannelOutputSignalLevel = LOW
                TomChannelPortPinSelect = TOUT2_SELB_PORT2_PIN2
              TomChannelTimerParameters:
                TomChDCycCompareShadowValSr1 = 0
                TomChEnableForceUpdate = false
                TomChPeriodCompareShadowValSr0 = 0
                TomChResetCn0OnForceUpdate = false
                TomChUpdateEnableOnCn0Reset = false
                TomChannelBitReversalMode = false
                TomChannelClockSelect = GTM_FIXED_CLOCK_0
                TomChannelCounterCn0Reset = ON_COMPARE_MATCH_ON_CHANNEL
                TomChannelCounterValCn0 = 0
                TomChannelDutyCycleCompareValCm1 = 0
                TomChannelExtCounterCn0Reset = TRIG_ON_PREV_COMPARE_MATCH
                TomChannelExtTriggerOutput = EXT_TRIG_FROM_PREVIOUS_CHANNEL
                TomChannelOneShotMode = false
                TomChannelPeriodCompareValCm0 = 0
                TomChannelTrigOneShotMode = false
                TomChannelTriggerOutput = TRIG_FROM_PREVIOUS_CHANNEL
              TomChannelUsage: TomChannelUsage=USED_BY_OTHER_DRIVERS_OR_UNUSED
            TomChannel_11
              TomChannelEnable: TomChDisableOnTgcTrigger=false, TomChannelEnable=AT_START
              TomChannelInterrupt: TomIntEnableOnDutyCycleMatchCcu1=false, TomIntEnableOnPeriodMatchCcu0=false, TomInterruptMode=GTM_INTERRUPT_LEVEL_MODE, TomNotification=NULL_PTR
              TomChannelOutput:
                TomChOutputDisableOnTgcTrig = false
                TomChannelOutputControl = DONT_ENABLE_CHANNEL_OUTPUT
                TomChannelOutputSignalLevel = LOW
                TomChannelPortPinSelect = TOUT3_SELB_PORT2_PIN3
              TomChannelTimerParameters:
                TomChDCycCompareShadowValSr1 = 0
                TomChEnableForceUpdate = false
                TomChPeriodCompareShadowValSr0 = 0
                TomChResetCn0OnForceUpdate = false
                TomChUpdateEnableOnCn0Reset = false
                TomChannelBitReversalMode = false
                TomChannelClockSelect = GTM_FIXED_CLOCK_0
                TomChannelCounterCn0Reset = ON_COMPARE_MATCH_ON_CHANNEL
                TomChannelCounterValCn0 = 0
                TomChannelDutyCycleCompareValCm1 = 0
                TomChannelExtCounterCn0Reset = TRIG_ON_PREV_COMPARE_MATCH
                TomChannelExtTriggerOutput = EXT_TRIG_FROM_PREVIOUS_CHANNEL
                TomChannelOneShotMode = false
                TomChannelPeriodCompareValCm0 = 0
                TomChannelTrigOneShotMode = false
                TomChannelTriggerOutput = TRIG_FROM_PREVIOUS_CHANNEL
              TomChannelUsage: TomChannelUsage=USED_BY_OTHER_DRIVERS_OR_UNUSED
            TomChannel_12
              TomChannelEnable: TomChDisableOnTgcTrigger=false, TomChannelEnable=AT_START
              TomChannelInterrupt: TomIntEnableOnDutyCycleMatchCcu1=false, TomIntEnableOnPeriodMatchCcu0=false, TomInterruptMode=GTM_INTERRUPT_LEVEL_MODE, TomNotification=NULL_PTR
              TomChannelOutput:
                TomChOutputDisableOnTgcTrig = false
                TomChannelOutputControl = DONT_ENABLE_CHANNEL_OUTPUT
                TomChannelOutputSignalLevel = LOW
                TomChannelPortPinSelect = TOUT4_SELB_PORT2_PIN4
              TomChannelTimerParameters:
                TomChDCycCompareShadowValSr1 = 0
                TomChEnableForceUpdate = false
                TomChPeriodCompareShadowValSr0 = 0
                TomChResetCn0OnForceUpdate = false
                TomChUpdateEnableOnCn0Reset = false
                TomChannelBitReversalMode = false
                TomChannelClockSelect = GTM_FIXED_CLOCK_0
                TomChannelCounterCn0Reset = ON_COMPARE_MATCH_ON_CHANNEL
                TomChannelCounterValCn0 = 0
                TomChannelDutyCycleCompareValCm1 = 0
                TomChannelExtCounterCn0Reset = TRIG_ON_PREV_COMPARE_MATCH
                TomChannelExtTriggerOutput = EXT_TRIG_FROM_PREVIOUS_CHANNEL
                TomChannelOneShotMode = false
                TomChannelPeriodCompareValCm0 = 0
                TomChannelTrigOneShotMode = false
                TomChannelTriggerOutput = TRIG_FROM_PREVIOUS_CHANNEL
              TomChannelUsage: TomChannelUsage=USED_BY_OTHER_DRIVERS_OR_UNUSED
            TomChannel_13
              TomChannelEnable: TomChDisableOnTgcTrigger=false, TomChannelEnable=AT_START
              TomChannelInterrupt: TomIntEnableOnDutyCycleMatchCcu1=false, TomIntEnableOnPeriodMatchCcu0=false, TomInterruptMode=GTM_INTERRUPT_LEVEL_MODE, TomNotification=NULL_PTR
              TomChannelOutput:
                TomChOutputDisableOnTgcTrig = false
                TomChannelOutputControl = DONT_ENABLE_CHANNEL_OUTPUT
                TomChannelOutputSignalLevel = LOW
                TomChannelPortPinSelect = TOUT5_SELB_PORT2_PIN5
              TomChannelTimerParameters:
                TomChDCycCompareShadowValSr1 = 0
                TomChEnableForceUpdate = false
                TomChPeriodCompareShadowValSr0 = 0
                TomChResetCn0OnForceUpdate = false
                TomChUpdateEnableOnCn0Reset = false
                TomChannelBitReversalMode = false
                TomChannelClockSelect = GTM_FIXED_CLOCK_0
                TomChannelCounterCn0Reset = ON_COMPARE_MATCH_ON_CHANNEL
                TomChannelCounterValCn0 = 0
                TomChannelDutyCycleCompareValCm1 = 0
                TomChannelExtCounterCn0Reset = TRIG_ON_PREV_COMPARE_MATCH
                TomChannelExtTriggerOutput = EXT_TRIG_FROM_PREVIOUS_CHANNEL
                TomChannelOneShotMode = false
                TomChannelPeriodCompareValCm0 = 0
                TomChannelTrigOneShotMode = false
                TomChannelTriggerOutput = TRIG_FROM_PREVIOUS_CHANNEL
              TomChannelUsage: TomChannelUsage=USED_BY_OTHER_DRIVERS_OR_UNUSED
            TomChannel_14
              TomChannelEnable: TomChDisableOnTgcTrigger=false, TomChannelEnable=AT_START
              TomChannelInterrupt: TomIntEnableOnDutyCycleMatchCcu1=false, TomIntEnableOnPeriodMatchCcu0=false, TomInterruptMode=GTM_INTERRUPT_LEVEL_MODE, TomNotification=NULL_PTR
              TomChannelOutput:
                TomChOutputDisableOnTgcTrig = false
                TomChannelOutputControl = DONT_ENABLE_CHANNEL_OUTPUT
                TomChannelOutputSignalLevel = LOW
                TomChannelPortPinSelect = TOUT6_SELB_PORT2_PIN6
              TomChannelTimerParameters:
                TomChDCycCompareShadowValSr1 = 0
                TomChEnableForceUpdate = false
                TomChPeriodCompareShadowValSr0 = 0
                TomChResetCn0OnForceUpdate = false
                TomChUpdateEnableOnCn0Reset = false
                TomChannelBitReversalMode = false
                TomChannelClockSelect = GTM_FIXED_CLOCK_0
                TomChannelCounterCn0Reset = ON_COMPARE_MATCH_ON_CHANNEL
                TomChannelCounterValCn0 = 0
                TomChannelDutyCycleCompareValCm1 = 0
                TomChannelExtCounterCn0Reset = TRIG_ON_PREV_COMPARE_MATCH
                TomChannelExtTriggerOutput = EXT_TRIG_FROM_PREVIOUS_CHANNEL
                TomChannelOneShotMode = false
                TomChannelPeriodCompareValCm0 = 0
                TomChannelTrigOneShotMode = false
                TomChannelTriggerOutput = TRIG_FROM_PREVIOUS_CHANNEL
              TomChannelUsage: TomChannelUsage=USED_BY_OTHER_DRIVERS_OR_UNUSED
            TomChannel_15
              TomChannelEnable: TomChDisableOnTgcTrigger=false, TomChannelEnable=AT_START
              TomChannelInterrupt: TomIntEnableOnDutyCycleMatchCcu1=false, TomIntEnableOnPeriodMatchCcu0=false, TomInterruptMode=GTM_INTERRUPT_LEVEL_MODE, TomNotification=NULL_PTR
              TomChannelOutput:
                TomChOutputDisableOnTgcTrig = false
                TomChannelOutputControl = DONT_ENABLE_CHANNEL_OUTPUT
                TomChannelOutputSignalLevel = LOW
                TomChannelPortPinSelect = TOUT7_SELB_PORT2_PIN7
              TomChannelTimerParameters:
                TomChDCycCompareShadowValSr1 = 0
                TomChEnableForceUpdate = false
                TomChPeriodCompareShadowValSr0 = 0
                TomChResetCn0OnForceUpdate = false
                TomChUpdateEnableOnCn0Reset = false
                TomChannelBitReversalMode = false
                TomChannelClockSelect = GTM_FIXED_CLOCK_0
                TomChannelCounterCn0Reset = ON_COMPARE_MATCH_ON_CHANNEL
                TomChannelCounterValCn0 = 0
                TomChannelDutyCycleCompareValCm1 = 0
                TomChannelExtCounterCn0Reset = TRIG_ON_PREV_COMPARE_MATCH
                TomChannelExtTriggerOutput = EXT_TRIG_FROM_PREVIOUS_CHANNEL
                TomChannelOneShotMode = false
                TomChannelPeriodCompareValCm0 = 0
                TomChannelTrigOneShotMode = false
                TomChannelTriggerOutput = TRIG_FROM_PREVIOUS_CHANNEL
              TomChannelUsage: TomChannelUsage=USED_BY_OTHER_DRIVERS_OR_UNUSED
            TomChannel_2
              TomChannelEnable: TomChDisableOnTgcTrigger=false, TomChannelEnable=AT_START
              TomChannelInterrupt: TomIntEnableOnDutyCycleMatchCcu1=false, TomIntEnableOnPeriodMatchCcu0=false, TomInterruptMode=GTM_INTERRUPT_LEVEL_MODE, TomNotification=NULL_PTR
              TomChannelOutput:
                TomChOutputDisableOnTgcTrig = false
                TomChannelOutputControl = DONT_ENABLE_CHANNEL_OUTPUT
                TomChannelOutputSignalLevel = LOW
                TomChannelPortPinSelect = TOUT12_SELB_PORT0_PIN3
              TomChannelTimerParameters:
                TomChDCycCompareShadowValSr1 = 0
                TomChEnableForceUpdate = false
                TomChPeriodCompareShadowValSr0 = 0
                TomChResetCn0OnForceUpdate = false
                TomChUpdateEnableOnCn0Reset = false
                TomChannelBitReversalMode = false
                TomChannelClockSelect = GTM_FIXED_CLOCK_0
                TomChannelCounterCn0Reset = ON_COMPARE_MATCH_ON_CHANNEL
                TomChannelCounterValCn0 = 0
                TomChannelDutyCycleCompareValCm1 = 0
                TomChannelExtCounterCn0Reset = TRIG_ON_PREV_COMPARE_MATCH
                TomChannelExtTriggerOutput = EXT_TRIG_FROM_PREVIOUS_CHANNEL
                TomChannelOneShotMode = false
                TomChannelPeriodCompareValCm0 = 0
                TomChannelTrigOneShotMode = false
                TomChannelTriggerOutput = TRIG_FROM_PREVIOUS_CHANNEL
              TomChannelUsage: TomChannelUsage=USED_BY_OTHER_DRIVERS_OR_UNUSED
            TomChannel_3
              TomChannelEnable: TomChDisableOnTgcTrigger=false, TomChannelEnable=AT_START
              TomChannelInterrupt: TomIntEnableOnDutyCycleMatchCcu1=false, TomIntEnableOnPeriodMatchCcu0=false, TomInterruptMode=GTM_INTERRUPT_LEVEL_MODE, TomNotification=NULL_PTR
              TomChannelOutput:
                TomChOutputDisableOnTgcTrig = false
                TomChannelOutputControl = DONT_ENABLE_CHANNEL_OUTPUT
                TomChannelOutputSignalLevel = LOW
                TomChannelPortPinSelect = TOUT13_SELB_PORT0_PIN4
              TomChannelTimerParameters:
                TomChDCycCompareShadowValSr1 = 0
                TomChEnableForceUpdate = false
                TomChPeriodCompareShadowValSr0 = 0
                TomChResetCn0OnForceUpdate = false
                TomChUpdateEnableOnCn0Reset = false
                TomChannelBitReversalMode = false
                TomChannelClockSelect = GTM_FIXED_CLOCK_0
                TomChannelCounterCn0Reset = ON_COMPARE_MATCH_ON_CHANNEL
                TomChannelCounterValCn0 = 0
                TomChannelDutyCycleCompareValCm1 = 0
                TomChannelExtCounterCn0Reset = TRIG_ON_PREV_COMPARE_MATCH
                TomChannelExtTriggerOutput = EXT_TRIG_FROM_PREVIOUS_CHANNEL
                TomChannelOneShotMode = false
                TomChannelPeriodCompareValCm0 = 0
                TomChannelTrigOneShotMode = false
                TomChannelTriggerOutput = TRIG_FROM_PREVIOUS_CHANNEL
              TomChannelUsage: TomChannelUsage=USED_BY_OTHER_DRIVERS_OR_UNUSED
            TomChannel_4
              TomChannelEnable: TomChDisableOnTgcTrigger=false, TomChannelEnable=AT_START
              TomChannelInterrupt: TomIntEnableOnDutyCycleMatchCcu1=false, TomIntEnableOnPeriodMatchCcu0=false, TomInterruptMode=GTM_INTERRUPT_LEVEL_MODE, TomNotification=NULL_PTR
              TomChannelOutput:
                TomChOutputDisableOnTgcTrig = false
                TomChannelOutputControl = DONT_ENABLE_CHANNEL_OUTPUT
                TomChannelOutputSignalLevel = LOW
                TomChannelPortPinSelect = TOUT14_SELB_PORT0_PIN5
              TomChannelTimerParameters:
                TomChDCycCompareShadowValSr1 = 0
                TomChEnableForceUpdate = false
                TomChPeriodCompareShadowValSr0 = 0
                TomChResetCn0OnForceUpdate = false
                TomChUpdateEnableOnCn0Reset = false
                TomChannelBitReversalMode = false
                TomChannelClockSelect = GTM_FIXED_CLOCK_0
                TomChannelCounterCn0Reset = ON_COMPARE_MATCH_ON_CHANNEL
                TomChannelCounterValCn0 = 0
                TomChannelDutyCycleCompareValCm1 = 0
                TomChannelExtCounterCn0Reset = TRIG_ON_PREV_COMPARE_MATCH
                TomChannelExtTriggerOutput = EXT_TRIG_FROM_PREVIOUS_CHANNEL
                TomChannelOneShotMode = false
                TomChannelPeriodCompareValCm0 = 0
                TomChannelTrigOneShotMode = false
                TomChannelTriggerOutput = TRIG_FROM_PREVIOUS_CHANNEL
              TomChannelUsage: TomChannelUsage=USED_BY_OTHER_DRIVERS_OR_UNUSED
            TomChannel_5
              TomChannelEnable: TomChDisableOnTgcTrigger=false, TomChannelEnable=AT_START
              TomChannelInterrupt: TomIntEnableOnDutyCycleMatchCcu1=false, TomIntEnableOnPeriodMatchCcu0=false, TomInterruptMode=GTM_INTERRUPT_LEVEL_MODE, TomNotification=NULL_PTR
              TomChannelOutput:
                TomChOutputDisableOnTgcTrig = false
                TomChannelOutputControl = DONT_ENABLE_CHANNEL_OUTPUT
                TomChannelOutputSignalLevel = LOW
                TomChannelPortPinSelect = TOUT15_SELB_PORT0_PIN6
              TomChannelTimerParameters:
                TomChDCycCompareShadowValSr1 = 0
                TomChEnableForceUpdate = false
                TomChPeriodCompareShadowValSr0 = 0
                TomChResetCn0OnForceUpdate = false
                TomChUpdateEnableOnCn0Reset = false
                TomChannelBitReversalMode = false
                TomChannelClockSelect = GTM_FIXED_CLOCK_0
                TomChannelCounterCn0Reset = ON_COMPARE_MATCH_ON_CHANNEL
                TomChannelCounterValCn0 = 0
                TomChannelDutyCycleCompareValCm1 = 0
                TomChannelExtCounterCn0Reset = TRIG_ON_PREV_COMPARE_MATCH
                TomChannelExtTriggerOutput = EXT_TRIG_FROM_PREVIOUS_CHANNEL
                TomChannelOneShotMode = false
                TomChannelPeriodCompareValCm0 = 0
                TomChannelTrigOneShotMode = false
                TomChannelTriggerOutput = TRIG_FROM_PREVIOUS_CHANNEL
              TomChannelUsage: TomChannelUsage=USED_BY_OTHER_DRIVERS_OR_UNUSED
            TomChannel_6
              TomChannelEnable: TomChDisableOnTgcTrigger=false, TomChannelEnable=AT_START
              TomChannelInterrupt: TomIntEnableOnDutyCycleMatchCcu1=false, TomIntEnableOnPeriodMatchCcu0=false, TomInterruptMode=GTM_INTERRUPT_LEVEL_MODE, TomNotification=NULL_PTR
              TomChannelOutput:
                TomChOutputDisableOnTgcTrig = false
                TomChannelOutputControl = DONT_ENABLE_CHANNEL_OUTPUT
                TomChannelOutputSignalLevel = LOW
                TomChannelPortPinSelect = TOUT16_SELB_PORT0_PIN7
              TomChannelTimerParameters:
                TomChDCycCompareShadowValSr1 = 0
                TomChEnableForceUpdate = false
                TomChPeriodCompareShadowValSr0 = 0
                TomChResetCn0OnForceUpdate = false
                TomChUpdateEnableOnCn0Reset = false
                TomChannelBitReversalMode = false
                TomChannelClockSelect = GTM_FIXED_CLOCK_0
                TomChannelCounterCn0Reset = ON_COMPARE_MATCH_ON_CHANNEL
                TomChannelCounterValCn0 = 0
                TomChannelDutyCycleCompareValCm1 = 0
                TomChannelExtCounterCn0Reset = TRIG_ON_PREV_COMPARE_MATCH
                TomChannelExtTriggerOutput = EXT_TRIG_FROM_PREVIOUS_CHANNEL
                TomChannelOneShotMode = false
                TomChannelPeriodCompareValCm0 = 0
                TomChannelTrigOneShotMode = false
                TomChannelTriggerOutput = TRIG_FROM_PREVIOUS_CHANNEL
              TomChannelUsage: TomChannelUsage=USED_BY_OTHER_DRIVERS_OR_UNUSED
            TomChannel_7
              TomChannelEnable: TomChDisableOnTgcTrigger=false, TomChannelEnable=AT_START
              TomChannelInterrupt: TomIntEnableOnDutyCycleMatchCcu1=false, TomIntEnableOnPeriodMatchCcu0=false, TomInterruptMode=GTM_INTERRUPT_LEVEL_MODE, TomNotification=NULL_PTR
              TomChannelOutput:
                TomChOutputDisableOnTgcTrig = false
                TomChannelOutputControl = DONT_ENABLE_CHANNEL_OUTPUT
                TomChannelOutputSignalLevel = LOW
                TomChannelPortPinSelect = TOUT17_SELB_PORT0_PIN8
              TomChannelTimerParameters:
                TomChDCycCompareShadowValSr1 = 0
                TomChEnableForceUpdate = false
                TomChPeriodCompareShadowValSr0 = 0
                TomChResetCn0OnForceUpdate = false
                TomChUpdateEnableOnCn0Reset = false
                TomChannelBitReversalMode = false
                TomChannelClockSelect = GTM_FIXED_CLOCK_0
                TomChannelCounterCn0Reset = ON_COMPARE_MATCH_ON_CHANNEL
                TomChannelCounterValCn0 = 0
                TomChannelDutyCycleCompareValCm1 = 0
                TomChannelExtCounterCn0Reset = TRIG_ON_PREV_COMPARE_MATCH
                TomChannelExtTriggerOutput = EXT_TRIG_FROM_PREVIOUS_CHANNEL
                TomChannelOneShotMode = false
                TomChannelPeriodCompareValCm0 = 0
                TomChannelTrigOneShotMode = false
                TomChannelTriggerOutput = TRIG_FROM_PREVIOUS_CHANNEL
              TomChannelUsage: TomChannelUsage=USED_BY_OTHER_DRIVERS_OR_UNUSED
            TomChannel_8
              TomChannelEnable: TomChDisableOnTgcTrigger=false, TomChannelEnable=AT_START
              TomChannelInterrupt: TomIntEnableOnDutyCycleMatchCcu1=false, TomIntEnableOnPeriodMatchCcu0=false, TomInterruptMode=GTM_INTERRUPT_LEVEL_MODE, TomNotification=NULL_PTR
              TomChannelOutput:
                TomChOutputDisableOnTgcTrig = false
                TomChannelOutputControl = DONT_ENABLE_CHANNEL_OUTPUT
                TomChannelOutputSignalLevel = LOW
                TomChannelPortPinSelect = TOUT0_SELB_PORT2_PIN0
              TomChannelTimerParameters:
                TomChDCycCompareShadowValSr1 = 0
                TomChEnableForceUpdate = false
                TomChPeriodCompareShadowValSr0 = 0
                TomChResetCn0OnForceUpdate = false
                TomChUpdateEnableOnCn0Reset = false
                TomChannelBitReversalMode = false
                TomChannelClockSelect = GTM_FIXED_CLOCK_0
                TomChannelCounterCn0Reset = ON_COMPARE_MATCH_ON_CHANNEL
                TomChannelCounterValCn0 = 0
                TomChannelDutyCycleCompareValCm1 = 0
                TomChannelExtCounterCn0Reset = TRIG_ON_PREV_COMPARE_MATCH
                TomChannelExtTriggerOutput = EXT_TRIG_FROM_PREVIOUS_CHANNEL
                TomChannelOneShotMode = false
                TomChannelPeriodCompareValCm0 = 0
                TomChannelTrigOneShotMode = false
                TomChannelTriggerOutput = TRIG_FROM_PREVIOUS_CHANNEL
              TomChannelUsage: TomChannelUsage=USED_BY_OTHER_DRIVERS_OR_UNUSED
            TomChannel_9
              TomChannelEnable: TomChDisableOnTgcTrigger=false, TomChannelEnable=AT_START
              TomChannelInterrupt: TomIntEnableOnDutyCycleMatchCcu1=false, TomIntEnableOnPeriodMatchCcu0=false, TomInterruptMode=GTM_INTERRUPT_LEVEL_MODE, TomNotification=NULL_PTR
              TomChannelOutput:
                TomChOutputDisableOnTgcTrig = false
                TomChannelOutputControl = DONT_ENABLE_CHANNEL_OUTPUT
                TomChannelOutputSignalLevel = LOW
                TomChannelPortPinSelect = TOUT1_SELB_PORT2_PIN1
              TomChannelTimerParameters:
                TomChDCycCompareShadowValSr1 = 0
                TomChEnableForceUpdate = false
                TomChPeriodCompareShadowValSr0 = 0
                TomChResetCn0OnForceUpdate = false
                TomChUpdateEnableOnCn0Reset = false
                TomChannelBitReversalMode = false
                TomChannelClockSelect = GTM_FIXED_CLOCK_0
                TomChannelCounterCn0Reset = ON_COMPARE_MATCH_ON_CHANNEL
                TomChannelCounterValCn0 = 0
                TomChannelDutyCycleCompareValCm1 = 0
                TomChannelExtCounterCn0Reset = TRIG_ON_PREV_COMPARE_MATCH
                TomChannelExtTriggerOutput = EXT_TRIG_FROM_PREVIOUS_CHANNEL
                TomChannelOneShotMode = false
                TomChannelPeriodCompareValCm0 = 0
                TomChannelTrigOneShotMode = false
                TomChannelTriggerOutput = TRIG_FROM_PREVIOUS_CHANNEL
              TomChannelUsage: TomChannelUsage=USED_BY_OTHER_DRIVERS_OR_UNUSED
          TomTriggersForTgc_0 (TomTriggersForTgc)
            TomTgcInternalTriggerSelect:
              TomTgcIntTriggerFromChannel{0..7} = false
            TomTgcTriggerByTimebase: TomTgcTbuTimebaseSelect=TBU_TS0_TIMEBASE, TomTgcTimeBaseTriggerEnable=false, TomTgcTimebaseMatchValue=0
          TomTriggersForTgc_1 (TomTriggersForTgc)
            TomTgcInternalTriggerSelect:
              TomTgcIntTriggerFromChannel{0..7} = false
            TomTgcTriggerByTimebase: TomTgcTbuTimebaseSelect=TBU_TS0_TIMEBASE, TomTgcTimeBaseTriggerEnable=false, TomTgcTimebaseMatchValue=0
      McuClockSettingConfig_0 (McuClockSettingConfig): McuClockSettingId=0
        McuClockReferencePoint:
          McuASCLINFDivider = 2
          McuASCLINSDivider = 8
          McuBAUD2Divider = 2
          McuBBBDivider = 2
          McuCANDivider = 2
          McuCPU0Divider = 0
          McuClockASCLINFFrequency = 60000000
          McuClockASCLINSFrequency = 15000000
          McuClockBAUD2Frequency = 60000000
          McuClockBBBFrequency = 60000000
          McuClockCANFrequency = 60000000
          McuClockCPU0Frequency = 120000000
          McuClockErayFrequency = 80000000
          McuClockErayPll2Frequency = 80000000
          McuClockErayPllFrequency = 80000000
          McuClockFSI2Frequency = 60000000
          McuClockFSIFrequency = 60000000
          McuClockGTMFrequency = 60000000
          McuClockMAXFrequency = 120000000
          McuClockReferencePoint2Frequency = 100000000
          McuClockReferencePointFrequency = 120000000
          McuClockSPBFrequency = 60000000
          McuClockSRIFrequency = 120000000
          McuClockSTMFrequency = 60000000
          McuClockSettingMode = NORMAL_MODE
          McuErayDivider = 1
          McuErayPllK2Divider = 4
          McuErayPllK3Divider = 4
          McuErayPllNDivider = 19
          McuErayPllPDivider = 0
          McuFMPllModAmp = 1.25
          McuFSI2Divider = 2
          McuFSIDivider = 2
          McuGTMDivider = 2
          McuK2DivRampToBackUpConfDelay = 10
          McuK2DivRampToPllConfDelay = 10
          McuK2DivSteps = 2
          McuMAXDivider = 1
          McuPllK1Divider = 1
          McuPllK2Divider = 4
          McuPllK3Divider = 5
          McuPllNDivider = 29
          McuPllPDivider = 0
          McuSPBDivider = 2
          McuSRIDivider = 1
          McuSTMDivider = 2
      McuModeSettingConf_0 (McuModeSettingConf): McuIdleReqAckSeqDisable=false, McuMode=0
        McuStandbySettingConf
      McuTriggerReset: ESR0ResetTrigger=0, ESR1ResetTrigger=0, SMUResetTrigger=0, STM0ResetTrigger=0
    McuSafety: McuClockMonitoringEnable=true, McuGetModeApi=true, McuInitCheckApi=true, McuSafetyEnable=false
    CommonPublishedInformation:
      ArMajorVersion = 3
      ArMinorVersion = 2
      ArPatchVersion = 0
      ModuleId = 101
      Release = _TRICORE_TC234
      SwMajorVersion = 4
      SwMinorVersion = 6
      SwPatchVersion = 1
      VendorApiInfix = 
      VendorId = 17
package /Fee
  module config Fee: implementation-config-variant=VARIANT-PRE-COMPILE, module-description=Fee_Impl
    FeeConfigBlock (FeeBlockConfiguration): FeeBlockNumber=16, FeeBlockSize=4, FeeImmediateData=false, FeeNumberOfWriteCycles=0, FeeDeviceIndex=FlsGeneral
    FeeGeneral:
      FeeDebugSupport = false
      FeeDevErrorDetect = true
      FeeIndex = 0
      FeePollingMode = false
      FeeSetModeSupported = false
      FeeVersionInfoApi = false
      FeeVirtualPageSize = 8
      FeeNvmJobEndNotification = NvM_JobEndNotification
      FeeNvmJobErrorNotification = NvM_JobErrorNotification
    FeePublishedInformation: FeeBlockOverhead=17, FeeMaximumBlockingTime=10, FeePageOverhead=1
    FeeIfxSpecificConfig:
      FeeEraseAllEnable = false
      FeeGcRestart = FEE_GC_RESTART_INIT
      FeeGetCycleCountApi = false
      FeeGetPrevDataApi = false
      FeeIllegalStateNotification = NULL_PTR
      FeeMaxBlockCount = 13
      FeeMaxBytesPerCycle = FEE_MAX_BYTES_64
      FeeStateVarStructure = Fee_StateVar
      FeeThresholdValue = 200
      FeeUnConfigBlkOverflowHandle = FEE_CONTINUE
      FeeUnConfigBlock = FEE_UNCONFIG_BLOCK_IGNORE
      FeeUseEraseSuspend = false
      FeeVirginFlashIllegalState = false
    CommonPublishedInformation:
      ArMajorVersion = 2
      ArMinorVersion = 0
      ArPatchVersion = 0
      ModuleId = 21
      Release = _TRICORE_TC234
      SwMajorVersion = 2
      SwMinorVersion = 4
      SwPatchVersion = 0
      VendorApiInfix = 
      VendorId = 17
    12 x FeeBlockConfiguration, all with FeeImmediateData=false, FeeNumberOfWriteCycles=0, FeeDeviceIndex=FlsGeneral:
      FeeDemAdminDataBlock: FeeBlockNumber=32, FeeBlockSize=16
      FeeDemStatusDataBlock: FeeBlockNumber=176, FeeBlockSize=18
      FeeDemPrimaryDataBlock0: FeeBlockNumber=48, FeeBlockSize=22
      FeeDemPrimaryDataBlock1: FeeBlockNumber=64, FeeBlockSize=22
      FeeDemPrimaryDataBlock2: FeeBlockNumber=80, FeeBlockSize=22
      FeeDemPrimaryDataBlock3: FeeBlockNumber=96, FeeBlockSize=22
      FeeDemPrimaryDataBlock4: FeeBlockNumber=112, FeeBlockSize=22
      FeeDemPrimaryDataBlock5: FeeBlockNumber=128, FeeBlockSize=22
      FeeDemPrimaryDataBlock6: FeeBlockNumber=144, FeeBlockSize=22
      FeeDemPrimaryDataBlock7: FeeBlockNumber=160, FeeBlockSize=22
      FeeConfigBlock_cons0: FeeBlockNumber=17, FeeBlockSize=4
      FeeBlockDescriptor_StartApplication: FeeBlockNumber=192, FeeBlockSize=3
