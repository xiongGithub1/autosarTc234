AUTOSAR XML (schema 4-3-0)
package /COM/VECTOR/CFG/WORKFLOW/SYSDESC/SYNC
  system SYSTEM: category=ECU_EXTRACT
    system mapping MAPPINGS
      data-mappings:
        data-element=StartApplication.COMPOSITIONTYPE.PpRxCtrl.DeSignal_Rx16bit_Cyclic_a691adb3, system-signal=Signal_Rx16bit_Cyclic
        data-element=StartApplication.COMPOSITIONTYPE.PpRxData.DeSignal_Rx15bit_OnWrite_a1df81ad, system-signal=Signal_Rx15bit_OnWrite
        data-element=StartApplication.COMPOSITIONTYPE.PpTxCtrl.DeSignal_Tx32bit_OnWrite_b2cd4fc2, system-signal=Signal_Tx32bit_OnWrite
        data-element=StartApplication.COMPOSITIONTYPE.PpTxData.DeSignal_Tx24bit_Cyclic_85bf3e37, system-signal=Signal_Tx24bit_Cyclic
    root-software-compositions:
      root sw composition prototype COMPOSITIONTYPE: flat-map=FLATMAP, software-composition=COMPOSITIONTYPE
  composition sw component type COMPOSITIONTYPE  # UB:Derived from original system description
    12 x component:
      BswM: type=BswM
      ComM: type=ComM
      DemMaster_0: type=DemMaster_0
      DemSatellite_0: type=DemSatellite_0
      Det: type=Det
      EcuM: type=EcuM
      Dcm: type=Dcm
      NvM: type=NvM
      Os_OsCore_Core0_swc: type=Os_OsCore_Core0_swc
      WdgM: type=WdgM
      IoHwAb: type=IoHwAb
      StartApplication: type=StartApplication
    connect BswM.Switch_ESH_ModeSwitch -> BswM.Notification_ESH_ModeNotification
    connect EcuM.EcuM_ShutdownTarget -> StartApplication.EcuM_ShutdownTarget
    connect ComM.UR_USR_CHNL_3c6d4e43 -> StartApplication.UR_USR_CHNL_3c6d4e43
    connect NvM.PS_NvMBlockDescriptor_StartApplication -> StartApplication.PpNvmDataPort
    connect DemSatellite_0.Event_DEM_EVENT_StartApplication -> StartApplication.PpDiagnosticMonitor_DEM_EVENT_StartApplication
    connect DemMaster_0.OpCycle_PowerCycle -> StartApplication.PpDemOpCycle_PowerCycle
    connect StartApplication.PpDcmDataService_DID_StartApplication -> Dcm.DataServices_Data_DID_StartApplication
    connect StartApplication.PpDemDataService_DemDataElementClass_StartApplication -> DemMaster_0.CBReadData_DemDataElementClass_StartApplication
    connect StartApplication.PpNvmJobFinishedPort -> NvM.NvM_RpNotifyJobEnd_NvMBlockDescriptor_StartApplication
    connect BswM.Provide_BswMRteModeRequestPort -> BswM.Request_ESH_PostRunRequest_0
  end to end protection set E2EPROTECTIONSET
  port interface mapping set PORTINTERFACEMAPPINGSET
