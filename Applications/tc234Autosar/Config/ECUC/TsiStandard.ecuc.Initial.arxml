AUTOSAR XML (schema 4-2-1)
package /InitialEcuC
  ecuc value collection InitialEcuC: ecuc-values=[Can, CanIf, CanNm, CanSM, CanTp, Com, ComM, Dcm, Dem, EcuC, EcuM, Nm, PduR, Xcp]
  module config Can
    CanConfigSet
      CT_CAN_e98c47e6 (CanController):
        CanControllerActivation = true
        CanControllerDefaultBaudrate = CanControllerBaudrateConfig
        CanControllerSystemRef = CT_CAN
        CanWakeupSourceRef = EcuMCommonConfiguration/CAN_f26020e5
        CanControllerBaudrateConfig: CanControllerBaudRate=500
      CN_CAN_e98c47e6_Rx_Std (CanHardwareObject): CanHandleType=BASIC, CanIdType=STANDARD, CanIdValue=0, CanObjectType=RECEIVE, CanControllerRef=CanConfigSet/CT_CAN_e98c47e6
      CN_CAN_e98c47e6_Tx (CanHardwareObject): CanHandleType=BASIC, CanIdValue=0, CanObjectType=TRANSMIT, CanControllerRef=CanConfigSet/CT_CAN_e98c47e6
    CanGeneral: CanIndex=0
  module config CanIf
    Can (CanIfCtrlDrvCfg): CanIfCtrlDrvInitHohConfigRef=CanIfInitHohCfg, CanIfCtrlDrvNameRef=CanGeneral
      CT_CAN_e98c47e6 (CanIfCtrlCfg): CanIfCtrlCanCtrlRef=CanConfigSet/CT_CAN_e98c47e6
    CanIfInitCfg
      CanIfBufferCfg_346f2748 (CanIfBufferCfg): CanIfBufferSize=0, CanIfBufferHthRef=CanIfInitHohCfg/CN_CAN_e98c47e6_Tx  # CHNL
      CanIfInitHohCfg: CanIfInitRefCfgSet=CanConfigSet
        CN_CAN_e98c47e6_Rx_Std (CanIfHrhCfg): CanIfHrhCanCtrlIdRef=Can/CT_CAN_e98c47e6, CanIfHrhIdSymRef=CanConfigSet/CN_CAN_e98c47e6_Rx_Std
        CN_CAN_e98c47e6_Tx (CanIfHthCfg): CanIfHthCanCtrlIdRef=Can/CT_CAN_e98c47e6, CanIfHthIdSymRef=CanConfigSet/CN_CAN_e98c47e6_Tx
      11 x CanIfRxPduCfg, all with CanIfRxPduCanIdType=STANDARD_CAN, CanIfRxPduHrhIdRef=CanIfInitHohCfg/CN_CAN_e98c47e6_Rx_Std:
        GlobalTimeMaster_oCAN_Rx_3abd61be: CanIfRxPduCanId=896, CanIfRxPduDlc=8, CanIfRxPduRef=PT_GlobalTimeMaster_PP_GlobalTimeMaster_Rx_346f2748_fe6ecc87
        MyECU_5f8bc0cc_NMCanIDRange: CanIfRxPduDlc=8, CanIfRxPduUserRxIndicationName=CanNm_RxIndication, CanIfRxPduUserRxIndicationUL=CAN_NM, CanIfRxPduRef=MyECU_NmRxPdu_5f8bc0cc
          CHNL (CanIfRxPduCanIdRange): CanIfRxPduCanIdRangeLowerCanId=1024, CanIfRxPduCanIdRangeUpperCanId=1087
        msg_RxCycle100_0_oCAN_Rx_3abd61be: CanIfRxPduCanId=528, CanIfRxPduDlc=1, CanIfRxPduUserRxIndicationName=PduR_CanIfRxIndication, CanIfRxPduUserRxIndicationUL=PDUR, CanIfRxPduRef=PT_msg_RxCycle100_0_PP_msg_RxCycle100_0_Rx_346f2748_fe6ecc87
        msg_RxCycle500_20_oCAN_Rx_3abd61be: CanIfRxPduCanId=272, CanIfRxPduDlc=6, CanIfRxPduUserRxIndicationName=PduR_CanIfRxIndication, CanIfRxPduUserRxIndicationUL=PDUR, CanIfRxPduRef=PT_msg_RxCycle500_20_PP_msg_RxCycle500_20_Rx_346f2748_fe6ecc87
        msg_RxCycle_E2eProf1C_500_10_oCAN_Rx_3abd61be: CanIfRxPduCanId=288, CanIfRxPduDlc=8, CanIfRxPduUserRxIndicationName=PduR_CanIfRxIndication, CanIfRxPduUserRxIndicationUL=PDUR, CanIfRxPduRef=PT_msg_RxCycle_E2eProf1C_500_10_PP_msg_RxCycle_E2eProf1C_500_10_Rx_346f2748_fe6ecc87
        msg_RxEvent_20_oCAN_Rx_3abd61be: CanIfRxPduCanId=784, CanIfRxPduDlc=4, CanIfRxPduUserRxIndicationName=PduR_CanIfRxIndication, CanIfRxPduUserRxIndicationUL=PDUR, CanIfRxPduRef=PT_msg_RxEvent_20_PP_msg_RxEvent_20_Rx_346f2748_fe6ecc87
        msg_StartAppl_Rx_MyECU_oCAN_Rx_3abd61be: CanIfRxPduCanId=1281, CanIfRxPduDlc=8, CanIfRxPduUserRxIndicationName=PduR_CanIfRxIndication, CanIfRxPduUserRxIndicationUL=PDUR, CanIfRxPduRef=PT_msg_StartAppl_Rx_MyECU_PP_msg_StartAppl_Rx_MyECU_Rx_346f2748_fe6ecc87
        msg_XCP_Request_MyECU_oCAN_Rx_3abd61be: CanIfRxPduCanId=1795, CanIfRxPduDlc=8, CanIfRxPduUserRxIndicationName=Xcp_CanIfRxIndication, CanIfRxPduUserRxIndicationUL=XCP, CanIfRxPduRef=PT_msg_XCP_Request_MyECU_PP_msg_XCP_Request_MyECU_Rx_346f2748_fe6ecc87
        msg_diag_RequestGlobal_Tp_oCAN_Rx_3abd61be: CanIfRxPduCanId=1556, CanIfRxPduDlc=8, CanIfRxPduUserRxIndicationName=CanTp_RxIndication, CanIfRxPduUserRxIndicationType=PDUID_PDUINFOPTR, CanIfRxPduUserRxIndicationUL=CAN_TP, CanIfRxPduRef=PT_msg_diag_RequestGlobal_Tp_PP_msg_diag_RequestGlobal_Tp_Rx_346f2748_fe6ecc87
        msg_diag_Request_MyECU_Slave3_oCAN_Rx_3abd61be: CanIfRxPduCanId=1553, CanIfRxPduDlc=8, CanIfRxPduRef=PT_msg_diag_Request_MyECU_Slave3_PP_msg_diag_Request_MyECU_Slave3_Rx_346f2748_fe6ecc87
        msg_diag_Request_MyECU_Tp_oCAN_Rx_3abd61be: CanIfRxPduCanId=1552, CanIfRxPduDlc=8, CanIfRxPduUserRxIndicationName=CanTp_RxIndication, CanIfRxPduUserRxIndicationType=PDUID_PDUINFOPTR, CanIfRxPduUserRxIndicationUL=CAN_TP, CanIfRxPduRef=PT_msg_diag_Request_MyECU_Tp_PP_msg_diag_Request_MyECU_Tp_Rx_346f2748_fe6ecc87
      10 x CanIfTxPduCfg, all with CanIfTxPduCanIdType=STANDARD_CAN, CanIfTxPduBufferRef=CanIfBufferCfg_346f2748:
        msg_StartAppl_Tx_MyECU_oCAN_Tx_3abd61be: CanIfTxPduCanId=1280, CanIfTxPduDlc=8, CanIfTxPduUserTxConfirmationName=PduR_CanIfTxConfirmation, CanIfTxPduUserTxConfirmationUL=PDUR, CanIfTxPduRef=PT_msg_StartAppl_Tx_MyECU_PP_msg_StartAppl_Tx_MyECU_Tx_346f2748_fe6ecc87
        msg_TxCycle1000_10_oCAN_Tx_3abd61be: CanIfTxPduCanId=872, CanIfTxPduDlc=2, CanIfTxPduUserTxConfirmationName=PduR_CanIfTxConfirmation, CanIfTxPduUserTxConfirmationUL=PDUR, CanIfTxPduRef=PT_msg_TxCycle1000_10_PP_msg_TxCycle1000_10_Tx_346f2748_fe6ecc87
        msg_TxCycle10_0_oCAN_Tx_3abd61be: CanIfTxPduCanId=616, CanIfTxPduDlc=7, CanIfTxPduUserTxConfirmationName=PduR_CanIfTxConfirmation, CanIfTxPduUserTxConfirmationUL=PDUR, CanIfTxPduRef=PT_msg_TxCycle10_0_PP_msg_TxCycle10_0_Tx_346f2748_fe6ecc87
        msg_TxCycle_E2eProf1C_500_30_oCAN_Tx_3abd61be: CanIfTxPduCanId=888, CanIfTxPduDlc=8, CanIfTxPduUserTxConfirmationName=PduR_CanIfTxConfirmation, CanIfTxPduUserTxConfirmationUL=PDUR, CanIfTxPduRef=PT_msg_TxCycle_E2eProf1C_500_30_PP_msg_TxCycle_E2eProf1C_500_30_Tx_346f2748_fe6ecc87
        msg_TxEvent_10_oCAN_Tx_3abd61be: CanIfTxPduCanId=360, CanIfTxPduDlc=7, CanIfTxPduUserTxConfirmationName=PduR_CanIfTxConfirmation, CanIfTxPduUserTxConfirmationUL=PDUR, CanIfTxPduRef=PT_msg_TxEvent_10_PP_msg_TxEvent_10_Tx_346f2748_fe6ecc87
        msg_XCP_Response_MyECU_oCAN_Tx_3abd61be: CanIfTxPduCanId=1796, CanIfTxPduDlc=8, CanIfTxPduUserTxConfirmationName=Xcp_CanIfTxConfirmation, CanIfTxPduUserTxConfirmationUL=XCP, CanIfTxPduRef=PT_msg_XCP_Response_MyECU_PP_msg_XCP_Response_MyECU_Tx_346f2748_fe6ecc87
        msg_diag_Response_MyECU_Slave3_oCAN_Tx_3abd61be: CanIfTxPduCanId=1555, CanIfTxPduDlc=8, CanIfTxPduRef=PT_msg_diag_Response_MyECU_Slave3_PP_msg_diag_Response_MyECU_Slave3_Tx_346f2748_fe6ecc87
        msg_diag_Response_MyECU_Tp_oCAN_Tx_3abd61be: CanIfTxPduCanId=1554, CanIfTxPduDlc=8, CanIfTxPduUserTxConfirmationName=CanTp_TxConfirmation, CanIfTxPduUserTxConfirmationUL=CAN_TP, CanIfTxPduRef=PT_msg_diag_Response_MyECU_Tp_PP_msg_diag_Response_MyECU_Tp_Tx_346f2748_fe6ecc87
        msg_diag_Uudt_Response_MyECU_oCAN_Tx_3abd61be: CanIfTxPduCanId=1558, CanIfTxPduDlc=8, CanIfTxPduUserTxConfirmationName=PduR_CanIfTxConfirmation, CanIfTxPduUserTxConfirmationUL=PDUR, CanIfTxPduRef=PT_msg_diag_Uudt_Response_MyECU_PP_msg_diag_Uudt_Response_MyECU_Tx_346f2748_fe6ecc87
        msg_nm_MyECU_oCAN_Tx_3abd61be: CanIfTxPduCanId=1024, CanIfTxPduDlc=8, CanIfTxPduUserTxConfirmationName=CanNm_TxConfirmation, CanIfTxPduUserTxConfirmationUL=CAN_NM, CanIfTxPduRef=PT_msg_nm_MyECU_PP_msg_nm_MyECU_Tx_346f2748_fe6ecc87
    CanIfPrivateCfg: CanIfPrivateSoftwareFilterType=LINEAR
    CanIfPublicCfg: CanIfPublicPnSupport=false
  module config CanNm
    CanNmGlobalConfig: CanNmComUserDataSupport=true, CanNmPnEiraCalcEnabled=false, CanNmUserDataEnabled=true
      CAN_17d0077e (CanNmChannelConfig):
        CanNmMsgCycleTime = 0.1
        CanNmMsgReducedTime = 0.05
        CanNmNodeId = 0
        CanNmPduCbvPosition = CANNM_PDU_BYTE_0
        CanNmPduNidPosition = CANNM_PDU_BYTE_1
        CanNmRepeatMessageTime = 0.4
        CanNmTimeoutTime = 1
        CanNmUserDataLength = 6
        CanNmWaitBusSleepTime = 0.75
        CanNmComMNetworkHandleRef = ComMConfigSet/CAN_f26020e5
        CAN_17d0077e_RxPdu_5c9d081e (CanNmRxPdu): CanNmRxPduRef=MyECU_NmRxPdu_5f8bc0cc
        msg_nm_MyECU_oCAN_TxPdu_3abd61be (CanNmTxPdu): CanNmTxPduRef=PT_msg_nm_MyECU_PP_msg_nm_MyECU_Tx_346f2748_fe6ecc87
        NmUsrData_msg_nm_MyECU_oCAN_3abd61be (CanNmUserDataTxPdu): CanNmTxUserDataPduRef=EcucPduCollection/NmUsrData_msg_nm_MyECU_oCAN_3abd61be  # msg_nm_MyECU_oCAN
  module config CanSM
    CanSMConfiguration
      CHNL_3c6d4e43 (CanSMManagerNetwork): CanSMComMNetworkHandleRef=ComMConfigSet/CAN_f26020e5
        CT_CAN_e98c47e6 (CanSMController): CanSMControllerId=Can/CT_CAN_e98c47e6
  module config CanTp
    CanTpConfig: CanTpMainFunctionPeriod=0.005
      TPCH_2afe666d (CanTpChannel): CanTpChannelMode=CANTP_MODE_FULL_DUPLEX
        RxNSdu_2afe666d (CanTpRxNSdu):
          CanTpRxAddressingFormat = CANTP_STANDARD
          CanTpRxDl = 8
          CanTpRxTaType = CANTP_PHYSICAL
          CanTpRxNSduRef = EcucPduCollection/PT_msg_diag_Request_MyECU_PP_msg_diag_Request_MyECU_Rx_346f2748_fe6ecc87
          CanTpRxNPdu_389d90ae (CanTpRxNPdu): CanTpRxNPduRef=PT_msg_diag_Request_MyECU_Tp_PP_msg_diag_Request_MyECU_Tp_Rx_346f2748_fe6ecc87
          CanTpTxFcNPdu_389d90ae (CanTpTxFcNPdu): CanTpTxFcNPduRef=PT_msg_diag_Response_MyECU_Tp_PP_msg_diag_Response_MyECU_Tp_Tx_346f2748_fe6ecc87
        TxNSdu_7c5f02f8 (CanTpTxNSdu):
          CanTpTxAddressingFormat = CANTP_STANDARD
          CanTpTxDl = 8
          CanTpTxTaType = CANTP_PHYSICAL
          CanTpTxNSduRef = EcucPduCollection/PT_msg_diag_Response_MyECU_PP_msg_diag_Response_MyECU_Tx_346f2748_fe6ecc87
          CanTpRxFcNPdu_5a3ff36f (CanTpRxFcNPdu): CanTpRxFcNPduRef=PT_msg_diag_Request_MyECU_Tp_PP_msg_diag_Request_MyECU_Tp_Rx_346f2748_fe6ecc87
          CanTpTxNPdu_5a3ff36f (CanTpTxNPdu): CanTpTxNPduRef=PT_msg_diag_Response_MyECU_Tp_PP_msg_diag_Response_MyECU_Tp_Tx_346f2748_fe6ecc87
      TPCH_df418442 (CanTpChannel): CanTpChannelMode=CANTP_MODE_FULL_DUPLEX
        RxNSdu_df418442 (CanTpRxNSdu):
          CanTpRxAddressingFormat = CANTP_STANDARD
          CanTpRxDl = 8
          CanTpRxTaType = CANTP_FUNCTIONAL
          CanTpRxNSduRef = EcucPduCollection/PT_msg_diag_RequestGlobal_PP_msg_diag_RequestGlobal_Rx_346f2748_fe6ecc87
          CanTpRxNPdu_a6b5883d (CanTpRxNPdu): CanTpRxNPduRef=PT_msg_diag_RequestGlobal_Tp_PP_msg_diag_RequestGlobal_Tp_Rx_346f2748_fe6ecc87
  module config Com
    ComConfig
      11 x ComIPdu, all with ComIPduType=NORMAL:
        msg_RxCycle100_0_oCAN_3abd61be: ComIPduDirection=RECEIVE, ComIPduGroupRef=MyECU_oCAN_Rx_fcef2243, ComIPduSignalRef=Signal_RearInteriorLight_1e247d16, ComIPduSignalRef=Signal_RearLeftDoor_1e247d16, ComIPduSignalRef=Signal_RearRightDoor_1e247d16, ComPduIdRef=PT_msg_RxCycle100_0_PP_msg_RxCycle100_0_Rx_346f2748_fe6ecc87
        msg_RxCycle500_20_oCAN_3abd61be: ComIPduDirection=RECEIVE, ComIPduGroupRef=MyECU_oCAN_Rx_fcef2243, ComIPduSignalRef=Signal_Rx16bit_Cyclic_a691adb3, ComIPduSignalRef=Signal_Rx20bit_Cyclic_a691adb3, ComIPduSignalRef=Signal_Rx8bit_Cyclic_a691adb3, ComPduIdRef=PT_msg_RxCycle500_20_PP_msg_RxCycle500_20_Rx_346f2748_fe6ecc87
        msg_RxCycle_E2eProf1C_500_10_oCAN_3abd61be: ComIPduDirection=RECEIVE, ComIPduGroupRef=MyECU_oCAN_Rx_fcef2243, ComIPduSignalGroupRef=SG_RgRx_Prof1C_RxCycle_e8110737, ComPduIdRef=PT_msg_RxCycle_E2eProf1C_500_10_PP_msg_RxCycle_E2eProf1C_500_10_Rx_346f2748_fe6ecc87
        msg_RxEvent_20_oCAN_3abd61be: ComIPduDirection=RECEIVE, ComIPduGroupRef=MyECU_oCAN_Rx_fcef2243, ComIPduSignalRef=Signal_Rx11bit_OnWrite_a1df81ad, ComIPduSignalRef=Signal_Rx15bit_OnWrite_a1df81ad, ComPduIdRef=PT_msg_RxEvent_20_PP_msg_RxEvent_20_Rx_346f2748_fe6ecc87
        msg_StartAppl_Rx_MyECU_oCAN_3abd61be: ComIPduDirection=RECEIVE, ComIPduGroupRef=MyECU_oCAN_Rx_fcef2243, ComIPduSignalRef=Signal_StartAppl_RxCtrl_MyECU_0da3c1e2, ComIPduSignalRef=Signal_StartAppl_RxData_MyECU_0da3c1e2, ComPduIdRef=PT_msg_StartAppl_Rx_MyECU_PP_msg_StartAppl_Rx_MyECU_Rx_346f2748_fe6ecc87
        msg_StartAppl_Tx_MyECU_oCAN_3abd61be: ComIPduDirection=SEND, ComIPduGroupRef=MyECU_oCAN_Tx_fcef2243, ComIPduSignalRef=Signal_StartAppl_TxCtrl_MyECU_ad461e3f, ComIPduSignalRef=Signal_StartAppl_TxData_MyECU_ad461e3f, ComPduIdRef=PT_msg_StartAppl_Tx_MyECU_PP_msg_StartAppl_Tx_MyECU_Tx_346f2748_fe6ecc87
          ComTxIPdu: ComMinimumDelayTime=0, ComTxIPduUnusedAreasDefault=0
            ComTxModeFalse
              ComTxMode: ComTxModeMode=PERIODIC, ComTxModeTimeOffset=0, ComTxModeTimePeriod=0.05
            ComTxModeTrue
              ComTxMode: ComTxModeMode=PERIODIC, ComTxModeTimeOffset=0, ComTxModeTimePeriod=0.05
        msg_TxCycle1000_10_oCAN_3abd61be: ComIPduDirection=SEND, ComIPduGroupRef=MyECU_oCAN_Tx_fcef2243, ComIPduSignalRef=Signal_Tx10bit_Cyclic_d74aed68, ComIPduSignalRef=Signal_Tx4bit_Cyclic_d74aed68, ComPduIdRef=PT_msg_TxCycle1000_10_PP_msg_TxCycle1000_10_Tx_346f2748_fe6ecc87
          ComTxIPdu: ComMinimumDelayTime=0, ComTxIPduUnusedAreasDefault=0
            ComTxModeFalse
              ComTxMode: ComTxModeMode=PERIODIC, ComTxModeTimeOffset=0.01, ComTxModeTimePeriod=1
            ComTxModeTrue
              ComTxMode: ComTxModeMode=PERIODIC, ComTxModeTimeOffset=0.01, ComTxModeTimePeriod=1
        msg_TxCycle10_0_oCAN_3abd61be: ComIPduDirection=SEND, ComIPduGroupRef=MyECU_oCAN_Tx_fcef2243, ComIPduSignalRef=Signal_Tx24bit_Cyclic_85bf3e37, ComIPduSignalRef=Signal_Tx32bit_Cyclic_85bf3e37, ComPduIdRef=PT_msg_TxCycle10_0_PP_msg_TxCycle10_0_Tx_346f2748_fe6ecc87
          ComTxIPdu: ComMinimumDelayTime=0, ComTxIPduUnusedAreasDefault=0
            ComTxModeFalse
              ComTxMode: ComTxModeMode=PERIODIC, ComTxModeTimeOffset=0, ComTxModeTimePeriod=0.01
            ComTxModeTrue
              ComTxMode: ComTxModeMode=PERIODIC, ComTxModeTimeOffset=0, ComTxModeTimePeriod=0.01
        msg_TxCycle_E2eProf1C_500_30_oCAN_3abd61be: ComIPduDirection=SEND, ComIPduGroupRef=MyECU_oCAN_Tx_fcef2243, ComIPduSignalGroupRef=SG_SgTx_Prof1C_TxCycle_eeefc687, ComPduIdRef=PT_msg_TxCycle_E2eProf1C_500_30_PP_msg_TxCycle_E2eProf1C_500_30_Tx_346f2748_fe6ecc87
          ComTxIPdu: ComMinimumDelayTime=0, ComTxIPduUnusedAreasDefault=0
            ComTxModeFalse
              ComTxMode: ComTxModeMode=PERIODIC, ComTxModeTimeOffset=0.03, ComTxModeTimePeriod=0.5
            ComTxModeTrue
              ComTxMode: ComTxModeMode=PERIODIC, ComTxModeTimeOffset=0.03, ComTxModeTimePeriod=0.5
        msg_TxEvent_10_oCAN_3abd61be: ComIPduDirection=SEND, ComIPduGroupRef=MyECU_oCAN_Tx_fcef2243, ComIPduSignalRef=Signal_Tx24bit_OnWrite_b2cd4fc2, ComIPduSignalRef=Signal_Tx32bit_OnWrite_b2cd4fc2, ComPduIdRef=PT_msg_TxEvent_10_PP_msg_TxEvent_10_Tx_346f2748_fe6ecc87
          ComTxIPdu: ComMinimumDelayTime=0, ComTxIPduUnusedAreasDefault=0
            ComTxModeFalse
              ComTxMode: ComTxModeMode=DIRECT, ComTxModeNumberOfRepetitions=0, ComTxModeRepetitionPeriod=0
            ComTxModeTrue
              ComTxMode: ComTxModeMode=DIRECT, ComTxModeNumberOfRepetitions=0, ComTxModeRepetitionPeriod=0
        msg_nm_MyECU_oCAN_3abd61be: ComIPduDirection=SEND, ComIPduSignalRef=NmUd_MyECU_16bit_c97b60cc, ComIPduSignalRef=NmUd_MyECU_32bit_c97b60cc, ComPduIdRef=EcucPduCollection/NmUsrData_msg_nm_MyECU_oCAN_3abd61be
          ComTxIPdu: ComTxIPduUnusedAreasDefault=0
      MyECU_oCAN_Rx_fcef2243 (ComIPduGroup)
      MyECU_oCAN_Tx_fcef2243 (ComIPduGroup)
      20 x ComSignal, all with ComSignalEndianness=LITTLE_ENDIAN:
        NmUd_MyECU_16bit_c97b60cc: ComBitPosition=0, ComBitSize=16, ComSignalInitValue=0, ComSignalType=UINT16, ComTransferProperty=PENDING, ComSystemTemplateSystemSignalRef=NmUd_MyECU_16bit
        NmUd_MyECU_32bit_c97b60cc: ComBitPosition=16, ComBitSize=32, ComSignalInitValue=0, ComSignalType=UINT32, ComTransferProperty=PENDING, ComSystemTemplateSystemSignalRef=NmUd_MyECU_32bit
        Signal_RearInteriorLight_1e247d16: ComBitPosition=0, ComBitSize=1, ComSignalInitValue=0, ComSignalType=BOOLEAN, ComTimeout=0, ComSystemTemplateSystemSignalRef=Signal_RearInteriorLight
        Signal_RearLeftDoor_1e247d16: ComBitPosition=1, ComBitSize=1, ComSignalInitValue=0, ComSignalType=BOOLEAN, ComTimeout=0, ComSystemTemplateSystemSignalRef=Signal_RearLeftDoor
        Signal_RearRightDoor_1e247d16: ComBitPosition=2, ComBitSize=1, ComSignalInitValue=0, ComSignalType=BOOLEAN, ComTimeout=0, ComSystemTemplateSystemSignalRef=Signal_RearRightDoor
        Signal_Rx11bit_OnWrite_a1df81ad: ComBitPosition=0, ComBitSize=11, ComSignalInitValue=50, ComSignalType=UINT16, ComTimeout=0, ComSystemTemplateSystemSignalRef=Signal_Rx11bit_OnWrite
        Signal_Rx15bit_OnWrite_a1df81ad: ComBitPosition=12, ComBitSize=15, ComSignalInitValue=25, ComSignalType=UINT16, ComTimeout=0, ComSystemTemplateSystemSignalRef=Signal_Rx15bit_OnWrite
        Signal_Rx16bit_Cyclic_a691adb3: ComBitPosition=32, ComBitSize=16, ComSignalInitValue=32768, ComSignalType=UINT16, ComTimeout=0, ComSystemTemplateSystemSignalRef=Signal_Rx16bit_Cyclic
        Signal_Rx20bit_Cyclic_a691adb3: ComBitPosition=8, ComBitSize=20, ComSignalInitValue=1, ComSignalType=UINT32, ComTimeout=0, ComSystemTemplateSystemSignalRef=Signal_Rx20bit_Cyclic
        Signal_Rx8bit_Cyclic_a691adb3: ComBitPosition=0, ComBitSize=8, ComSignalInitValue=15, ComSignalType=UINT8, ComTimeout=0, ComSystemTemplateSystemSignalRef=Signal_Rx8bit_Cyclic
        Signal_StartAppl_RxCtrl_MyECU_0da3c1e2: ComBitPosition=0, ComBitSize=8, ComSignalInitValue=0, ComSignalType=UINT8, ComTimeout=0, ComSystemTemplateSystemSignalRef=Signal_StartAppl_RxCtrl_MyECU
        Signal_StartAppl_RxData_MyECU_0da3c1e2: ComBitPosition=8, ComBitSize=8, ComSignalInitValue=0, ComSignalType=UINT8, ComTimeout=0, ComSystemTemplateSystemSignalRef=Signal_StartAppl_RxData_MyECU
        Signal_StartAppl_TxCtrl_MyECU_ad461e3f: ComBitPosition=0, ComBitSize=8, ComSignalInitValue=0, ComSignalType=UINT8, ComTransferProperty=PENDING, ComSystemTemplateSystemSignalRef=Signal_StartAppl_TxCtrl_MyECU
        Signal_StartAppl_TxData_MyECU_ad461e3f: ComBitPosition=8, ComBitSize=8, ComSignalInitValue=0, ComSignalType=UINT8, ComTransferProperty=PENDING, ComSystemTemplateSystemSignalRef=Signal_StartAppl_TxData_MyECU
        Signal_Tx10bit_Cyclic_d74aed68: ComBitPosition=0, ComBitSize=10, ComSignalInitValue=0, ComSignalType=UINT16, ComTransferProperty=PENDING, ComSystemTemplateSystemSignalRef=Signal_Tx10bit_Cyclic
        Signal_Tx24bit_Cyclic_85bf3e37: ComBitPosition=32, ComBitSize=24, ComSignalInitValue=0, ComSignalType=UINT32, ComTransferProperty=PENDING, ComSystemTemplateSystemSignalRef=Signal_Tx24bit_Cyclic
        Signal_Tx24bit_OnWrite_b2cd4fc2: ComBitPosition=32, ComBitSize=24, ComSignalInitValue=63, ComSignalType=UINT32, ComTransferProperty=TRIGGERED_WITHOUT_REPETITION, ComSystemTemplateSystemSignalRef=Signal_Tx24bit_OnWrite
        Signal_Tx32bit_Cyclic_85bf3e37: ComBitPosition=0, ComBitSize=32, ComSignalInitValue=0, ComSignalType=UINT32, ComTransferProperty=PENDING, ComSystemTemplateSystemSignalRef=Signal_Tx32bit_Cyclic
        Signal_Tx32bit_OnWrite_b2cd4fc2: ComBitPosition=0, ComBitSize=32, ComSignalInitValue=31, ComSignalType=UINT32, ComTransferProperty=TRIGGERED_WITHOUT_REPETITION, ComSystemTemplateSystemSignalRef=Signal_Tx32bit_OnWrite
        Signal_Tx4bit_Cyclic_d74aed68: ComBitPosition=10, ComBitSize=4, ComSignalInitValue=0, ComSignalType=UINT8, ComTransferProperty=PENDING, ComSystemTemplateSystemSignalRef=Signal_Tx4bit_Cyclic
      SG_RgRx_Prof1C_RxCycle_e8110737 (ComSignalGroup): ComTimeout=0, ComTransferProperty=PENDING, ComSystemTemplateSignalGroupRef=SG_RgRx_Prof1C_RxCycle
        6 x ComGroupSignal, all with ComSignalEndianness=LITTLE_ENDIAN, ComSignalInitValue=0:
          SigRx_Prof1C_CRC_0fb90f33: ComBitPosition=0, ComBitSize=8, ComSignalType=UINT8, ComSystemTemplateSystemSignalRef=SigRx_Prof1C_CRC
          SigRx_Prof1C_DataId_HiByte_LoNib_0fb90f33: ComBitPosition=12, ComBitSize=4, ComSignalType=UINT8, ComSystemTemplateSystemSignalRef=SigRx_Prof1C_DataId_HiByte_LoNib
          SigRx_Prof1C_SQ_0fb90f33: ComBitPosition=8, ComBitSize=4, ComSignalType=UINT8, ComSystemTemplateSystemSignalRef=SigRx_Prof1C_SQ
          SigRx_Prof1C_Sig32Bit_0fb90f33: ComBitPosition=24, ComBitSize=32, ComSignalType=UINT32, ComSystemTemplateSystemSignalRef=SigRx_Prof1C_Sig32Bit
          SigRx_Prof1C_Sig3Bit_0fb90f33: ComBitPosition=21, ComBitSize=3, ComSignalType=UINT8, ComSystemTemplateSystemSignalRef=SigRx_Prof1C_Sig3Bit
          SigRx_Prof1C_Sig4Bit_0fb90f33: ComBitPosition=16, ComBitSize=4, ComSignalType=UINT8, ComSystemTemplateSystemSignalRef=SigRx_Prof1C_Sig4Bit
      SG_SgTx_Prof1C_TxCycle_eeefc687 (ComSignalGroup): ComTransferProperty=PENDING, ComSystemTemplateSignalGroupRef=SG_SgTx_Prof1C_TxCycle
        7 x ComGroupSignal, all with ComSignalEndianness=LITTLE_ENDIAN, ComSignalInitValue=0, ComTransferProperty=PENDING:
          SigTx_Prof1C_CRC_06e38486: ComBitPosition=0, ComBitSize=8, ComSignalType=UINT8, ComSystemTemplateSystemSignalRef=SigTx_Prof1C_CRC
          SigTx_Prof1C_DataId_HiByte_LoNib_06e38486: ComBitPosition=12, ComBitSize=4, ComSignalType=UINT8, ComSystemTemplateSystemSignalRef=SigTx_Prof1C_DataId_HiByte_LoNib
          SigTx_Prof1C_SQ_06e38486: ComBitPosition=8, ComBitSize=4, ComSignalType=UINT8, ComSystemTemplateSystemSignalRef=SigTx_Prof1C_SQ
          SigTx_Prof1C_Sig16Bit_06e38486: ComBitPosition=32, ComBitSize=16, ComSignalType=UINT16, ComSystemTemplateSystemSignalRef=SigTx_Prof1C_Sig16Bit
          SigTx_Prof1C_Sig2Bit_06e38486: ComBitPosition=30, ComBitSize=2, ComSignalType=UINT8, ComSystemTemplateSystemSignalRef=SigTx_Prof1C_Sig2Bit
          SigTx_Prof1C_Sig4Bit_06e38486: ComBitPosition=16, ComBitSize=4, ComSignalType=UINT8, ComSystemTemplateSystemSignalRef=SigTx_Prof1C_Sig4Bit
          SigTx_Prof1C_Sig8Bit_06e38486: ComBitPosition=48, ComBitSize=8, ComSignalType=UINT8, ComSystemTemplateSystemSignalRef=SigTx_Prof1C_Sig8Bit
    ComGeneral
  module config ComM
    ComMConfigSet: ComMPncEnabled=false
      CAN_f26020e5 (ComMChannel): ComMBusType=COMM_BUS_TYPE_CAN, ComMChannelId=0  # CN_CAN
        ComMNetworkManagement: ComMNmVariant=FULL
        CHNL_3c6d4e43 (ComMUserPerChannel): ComMUserChannel=USR_CHNL_3c6d4e43  # CN_CAN
      USR_CHNL_3c6d4e43 (ComMUser): ComMUserIdentifier=0  # CN_CAN
    ComMGeneral: ComMPncIdCounting=COMM_PNC_ID_COUNT_FROM_NM_MESSAGE, ComMPncSupport=false
  module config Dcm
    DcmConfigSet  # Diagnostics Data Import
      DcmDsl
        DcmDslProtocol
          DcmDslProtocolRow
            DC_0xE001_oMyECU_oCAN (DcmDslConnection)
              DcmDslMainConnection: DcmDslProtocolRxTesterSourceAddr=224
                PT_msg_diag_RequestGlobal_PP_msg_diag_RequestGlobal_Rx_346f2748_fe6ecc87 (DcmDslProtocolRx):
                  DcmDslProtocolRxAddrType = DCM_FUNCTIONAL_TYPE
                  DcmDslProtocolRxPduId = 1
                  DcmDslProtocolRxComMChannelRef = ComMConfigSet/CAN_f26020e5
                  DcmDslProtocolRxPduRef = EcucPduCollection/PT_msg_diag_RequestGlobal_PP_msg_diag_RequestGlobal_Rx_346f2748_fe6ecc87
                PT_msg_diag_Request_MyECU_PP_msg_diag_Request_MyECU_Rx_346f2748_fe6ecc87 (DcmDslProtocolRx):
                  DcmDslProtocolRxAddrType = DCM_PHYSICAL_TYPE
                  DcmDslProtocolRxPduId = 2
                  DcmDslProtocolRxComMChannelRef = ComMConfigSet/CAN_f26020e5
                  DcmDslProtocolRxPduRef = EcucPduCollection/PT_msg_diag_Request_MyECU_PP_msg_diag_Request_MyECU_Rx_346f2748_fe6ecc87
                PT_msg_diag_Response_MyECU_PP_msg_diag_Response_MyECU_Tx_346f2748_fe6ecc87 (DcmDslProtocolTx):
                  DcmDslTxConfirmationPduId = 0
                  DcmDslProtocolTxPduRef = EcucPduCollection/PT_msg_diag_Response_MyECU_PP_msg_diag_Response_MyECU_Tx_346f2748_fe6ecc87
      DcmDsp: DcmDspMaxDidToRead=5, DcmDspMaxPeriodicDidToRead=5  # Diagnostics Data Import
        ComControl (DcmDspComControl)  # Diagnostics Data Import
          DspComContolAllChannel (DcmDspComControlAllChannel)  # Diagnostics Data Import
        DcmDspSession  # Diagnostics Data Import
          3 x DcmDspSessionRow, all with DcmDspSessionP2ServerMax=0.05, DcmDspSessionP2StarServerMax=5:
            Extended: DcmDspSessionLevel=3  # Diagnostics Data Import
            Programming: DcmDspSessionLevel=2  # Diagnostics Data Import
            Default: DcmDspSessionLevel=1  # Diagnostics Data Import
        DcmDspSecurity  # Diagnostics Data Import
          3 x DcmDspSecurityRow:
            Level_3: DcmDspSecurityDelayTime=10, DcmDspSecurityDelayTimeOnBoot=0, DcmDspSecurityKeySize=2, DcmDspSecurityLevel=2, DcmDspSecurityNumAttDelay=3, DcmDspSecuritySeedSize=2  # Diagnostics Data Import
            UnlockedL1: DcmDspSecurityDelayTime=10, DcmDspSecurityDelayTimeOnBoot=0, DcmDspSecurityKeySize=4, DcmDspSecurityLevel=1, DcmDspSecurityNumAttDelay=3, DcmDspSecuritySeedSize=4  # Diagnostics Data Import
            Locked: DcmDspSecurityLevel=0  # Diagnostics Data Import
        4 x DcmDspRoutineInfo:
          RoutineInfo_ForceBootMode  # Diagnostics Data Import
            DcmDspRoutineAuthorization: DcmDspRoutineSessionRef=DcmDspSession/Programming, DcmDspRoutineSessionRef=DcmDspSession/Extended  # Diagnostics Data Import
          RoutineInfo_CheckProgrammingPreconditions  # Diagnostics Data Import
            DcmDspRoutineAuthorization: DcmDspRoutineSessionRef=DcmDspSession/Programming, DcmDspRoutineSessionRef=DcmDspSession/Extended  # Diagnostics Data Import
          RoutineInfo_SampleRoutineControl_StartOnly  # Diagnostics Data Import
            DcmDspRoutineRequestResOut  # Diagnostics Data Import
              Out_Result (DcmDspRoutineRequestResOutSignal): DcmDspRoutineSignalLength=32, DcmDspRoutineSignalType=UINT32, DcmDspRoutineSignalEndianness=BIG_ENDIAN, DcmDspRoutineSignalPos=0  # Diagnostics Data Import
            DcmDspStartRoutineIn  # Diagnostics Data Import
              In_Option1 (DcmDspStartRoutineInSignal): DcmDspRoutineSignalLength=24, DcmDspRoutineSignalType=UINT8, DcmDspRoutineSignalEndianness=opaque, DcmDspRoutineSignalPos=0  # Diagnostics Data Import
            DcmDspRoutineAuthorization: DcmDspRoutineSessionRef=DcmDspSession/Programming, DcmDspRoutineSessionRef=DcmDspSession/Extended  # Diagnostics Data Import
          RoutineInfo_SampleRoutineControl  # Diagnostics Data Import
            DcmDspRoutineRequestResOut  # Diagnostics Data Import
              Out_Result (DcmDspRoutineRequestResOutSignal): DcmDspRoutineSignalLength=16, DcmDspRoutineSignalType=UINT16, DcmDspRoutineSignalEndianness=BIG_ENDIAN, DcmDspRoutineSignalPos=0  # Diagnostics Data Import
            DcmDspRoutineStopOut  # Diagnostics Data Import
              Out_StopState (DcmDspRoutineStopOutSignal): DcmDspRoutineSignalLength=32, DcmDspRoutineSignalType=UINT32, DcmDspRoutineSignalEndianness=BIG_ENDIAN, DcmDspRoutineSignalPos=0  # Diagnostics Data Import
            DcmDspStartRoutineOut  # Diagnostics Data Import
              Out_InitState (DcmDspStartRoutineOutSignal): DcmDspRoutineSignalLength=32, DcmDspRoutineSignalType=UINT32, DcmDspRoutineSignalEndianness=BIG_ENDIAN, DcmDspRoutineSignalPos=0  # Diagnostics Data Import
            DcmDspStartRoutineIn  # Diagnostics Data Import
              In_Option0 (DcmDspStartRoutineInSignal): DcmDspRoutineSignalLength=8, DcmDspRoutineSignalType=UINT8, DcmDspRoutineSignalPos=0  # Diagnostics Data Import
            DcmDspRoutineAuthorization: DcmDspRoutineSessionRef=DcmDspSession/Programming, DcmDspRoutineSessionRef=DcmDspSession/Extended  # Diagnostics Data Import
        4 x DcmDspRoutine:
          ForceBootMode: DcmDspRequestResultsRoutineSupported=false, DcmDspStopRoutineSupported=false, DcmDspRoutineIdentifier=62744, DcmDspRoutineInfoRef=RoutineInfo_ForceBootMode  # Diagnostics Data Import
          CheckProgrammingPreconditions: DcmDspRequestResultsRoutineSupported=false, DcmDspStopRoutineSupported=false, DcmDspRoutineIdentifier=515, DcmDspRoutineInfoRef=RoutineInfo_CheckProgrammingPreconditions  # Diagnostics Data Import
          SampleRoutineControl_StartOnly: DcmDspRequestResultsRoutineSupported=true, DcmDspStopRoutineSupported=false, DcmDspRoutineIdentifier=260, DcmDspRoutineInfoRef=RoutineInfo_SampleRoutineControl_StartOnly  # Diagnostics Data Import
          SampleRoutineControl: DcmDspRequestResultsRoutineSupported=true, DcmDspStopRoutineSupported=true, DcmDspRoutineIdentifier=256, DcmDspRoutineInfoRef=RoutineInfo_SampleRoutineControl  # Diagnostics Data Import
        DcmDspControlDTCSetting: DcmSupportDTCSettingControlOptionRecord=true  # Diagnostics Data Import
        17 x DcmDspDidInfo:
          DidInfo_DID_0xF413  # Diagnostics Data Import
            DcmDspDidAccess  # Diagnostics Data Import
              DcmDspDidRead  # Diagnostics Data Import
          DidInfo_DID_0xF412  # Diagnostics Data Import
            DcmDspDidAccess  # Diagnostics Data Import
              DcmDspDidRead  # Diagnostics Data Import
          DidInfo_DID_0xF410  # Diagnostics Data Import
            DcmDspDidAccess  # Diagnostics Data Import
              DcmDspDidRead  # Diagnostics Data Import
          DidInfo_SampleDynamicallyDefinedNonPeriodicDID: DcmDspDidDynamicallyDefined=true  # Diagnostics Data Import
            DcmDspDidAccess  # Diagnostics Data Import
              DcmDspDidDefine: DcmDspDDDidMaxElements=5  # Diagnostics Data Import
              DcmDspDidRead  # Diagnostics Data Import
          DidInfo_PeriodicDataSample  # Diagnostics Data Import
            DcmDspDidAccess  # Diagnostics Data Import
              DcmDspDidRead: DcmDspDidReadSessionRef=DcmDspSession/Programming, DcmDspDidReadSessionRef=DcmDspSession/Extended  # Diagnostics Data Import
          DidInfo_Hardware_Version  # Diagnostics Data Import
            DcmDspDidAccess  # Diagnostics Data Import
              DcmDspDidWrite  # Diagnostics Data Import
              DcmDspDidRead  # Diagnostics Data Import
          DidInfo_Vehicle_Identification  # Diagnostics Data Import
            DcmDspDidAccess  # Diagnostics Data Import
              DcmDspDidWrite  # Diagnostics Data Import
              DcmDspDidRead  # Diagnostics Data Import
          DidInfo_SerialNumber  # Diagnostics Data Import
            DcmDspDidAccess  # Diagnostics Data Import
              DcmDspDidWrite  # Diagnostics Data Import
              DcmDspDidRead  # Diagnostics Data Import
          DidInfo_EcuIdentification  # Diagnostics Data Import
            DcmDspDidAccess  # Diagnostics Data Import
              DcmDspDidWrite  # Diagnostics Data Import
              DcmDspDidRead  # Diagnostics Data Import
          DidInfo_Spare_Part_Number  # Diagnostics Data Import
            DcmDspDidAccess  # Diagnostics Data Import
              DcmDspDidWrite  # Diagnostics Data Import
              DcmDspDidRead  # Diagnostics Data Import
          DidInfo_Boot_Software  # Diagnostics Data Import
            DcmDspDidAccess  # Diagnostics Data Import
              DcmDspDidWrite  # Diagnostics Data Import
              DcmDspDidRead  # Diagnostics Data Import
          DidInfo_DataDiagnosticIdentifier_DID  # Diagnostics Data Import
            DcmDspDidAccess  # Diagnostics Data Import
              DcmDspDidWrite  # Diagnostics Data Import
              DcmDspDidRead  # Diagnostics Data Import
          DidInfo_DevelopmentData  # Diagnostics Data Import
            DcmDspDidAccess  # Diagnostics Data Import
              DcmDspDidWrite  # Diagnostics Data Import
              DcmDspDidRead  # Diagnostics Data Import
          DidInfo_Example_WriteOnlyDID  # Diagnostics Data Import
            DcmDspDidAccess  # Diagnostics Data Import
              DcmDspDidWrite  # Diagnostics Data Import
          DidInfo_SampleIoControl  # Diagnostics Data Import
            DcmDspDidAccess  # Diagnostics Data Import
              DcmDspDidRead  # Diagnostics Data Import
              DcmDspDidControl:  # Diagnostics Data Import
                DcmDspDidFreezeCurrentState = true
                DcmDspDidResetToDefault = true
                DcmDspDidReturnControlToEcu = true
                DcmDspDidShortTermAdjustment = true
                DcmDspDidControlSessionRef = DcmDspSession/Extended
          DidInfo_Example_ReadWriteData  # Diagnostics Data Import
            DcmDspDidAccess  # Diagnostics Data Import
              DcmDspDidWrite  # Diagnostics Data Import
              DcmDspDidRead  # Diagnostics Data Import
          DidInfo_Example_ReadOnlyDID  # Diagnostics Data Import
            DcmDspDidAccess  # Diagnostics Data Import
              DcmDspDidRead  # Diagnostics Data Import
        17 x DcmDspDid:
          DID_0xF413: DcmDspDidIdentifier=62483, DcmDspDidInfoRef=DidInfo_DID_0xF413  # Diagnostics Data Import
            DID_Data (DcmDspDidSignal): DcmDspDidDataPos=0, DcmDspDidDataRef=DID_0xF413_DID_Data  # Diagnostics Data Import
          DID_0xF412: DcmDspDidIdentifier=62482, DcmDspDidInfoRef=DidInfo_DID_0xF412  # Diagnostics Data Import
            DID_Data (DcmDspDidSignal): DcmDspDidDataPos=0, DcmDspDidDataRef=DID_0xF412_DID_Data  # Diagnostics Data Import
          DID_0xF410: DcmDspDidIdentifier=62480, DcmDspDidInfoRef=DidInfo_DID_0xF410  # Diagnostics Data Import
            DID_Data (DcmDspDidSignal): DcmDspDidDataPos=0, DcmDspDidDataRef=DID_0xF410_DID_Data  # Diagnostics Data Import
          SampleDynamicallyDefinedNonPeriodicDID: DcmDspDidIdentifier=62208, DcmDspDidInfoRef=DidInfo_SampleDynamicallyDefinedNonPeriodicDID  # Diagnostics Data Import
          PeriodicDataSample: DcmDspDidIdentifier=61953, DcmDspDidInfoRef=DidInfo_PeriodicDataSample  # Diagnostics Data Import
            DataRecord (DcmDspDidSignal): DcmDspDidDataPos=0, DcmDspDidDataRef=PeriodicDataSample_DataRecord  # Diagnostics Data Import
          Hardware_Version: DcmDspDidIdentifier=61843, DcmDspDidInfoRef=DidInfo_Hardware_Version  # Diagnostics Data Import
            Hardware_Version_Number (DcmDspDidSignal): DcmDspDidDataPos=0, DcmDspDidDataRef=Hardware_Version_Hardware_Version_Number  # Diagnostics Data Import
          Vehicle_Identification: DcmDspDidIdentifier=61840, DcmDspDidInfoRef=DidInfo_Vehicle_Identification  # Diagnostics Data Import
            VIN (DcmDspDidSignal): DcmDspDidDataPos=0, DcmDspDidDataRef=Vehicle_Identification_VIN  # Diagnostics Data Import
          SerialNumber: DcmDspDidIdentifier=61836, DcmDspDidInfoRef=DidInfo_SerialNumber  # Diagnostics Data Import
            SerialNumber (DcmDspDidSignal): DcmDspDidDataPos=0, DcmDspDidDataRef=SerialNumber_SerialNumber  # Diagnostics Data Import
          EcuIdentification: DcmDspDidIdentifier=61833, DcmDspDidInfoRef=DidInfo_EcuIdentification  # Diagnostics Data Import
            Part_Number (DcmDspDidSignal): DcmDspDidDataPos=0, DcmDspDidDataRef=EcuIdentification_Part_Number  # Diagnostics Data Import
          Spare_Part_Number: DcmDspDidIdentifier=61831, DcmDspDidInfoRef=DidInfo_Spare_Part_Number  # Diagnostics Data Import
            Spare_Part_Number (DcmDspDidSignal): DcmDspDidDataPos=0, DcmDspDidDataRef=Spare_Part_Number_Spare_Part_Number  # Diagnostics Data Import
          Boot_Software: DcmDspDidIdentifier=61824, DcmDspDidInfoRef=DidInfo_Boot_Software  # Diagnostics Data Import
            Boot_Software_Identification (DcmDspDidSignal): DcmDspDidDataPos=8, DcmDspDidDataRef=Boot_Software_Boot_Software_Identification  # Diagnostics Data Import
            NumberOfModules (DcmDspDidSignal): DcmDspDidDataPos=0, DcmDspDidDataRef=Boot_Software_NumberOfModules  # Diagnostics Data Import
          DataDiagnosticIdentifier_DID: DcmDspDidIdentifier=257, DcmDspDidInfoRef=DidInfo_DataDiagnosticIdentifier_DID  # Diagnostics Data Import
            DataDiagnosticIdentifier (DcmDspDidSignal): DcmDspDidDataPos=0, DcmDspDidDataRef=DataDiagnosticIdentifier_DID_DataDiagnosticIdentifier  # Diagnostics Data Import
          DevelopmentData: DcmDspDidIdentifier=256, DcmDspDidInfoRef=DidInfo_DevelopmentData  # Diagnostics Data Import
            5 x DcmDspDidSignal:
              TransportLayerVersion: DcmDspDidDataPos=64, DcmDspDidDataRef=DevelopmentData_TransportLayerVersion  # Diagnostics Data Import
              DiagnosticModuleVersion: DcmDspDidDataPos=48, DcmDspDidDataRef=DevelopmentData_DiagnosticModuleVersion  # Diagnostics Data Import
              NmVersion: DcmDspDidDataPos=32, DcmDspDidDataRef=DevelopmentData_NmVersion  # Diagnostics Data Import
              CanDriverVersion: DcmDspDidDataPos=16, DcmDspDidDataRef=DevelopmentData_CanDriverVersion  # Diagnostics Data Import
              OperatingSystemVersion: DcmDspDidDataPos=0, DcmDspDidDataRef=DevelopmentData_OperatingSystemVersion  # Diagnostics Data Import
          Example_WriteOnlyDID: DcmDspDidIdentifier=4, DcmDspDidInfoRef=DidInfo_Example_WriteOnlyDID  # Diagnostics Data Import
            DID_DataObject (DcmDspDidSignal): DcmDspDidDataPos=0, DcmDspDidDataRef=Example_WriteOnlyDID_DID_DataObject  # Diagnostics Data Import
          SampleIoControl: DcmDspDidIdentifier=3, DcmDspDidInfoRef=DidInfo_SampleIoControl  # Diagnostics Data Import
            DID_Data (DcmDspDidSignal): DcmDspDidDataPos=0, DcmDspDidDataRef=SampleIoControl_DID_Data  # Diagnostics Data Import
          Example_ReadWriteData: DcmDspDidIdentifier=2, DcmDspDidInfoRef=DidInfo_Example_ReadWriteData  # Diagnostics Data Import
            GlobalTime (DcmDspDidSignal): DcmDspDidDataPos=0, DcmDspDidDataRef=Example_ReadWriteData_GlobalTime  # Diagnostics Data Import
          Example_ReadOnlyDID: DcmDspDidIdentifier=1, DcmDspDidInfoRef=DidInfo_Example_ReadOnlyDID  # Diagnostics Data Import
            DID_Data_GlobalTime (DcmDspDidSignal): DcmDspDidDataPos=0, DcmDspDidDataRef=Example_ReadOnlyDID_DID_Data_GlobalTime  # Diagnostics Data Import
        DataInfo_DID_0xF413_DID_Data (DcmDspDataInfo): DcmDspDataFixedLength=true  # Diagnostics Data Import
        DID_0xF413_DID_Data (DcmDspData): DcmDspDataSize=16, DcmDspDataType=UINT16, DcmDspDataInfoRef=DataInfo_DID_0xF413_DID_Data  # Diagnostics Data Import
        DataInfo_DID_0xF412_DID_Data (DcmDspDataInfo): DcmDspDataFixedLength=true  # Diagnostics Data Import
        DID_0xF412_DID_Data (DcmDspData): DcmDspDataSize=16, DcmDspDataType=UINT16, DcmDspDataInfoRef=DataInfo_DID_0xF412_DID_Data  # Diagnostics Data Import
        DataInfo_DID_0xF410_DID_Data (DcmDspDataInfo): DcmDspDataFixedLength=true  # Diagnostics Data Import
        DID_0xF410_DID_Data (DcmDspData): DcmDspDataSize=16, DcmDspDataType=UINT16, DcmDspDataInfoRef=DataInfo_DID_0xF410_DID_Data  # Diagnostics Data Import
        DataInfo_PeriodicDataSample_DataRecord (DcmDspDataInfo): DcmDspDataFixedLength=true  # Diagnostics Data Import
        PeriodicDataSample_DataRecord (DcmDspData): DcmDspDataSize=16, DcmDspDataType=UINT16, DcmDspDataInfoRef=DataInfo_PeriodicDataSample_DataRecord  # Diagnostics Data Import
        DataInfo_Hardware_Version_Hardware_Version_Number (DcmDspDataInfo): DcmDspDataFixedLength=true  # Diagnostics Data Import
        Hardware_Version_Hardware_Version_Number (DcmDspData): DcmDspDataSize=32, DcmDspDataType=UINT32, DcmDspDataInfoRef=DataInfo_Hardware_Version_Hardware_Version_Number  # Diagnostics Data Import
        DataInfo_Vehicle_Identification_VIN (DcmDspDataInfo): DcmDspDataFixedLength=true  # Diagnostics Data Import
        Vehicle_Identification_VIN (DcmDspData): DcmDspDataSize=136, DcmDspDataType=UINT8_N, DcmDspDataInfoRef=DataInfo_Vehicle_Identification_VIN  # Diagnostics Data Import
        DataInfo_SerialNumber_SerialNumber (DcmDspDataInfo): DcmDspDataFixedLength=true  # Diagnostics Data Import
        SerialNumber_SerialNumber (DcmDspData): DcmDspDataSize=32, DcmDspDataType=UINT32, DcmDspDataInfoRef=DataInfo_SerialNumber_SerialNumber  # Diagnostics Data Import
        DataInfo_EcuIdentification_Part_Number (DcmDspDataInfo): DcmDspDataFixedLength=true  # Diagnostics Data Import
        EcuIdentification_Part_Number (DcmDspData): DcmDspDataSize=104, DcmDspDataType=UINT8_N, DcmDspDataInfoRef=DataInfo_EcuIdentification_Part_Number  # Diagnostics Data Import
        DataInfo_Spare_Part_Number_Spare_Part_Number (DcmDspDataInfo): DcmDspDataFixedLength=true  # Diagnostics Data Import
        Spare_Part_Number_Spare_Part_Number (DcmDspData): DcmDspDataSize=32, DcmDspDataType=UINT32, DcmDspDataInfoRef=DataInfo_Spare_Part_Number_Spare_Part_Number  # Diagnostics Data Import
        DataInfo_Boot_Software_Boot_Software_Identification (DcmDspDataInfo): DcmDspDataFixedLength=true  # Diagnostics Data Import
        Boot_Software_Boot_Software_Identification (DcmDspData): DcmDspDataSize=32, DcmDspDataType=UINT32, DcmDspDataInfoRef=DataInfo_Boot_Software_Boot_Software_Identification  # Diagnostics Data Import
        DataInfo_Boot_Software_NumberOfModules (DcmDspDataInfo): DcmDspDataFixedLength=true  # Diagnostics Data Import
        Boot_Software_NumberOfModules (DcmDspData): DcmDspDataSize=8, DcmDspDataType=UINT8, DcmDspDataInfoRef=DataInfo_Boot_Software_NumberOfModules  # Diagnostics Data Import
        DataInfo_DataDiagnosticIdentifier_DID_DataDiagnosticIdentifier (DcmDspDataInfo): DcmDspDataFixedLength=true  # Diagnostics Data Import
        DataDiagnosticIdentifier_DID_DataDiagnosticIdentifier (DcmDspData): DcmDspDataSize=16, DcmDspDataType=UINT16, DcmDspDataInfoRef=DataInfo_DataDiagnosticIdentifier_DID_DataDiagnosticIdentifier  # Diagnostics Data Import
        DataInfo_DevelopmentData_TransportLayerVersion (DcmDspDataInfo): DcmDspDataFixedLength=true  # Diagnostics Data Import
        DevelopmentData_TransportLayerVersion (DcmDspData): DcmDspDataSize=16, DcmDspDataType=UINT16, DcmDspDataInfoRef=DataInfo_DevelopmentData_TransportLayerVersion  # Diagnostics Data Import
        DataInfo_DevelopmentData_DiagnosticModuleVersion (DcmDspDataInfo): DcmDspDataFixedLength=true  # Diagnostics Data Import
        DevelopmentData_DiagnosticModuleVersion (DcmDspData): DcmDspDataSize=16, DcmDspDataType=UINT16, DcmDspDataInfoRef=DataInfo_DevelopmentData_DiagnosticModuleVersion  # Diagnostics Data Import
        DataInfo_DevelopmentData_NmVersion (DcmDspDataInfo): DcmDspDataFixedLength=true  # Diagnostics Data Import
        DevelopmentData_NmVersion (DcmDspData): DcmDspDataSize=16, DcmDspDataType=UINT16, DcmDspDataInfoRef=DataInfo_DevelopmentData_NmVersion  # Diagnostics Data Import
        DataInfo_DevelopmentData_CanDriverVersion (DcmDspDataInfo): DcmDspDataFixedLength=true  # Diagnostics Data Import
        DevelopmentData_CanDriverVersion (DcmDspData): DcmDspDataSize=16, DcmDspDataType=UINT16, DcmDspDataInfoRef=DataInfo_DevelopmentData_CanDriverVersion  # Diagnostics Data Import
        DataInfo_DevelopmentData_OperatingSystemVersion (DcmDspDataInfo): DcmDspDataFixedLength=true  # Diagnostics Data Import
        DevelopmentData_OperatingSystemVersion (DcmDspData): DcmDspDataSize=16, DcmDspDataType=UINT16, DcmDspDataInfoRef=DataInfo_DevelopmentData_OperatingSystemVersion  # Diagnostics Data Import
        DataInfo_Example_WriteOnlyDID_DID_DataObject (DcmDspDataInfo): DcmDspDataFixedLength=true  # Diagnostics Data Import
        Example_WriteOnlyDID_DID_DataObject (DcmDspData): DcmDspDataSize=8, DcmDspDataType=UINT8, DcmDspDataInfoRef=DataInfo_Example_WriteOnlyDID_DID_DataObject  # Diagnostics Data Import
        DataInfo_SampleIoControl_DID_Data (DcmDspDataInfo): DcmDspDataFixedLength=true  # Diagnostics Data Import
        SampleIoControl_DID_Data (DcmDspData): DcmDspDataConditionCheckReadFncUsed=false, DcmDspDataSize=32, DcmDspDataType=UINT32, DcmDspDataInfoRef=DataInfo_SampleIoControl_DID_Data  # Diagnostics Data Import
        DataInfo_Example_ReadWriteData_GlobalTime (DcmDspDataInfo): DcmDspDataFixedLength=true  # Diagnostics Data Import
        Example_ReadWriteData_GlobalTime (DcmDspData): DcmDspDataSize=32, DcmDspDataType=UINT32, DcmDspDataInfoRef=DataInfo_Example_ReadWriteData_GlobalTime  # Diagnostics Data Import
        DataInfo_Example_ReadOnlyDID_DID_Data_GlobalTime (DcmDspDataInfo): DcmDspDataFixedLength=true  # Diagnostics Data Import
        Example_ReadOnlyDID_DID_Data_GlobalTime (DcmDspData): DcmDspDataSize=48, DcmDspDataType=UINT8_N, DcmDspDataInfoRef=DataInfo_Example_ReadOnlyDID_DID_Data_GlobalTime  # Diagnostics Data Import
      DcmDsd  # Diagnostics Data Import
        DcmDsdServiceTable  # Diagnostics Data Import
          16 x DcmDsdService:
            ControlDtcSetting: DcmDsdSidTabServiceId=133, DcmDsdSidTabSubfuncAvail=true  # Diagnostics Data Import
              Disable (DcmDsdSubService): DcmDsdSubServiceId=2  # Diagnostics Data Import
              Enable (DcmDsdSubService): DcmDsdSubServiceId=1  # Diagnostics Data Import
            TesterPresent: DcmDsdSidTabServiceId=62, DcmDsdSidTabSubfuncAvail=true  # Diagnostics Data Import
              TesterPresent (DcmDsdSubService): DcmDsdSubServiceId=0  # Diagnostics Data Import
            WriteMemoryByAddress: DcmDsdSidTabServiceId=61, DcmDsdSidTabSubfuncAvail=false  # Diagnostics Data Import
            RoutineControl: DcmDsdSidTabServiceId=49, DcmDsdSidTabSubfuncAvail=true, DcmDsdSidTabSessionLevelRef=DcmDspSession/Programming, DcmDsdSidTabSessionLevelRef=DcmDspSession/Extended  # Diagnostics Data Import
            IoControlById: DcmDsdSidTabServiceId=47, DcmDsdSidTabSubfuncAvail=false, DcmDsdSidTabSessionLevelRef=DcmDspSession/Extended  # Diagnostics Data Import
            WriteDataById: DcmDsdSidTabServiceId=46, DcmDsdSidTabSubfuncAvail=false  # Diagnostics Data Import
            DynamicallyDefineDataId: DcmDsdSidTabServiceId=44, DcmDsdSidTabSubfuncAvail=true  # Diagnostics Data Import
              3 x DcmDsdSubService:
                DynDefClr: DcmDsdSubServiceId=3  # Diagnostics Data Import
                DynDefByAddr: DcmDsdSubServiceId=2  # Diagnostics Data Import
                DynDefById: DcmDsdSubServiceId=1  # Diagnostics Data Import
            ReadDataByPeriodicId: DcmDsdSidTabServiceId=42, DcmDsdSidTabSubfuncAvail=false, DcmDsdSidTabSessionLevelRef=DcmDspSession/Programming, DcmDsdSidTabSessionLevelRef=DcmDspSession/Extended  # Diagnostics Data Import
            CommunicationControl: DcmDsdSidTabServiceId=40, DcmDsdSidTabSubfuncAvail=true, DcmDsdSidTabSessionLevelRef=DcmDspSession/Programming, DcmDsdSidTabSessionLevelRef=DcmDspSession/Extended  # Diagnostics Data Import
              4 x DcmDsdSubService, all with DcmDsdSubServiceSessionLevelRef=DcmDspSession/Programming, DcmDsdSubServiceSessionLevelRef=DcmDspSession/Extended:
                DisableRxAndTx: DcmDsdSubServiceId=3  # Diagnostics Data Import
                DisableRxAndEnableTx: DcmDsdSubServiceId=2  # Diagnostics Data Import
                EnableRxAndDisableTx: DcmDsdSubServiceId=1  # Diagnostics Data Import
                EnableRxAndTx: DcmDsdSubServiceId=0  # Diagnostics Data Import
            SecurityAccess: DcmDsdSidTabServiceId=39, DcmDsdSidTabSubfuncAvail=true, DcmDsdSidTabSessionLevelRef=DcmDspSession/Programming, DcmDsdSidTabSessionLevelRef=DcmDspSession/Extended  # Diagnostics Data Import
              4 x DcmDsdSubService, all with DcmDsdSubServiceSessionLevelRef=DcmDspSession/Programming, DcmDsdSubServiceSessionLevelRef=DcmDspSession/Extended:
                sendKey_Send: DcmDsdSubServiceId=4  # Diagnostics Data Import
                requestSeed_Request: DcmDsdSubServiceId=3  # Diagnostics Data Import
                KeyLevel1_Send: DcmDsdSubServiceId=2  # Diagnostics Data Import
                SeedLevel1_Request: DcmDsdSubServiceId=1  # Diagnostics Data Import
            ReadMemoryByAddress: DcmDsdSidTabServiceId=35, DcmDsdSidTabSubfuncAvail=false  # Diagnostics Data Import
            ReadDataById: DcmDsdSidTabServiceId=34, DcmDsdSidTabSubfuncAvail=false  # Diagnostics Data Import
            ReadDtcInfo: DcmDsdSidTabServiceId=25, DcmDsdSidTabSubfuncAvail=true  # Diagnostics Data Import
              12 x DcmDsdSubService:
                RDTCFDC: DcmDsdSubServiceId=20  # Diagnostics Data Import
                RMRTFDTC: DcmDsdSubServiceId=13  # Diagnostics Data Import
                RFCDTC: DcmDsdSubServiceId=12  # Diagnostics Data Import
                RSUPDTC: DcmDsdSubServiceId=10  # Diagnostics Data Import
                RSIODTC: DcmDsdSubServiceId=9  # Diagnostics Data Import
                RDTCBSMR: DcmDsdSubServiceId=8  # Diagnostics Data Import
                RNODTCBSMR: DcmDsdSubServiceId=7  # Diagnostics Data Import
                RDTCEDRBDN: DcmDsdSubServiceId=6  # Diagnostics Data Import
                RDTCSSBDTC: DcmDsdSubServiceId=4  # Diagnostics Data Import
                RDTCSSI: DcmDsdSubServiceId=3  # Diagnostics Data Import
                RNODTCBSM: DcmDsdSubServiceId=1  # Diagnostics Data Import
                RDTCBSM: DcmDsdSubServiceId=2  # Diagnostics Data Import
            ClearDiagInfo: DcmDsdSidTabServiceId=20, DcmDsdSidTabSubfuncAvail=false  # Diagnostics Data Import
            EcuReset: DcmDsdSidTabServiceId=17, DcmDsdSidTabSubfuncAvail=true  # Diagnostics Data Import
              Hard (DcmDsdSubService): DcmDsdSubServiceId=1  # Diagnostics Data Import
            DiagSessionControl: DcmDsdSidTabServiceId=16, DcmDsdSidTabSubfuncAvail=true  # Diagnostics Data Import
              3 x DcmDsdSubService:
                Extended: DcmDsdSubServiceId=3  # Diagnostics Data Import
                Programming: DcmDsdSubServiceId=2  # Diagnostics Data Import
                Default: DcmDsdSubServiceId=1  # Diagnostics Data Import
  module config Dem
    DemGeneral:  # Diagnostics Data Import
      DemAgingCycleCounterProcessing = DEM_PROCESS_AGINGCTR_INTERN
      DemDebounceCounterBasedSupport = true
      DemDtcStatusAvailabilityMask = 255
      DemMaxNumberEventEntryMirror = 0
      DemPTOSupport = false
      DemTypeOfFreezeFrameRecordNumeration = DEM_FF_RECNUM_CALCULATED
      4 x DemDataClass:
        OccurrenceCounter_Occurrence_Counter: DemDataElementDataSize=1, DemDataElementInternalData=DEM_OCCCTR, DemDataElementUsePort=USE_DATA_INTERNAL  # Diagnostics Data Import
        DID_0x1_DID_Data_GlobalTime: DemDataElementDataSize=6, DemDataElementDataType=UINT8_N, DemDataElementEndianness=opaque, DemDataElementUsePort=USE_DATA_CLIENT_SERVER_PORT, DemDataElementStoreNonVolatile=true  # Diagnostics Data Import
        PID_0x13_DID_Data: DemDataElementDataSize=2, DemDataElementDataType=UINT16, DemDataElementEndianness=BIG_ENDIAN, DemDataElementUsePort=USE_DATA_CLIENT_SERVER_PORT, DemDataElementStoreNonVolatile=true  # Diagnostics Data Import
        PID_0x12_DID_Data: DemDataElementDataSize=2, DemDataElementDataType=UINT16, DemDataElementEndianness=BIG_ENDIAN, DemDataElementUsePort=USE_DATA_CLIENT_SERVER_PORT, DemDataElementStoreNonVolatile=true  # Diagnostics Data Import
      4 x DemOperationCycle:
        WarmUpCycle: DemOperationCycleType=DEM_OPCYC_WARMUP  # Diagnostics Data Import
        PowerCycle: DemOperationCycleType=DEM_OPCYC_POWER  # Diagnostics Data Import
        OBDDrivingCycle: DemOperationCycleType=DEM_OPCYC_OBD_DCY  # Diagnostics Data Import
        IgnitionCycle: DemOperationCycleType=DEM_OPCYC_IGNITION  # Diagnostics Data Import
      WarningIndicator (DemIndicator)  # Diagnostics Data Import
      FreezeFrameClass_5440cf4a (DemFreezeFrameClass): DemDidClassRef=DemGeneral/Example_ReadOnlyDID, DemDidClassRef=DemGeneral/DID_0xF412, DemDidClassRef=DemGeneral/DID_0xF413  # Diagnostics Data Import
      FreezeFrameClass_d65a1577 (DemFreezeFrameClass): DemDidClassRef=DemGeneral/Example_ReadOnlyDID  # Diagnostics Data Import
      OccurrenceCounter (DemExtendedDataRecordClass): DemExtendedDataRecordNumber=1, DemDataClassRef=OccurrenceCounter_Occurrence_Counter  # Diagnostics Data Import
      ExtendedDataClass_83dcefb7 (DemExtendedDataClass): DemExtendedDataRecordClassRef=OccurrenceCounter  # Diagnostics Data Import
      3 x DemDidClass:
        DID_0xF413: DemDidIdentifier=62483, DemDidDataClassRef=PID_0x13_DID_Data  # Diagnostics Data Import
        DID_0xF412: DemDidIdentifier=62482, DemDidDataClassRef=PID_0x12_DID_Data  # Diagnostics Data Import
        Example_ReadOnlyDID: DemDidIdentifier=1, DemDidDataClassRef=DID_0x1_DID_Data_GlobalTime  # Diagnostics Data Import
    DemConfigSet  # Diagnostics Data Import
      DTC_0x000003 (DemEventParameter):  # Diagnostics Data Import
        DemEventKind = DEM_EVENT_KIND_SWC
        DemMaxNumberFreezeFrameRecords = 1
        DemDTCClassRef = DTCClass_DTC_0x000003
        DemExtendedDataClassRef = ExtendedDataClass_83dcefb7
        DemFreezeFrameClassRef = FreezeFrameClass_5440cf4a
        DemEventClass:  # Diagnostics Data Import
          DemAgingAllowed = true
          DemAgingCycleCounterThreshold = 40
          DemEventDestination = DEM_DTC_ORIGIN_PRIMARY_MEMORY
          DemEventPriority = 1
          DemEventFailureCycleCounterThreshold = 2
          DemAgingCycleRef = WarmUpCycle
          DemOperationCycleRef = OBDDrivingCycle
          IndicatorAttribute_WarningIndicator (DemIndicatorAttribute): DemIndicatorFailureCycleSource=DEM_FAILURE_CYCLE_EVENT, DemIndicatorHealingCycleRef=OBDDrivingCycle, DemIndicatorRef=WarningIndicator  # Diagnostics Data Import
          DemDebounceAlgorithmClass  # Diagnostics Data Import
            DemDebounceCounterBased: DemDebounceCounterDecrementStepSize=1, DemDebounceCounterIncrementStepSize=1, DemDebounceCounterJumpDown=false, DemDebounceCounterJumpUp=true  # Diagnostics Data Import
      DTCClass_DTC_0x000003 (DemDTCClass): DemDTCSeverity=DEM_DTC_SEV_NO_SEVERITY, DemUdsDTC=3  # Diagnostics Data Import
      DTC_0x000002 (DemEventParameter):  # Diagnostics Data Import
        DemEventKind = DEM_EVENT_KIND_SWC
        DemMaxNumberFreezeFrameRecords = 1
        DemDTCClassRef = DTCClass_DTC_0x000002
        DemExtendedDataClassRef = ExtendedDataClass_83dcefb7
        DemFreezeFrameClassRef = FreezeFrameClass_d65a1577
        DemEventClass:  # Diagnostics Data Import
          DemAgingAllowed = false
          DemAgingCycleCounterThreshold = 100
          DemEventDestination = DEM_DTC_ORIGIN_PRIMARY_MEMORY
          DemEventPriority = 2
          DemEventFailureCycleCounterThreshold = 0
          DemAgingCycleRef = IgnitionCycle
          DemOperationCycleRef = PowerCycle
          IndicatorAttribute_WarningIndicator (DemIndicatorAttribute): DemIndicatorFailureCycleSource=DEM_FAILURE_CYCLE_EVENT, DemIndicatorHealingCycleRef=PowerCycle, DemIndicatorRef=WarningIndicator  # Diagnostics Data Import
          DemDebounceAlgorithmClass  # Diagnostics Data Import
            DemDebounceCounterBased: DemDebounceCounterDecrementStepSize=1, DemDebounceCounterIncrementStepSize=1, DemDebounceCounterJumpDown=false, DemDebounceCounterJumpUp=true  # Diagnostics Data Import
        DemCallbackInitMForE  # Diagnostics Data Import
      DTCClass_DTC_0x000002 (DemDTCClass): DemDTCSeverity=DEM_DTC_SEV_NO_SEVERITY, DemUdsDTC=2  # Diagnostics Data Import
  module config EcuC
    EcucPduCollection: PduIdTypeEnum=UINT8, PduLengthTypeEnum=UINT8
      25 x Pdu:
        MyECU_NmRxPdu_5f8bc0cc: PduLength=8
        NmUsrData_msg_nm_MyECU_oCAN_3abd61be: PduLength=6  # msg_nm_MyECU_oCAN
        PT_GlobalTimeMaster_PP_GlobalTimeMaster_Rx_346f2748_fe6ecc87: PduLength=8, SysTPduToFrameMappingRef=GlobalTimeMaster  # GlobalTimeMaster_oCAN
        PT_msg_RxCycle100_0_PP_msg_RxCycle100_0_Rx_346f2748_fe6ecc87: PduLength=1, SysTPduToFrameMappingRef=msg_RxCycle100_0  # msg_RxCycle100_0_oCAN
        PT_msg_RxCycle500_20_PP_msg_RxCycle500_20_Rx_346f2748_fe6ecc87: PduLength=6, SysTPduToFrameMappingRef=msg_RxCycle500_20  # msg_RxCycle500_20_oCAN
        PT_msg_RxCycle_E2eProf1C_500_10_PP_msg_RxCycle_E2eProf1C_500_10_Rx_346f2748_fe6ecc87: PduLength=8, SysTPduToFrameMappingRef=msg_RxCycle_E2eProf1C_500_10  # msg_RxCycle_E2eProf1C_500_10_oCAN
        PT_msg_RxEvent_20_PP_msg_RxEvent_20_Rx_346f2748_fe6ecc87: PduLength=4, SysTPduToFrameMappingRef=msg_RxEvent_20  # msg_RxEvent_20_oCAN
        PT_msg_StartAppl_Rx_MyECU_PP_msg_StartAppl_Rx_MyECU_Rx_346f2748_fe6ecc87: PduLength=8, SysTPduToFrameMappingRef=msg_StartAppl_Rx_MyECU  # msg_StartAppl_Rx_MyECU_oCAN
        PT_msg_StartAppl_Tx_MyECU_PP_msg_StartAppl_Tx_MyECU_Tx_346f2748_fe6ecc87: PduLength=8, SysTPduToFrameMappingRef=msg_StartAppl_Tx_MyECU  # msg_StartAppl_Tx_MyECU_oCAN
        PT_msg_TxCycle1000_10_PP_msg_TxCycle1000_10_Tx_346f2748_fe6ecc87: PduLength=2, SysTPduToFrameMappingRef=msg_TxCycle1000_10  # msg_TxCycle1000_10_oCAN
        PT_msg_TxCycle10_0_PP_msg_TxCycle10_0_Tx_346f2748_fe6ecc87: PduLength=7, SysTPduToFrameMappingRef=msg_TxCycle10_0  # msg_TxCycle10_0_oCAN
        PT_msg_TxCycle_E2eProf1C_500_30_PP_msg_TxCycle_E2eProf1C_500_30_Tx_346f2748_fe6ecc87: PduLength=8, SysTPduToFrameMappingRef=msg_TxCycle_E2eProf1C_500_30  # msg_TxCycle_E2eProf1C_500_30_oCAN
        PT_msg_TxEvent_10_PP_msg_TxEvent_10_Tx_346f2748_fe6ecc87: PduLength=7, SysTPduToFrameMappingRef=msg_TxEvent_10  # msg_TxEvent_10_oCAN
        PT_msg_XCP_Request_MyECU_PP_msg_XCP_Request_MyECU_Rx_346f2748_fe6ecc87: PduLength=8, SysTPduToFrameMappingRef=msg_XCP_Request_MyECU  # msg_XCP_Request_MyECU_oCAN
        PT_msg_XCP_Response_MyECU_PP_msg_XCP_Response_MyECU_Tx_346f2748_fe6ecc87: PduLength=8, SysTPduToFrameMappingRef=msg_XCP_Response_MyECU  # msg_XCP_Response_MyECU_oCAN
        PT_msg_diag_RequestGlobal_PP_msg_diag_RequestGlobal_Rx_346f2748_fe6ecc87: PduLength=7  # msg_diag_RequestGlobal_oCAN
        PT_msg_diag_RequestGlobal_Tp_PP_msg_diag_RequestGlobal_Tp_Rx_346f2748_fe6ecc87: PduLength=8, SysTPduToFrameMappingRef=msg_diag_RequestGlobal_Tp  # msg_diag_RequestGlobal_Tp_oCAN
        PT_msg_diag_Request_MyECU_PP_msg_diag_Request_MyECU_Rx_346f2748_fe6ecc87: PduLength=8  # msg_diag_Request_MyECU_oCAN
        PT_msg_diag_Request_MyECU_Slave3_PP_msg_diag_Request_MyECU_Slave3_Rx_346f2748_fe6ecc87: PduLength=8, SysTPduToFrameMappingRef=msg_diag_Request_MyECU_Slave3  # msg_diag_Request_MyECU_Slave3_oCAN
        PT_msg_diag_Request_MyECU_Tp_PP_msg_diag_Request_MyECU_Tp_Rx_346f2748_fe6ecc87: PduLength=8, SysTPduToFrameMappingRef=msg_diag_Request_MyECU_Tp  # msg_diag_Request_MyECU_Tp_oCAN
        PT_msg_diag_Response_MyECU_PP_msg_diag_Response_MyECU_Tx_346f2748_fe6ecc87: PduLength=8  # msg_diag_Response_MyECU_oCAN
        PT_msg_diag_Response_MyECU_Slave3_PP_msg_diag_Response_MyECU_Slave3_Tx_346f2748_fe6ecc87: PduLength=8, SysTPduToFrameMappingRef=msg_diag_Response_MyECU_Slave3  # msg_diag_Response_MyECU_Slave3_oCAN
        PT_msg_diag_Response_MyECU_Tp_PP_msg_diag_Response_MyECU_Tp_Tx_346f2748_fe6ecc87: PduLength=8, SysTPduToFrameMappingRef=msg_diag_Response_MyECU_Tp  # msg_diag_Response_MyECU_Tp_oCAN
        PT_msg_diag_Uudt_Response_MyECU_PP_msg_diag_Uudt_Response_MyECU_Tx_346f2748_fe6ecc87: PduLength=8, SysTPduToFrameMappingRef=msg_diag_Uudt_Response_MyECU  # msg_diag_Uudt_Response_MyECU_oCAN
        PT_msg_nm_MyECU_PP_msg_nm_MyECU_Tx_346f2748_fe6ecc87: PduLength=8, SysTPduToFrameMappingRef=msg_nm_MyECU  # msg_nm_MyECU_oCAN
  module config EcuM
    EcuMConfiguration
      EcuMCommonConfiguration
        EcuMDriverInitListOne
        EcuMDriverRestartList
        CAN_f26020e5 (EcuMWakeupSource): EcuMWakeupSourceId=5, EcuMComMChannelRef=ComMConfigSet/CAN_f26020e5  # CN_CAN
      EcuMFlexConfiguration: EcuMFlexModuleConfigurationRef=CanConfigSet
  module config Nm
    CAN_f26020e5 (NmChannelConfig): NmComMChannelRef=ComMConfigSet/CAN_f26020e5  # CN_CAN
      CAN_17d0077e (NmBusType)
        NmStandardBusNmConfig: NmStandardBusType=NM_BUSNM_CANNM  # CAN
    NmGlobalConfig
      NmGlobalFeatures: NmComUserDataSupport=true, NmNodeIdEnabled=true, NmUserDataEnabled=true
      NmGlobalProperties
  module config PduR
    PduRGeneral
    PduRRoutingTables
      PduRRoutingTable
        15 x PduRRoutingPath:
          Can_PT_msg_RxCycle100_0_346f2748  # msg_RxCycle100_0_oCAN
            DST_Can_PT_msg_RxCycle100_0_346f2748 (PduRDestPdu): PduRDestPduRef=PT_msg_RxCycle100_0_PP_msg_RxCycle100_0_Rx_346f2748_fe6ecc87
            SRC_Can_PT_msg_RxCycle100_0_346f2748 (PduRSrcPdu): PduRSrcPduRef=PT_msg_RxCycle100_0_PP_msg_RxCycle100_0_Rx_346f2748_fe6ecc87
          Can_PT_msg_RxCycle500_20_346f2748  # msg_RxCycle500_20_oCAN
            DST_Can_PT_msg_RxCycle500_20_346f2748 (PduRDestPdu): PduRDestPduRef=PT_msg_RxCycle500_20_PP_msg_RxCycle500_20_Rx_346f2748_fe6ecc87
            SRC_Can_PT_msg_RxCycle500_20_346f2748 (PduRSrcPdu): PduRSrcPduRef=PT_msg_RxCycle500_20_PP_msg_RxCycle500_20_Rx_346f2748_fe6ecc87
          Can_PT_msg_RxCycle_E2eProf1C_500_10_346f2748  # msg_RxCycle_E2eProf1C_500_10_oCAN
            DST_Can_PT_msg_RxCycle_E2eProf1C_500_10_346f2748 (PduRDestPdu): PduRDestPduRef=PT_msg_RxCycle_E2eProf1C_500_10_PP_msg_RxCycle_E2eProf1C_500_10_Rx_346f2748_fe6ecc87
            SRC_Can_PT_msg_RxCycle_E2eProf1C_500_10_346f2748 (PduRSrcPdu): PduRSrcPduRef=PT_msg_RxCycle_E2eProf1C_500_10_PP_msg_RxCycle_E2eProf1C_500_10_Rx_346f2748_fe6ecc87
          Can_PT_msg_RxEvent_20_346f2748  # msg_RxEvent_20_oCAN
            DST_Can_PT_msg_RxEvent_20_346f2748 (PduRDestPdu): PduRDestPduRef=PT_msg_RxEvent_20_PP_msg_RxEvent_20_Rx_346f2748_fe6ecc87
            SRC_Can_PT_msg_RxEvent_20_346f2748 (PduRSrcPdu): PduRSrcPduRef=PT_msg_RxEvent_20_PP_msg_RxEvent_20_Rx_346f2748_fe6ecc87
          Can_PT_msg_StartAppl_Rx_MyECU_346f2748  # msg_StartAppl_Rx_MyECU_oCAN
            DST_Can_PT_msg_StartAppl_Rx_MyECU_346f2748 (PduRDestPdu): PduRDestPduRef=PT_msg_StartAppl_Rx_MyECU_PP_msg_StartAppl_Rx_MyECU_Rx_346f2748_fe6ecc87
            SRC_Can_PT_msg_StartAppl_Rx_MyECU_346f2748 (PduRSrcPdu): PduRSrcPduRef=PT_msg_StartAppl_Rx_MyECU_PP_msg_StartAppl_Rx_MyECU_Rx_346f2748_fe6ecc87
          Can_PT_msg_StartAppl_Tx_MyECU_346f2748  # msg_StartAppl_Tx_MyECU_oCAN
            DST_Can_PT_msg_StartAppl_Tx_MyECU_346f2748 (PduRDestPdu): PduRDestPduRef=PT_msg_StartAppl_Tx_MyECU_PP_msg_StartAppl_Tx_MyECU_Tx_346f2748_fe6ecc87
            SRC_Can_PT_msg_StartAppl_Tx_MyECU_346f2748 (PduRSrcPdu): PduRSrcPduRef=PT_msg_StartAppl_Tx_MyECU_PP_msg_StartAppl_Tx_MyECU_Tx_346f2748_fe6ecc87
          Can_PT_msg_TxCycle1000_10_346f2748  # msg_TxCycle1000_10_oCAN
            DST_Can_PT_msg_TxCycle1000_10_346f2748 (PduRDestPdu): PduRDestPduRef=PT_msg_TxCycle1000_10_PP_msg_TxCycle1000_10_Tx_346f2748_fe6ecc87
            SRC_Can_PT_msg_TxCycle1000_10_346f2748 (PduRSrcPdu): PduRSrcPduRef=PT_msg_TxCycle1000_10_PP_msg_TxCycle1000_10_Tx_346f2748_fe6ecc87
          Can_PT_msg_TxCycle10_0_346f2748  # msg_TxCycle10_0_oCAN
            DST_Can_PT_msg_TxCycle10_0_346f2748 (PduRDestPdu): PduRDestPduRef=PT_msg_TxCycle10_0_PP_msg_TxCycle10_0_Tx_346f2748_fe6ecc87
            SRC_Can_PT_msg_TxCycle10_0_346f2748 (PduRSrcPdu): PduRSrcPduRef=PT_msg_TxCycle10_0_PP_msg_TxCycle10_0_Tx_346f2748_fe6ecc87
          Can_PT_msg_TxCycle_E2eProf1C_500_30_346f2748  # msg_TxCycle_E2eProf1C_500_30_oCAN
            DST_Can_PT_msg_TxCycle_E2eProf1C_500_30_346f2748 (PduRDestPdu): PduRDestPduRef=PT_msg_TxCycle_E2eProf1C_500_30_PP_msg_TxCycle_E2eProf1C_500_30_Tx_346f2748_fe6ecc87
            SRC_Can_PT_msg_TxCycle_E2eProf1C_500_30_346f2748 (PduRSrcPdu): PduRSrcPduRef=PT_msg_TxCycle_E2eProf1C_500_30_PP_msg_TxCycle_E2eProf1C_500_30_Tx_346f2748_fe6ecc87
          Can_PT_msg_TxEvent_10_346f2748  # msg_TxEvent_10_oCAN
            DST_Can_PT_msg_TxEvent_10_346f2748 (PduRDestPdu): PduRDestPduRef=PT_msg_TxEvent_10_PP_msg_TxEvent_10_Tx_346f2748_fe6ecc87
            SRC_Can_PT_msg_TxEvent_10_346f2748 (PduRSrcPdu): PduRSrcPduRef=PT_msg_TxEvent_10_PP_msg_TxEvent_10_Tx_346f2748_fe6ecc87
          Can_PT_msg_diag_RequestGlobal_346f2748  # msg_diag_RequestGlobal_oCAN
            DST_Can_PT_msg_diag_RequestGlobal_346f2748 (PduRDestPdu): PduRDestPduRef=EcucPduCollection/PT_msg_diag_RequestGlobal_PP_msg_diag_RequestGlobal_Rx_346f2748_fe6ecc87
            SRC_Can_PT_msg_diag_RequestGlobal_346f2748 (PduRSrcPdu): PduRSrcPduRef=EcucPduCollection/PT_msg_diag_RequestGlobal_PP_msg_diag_RequestGlobal_Rx_346f2748_fe6ecc87
          Can_PT_msg_diag_Request_MyECU_346f2748  # msg_diag_Request_MyECU_oCAN
            DST_Can_PT_msg_diag_Request_MyECU_346f2748 (PduRDestPdu): PduRDestPduRef=EcucPduCollection/PT_msg_diag_Request_MyECU_PP_msg_diag_Request_MyECU_Rx_346f2748_fe6ecc87
            SRC_Can_PT_msg_diag_Request_MyECU_346f2748 (PduRSrcPdu): PduRSrcPduRef=EcucPduCollection/PT_msg_diag_Request_MyECU_PP_msg_diag_Request_MyECU_Rx_346f2748_fe6ecc87
          Can_PT_msg_diag_Response_MyECU_346f2748  # msg_diag_Response_MyECU_oCAN
            DST_Can_PT_msg_diag_Response_MyECU_346f2748 (PduRDestPdu): PduRDestPduRef=EcucPduCollection/PT_msg_diag_Response_MyECU_PP_msg_diag_Response_MyECU_Tx_346f2748_fe6ecc87
            SRC_Can_PT_msg_diag_Response_MyECU_346f2748 (PduRSrcPdu): PduRSrcPduRef=EcucPduCollection/PT_msg_diag_Response_MyECU_PP_msg_diag_Response_MyECU_Tx_346f2748_fe6ecc87
          Can_PT_msg_diag_Uudt_Response_MyECU_346f2748  # msg_diag_Uudt_Response_MyECU_oCAN
            DST_Can_PT_msg_diag_Uudt_Response_MyECU_346f2748 (PduRDestPdu): PduRDestPduRef=PT_msg_diag_Uudt_Response_MyECU_PP_msg_diag_Uudt_Response_MyECU_Tx_346f2748_fe6ecc87
            SRC_Can_PT_msg_diag_Uudt_Response_MyECU_346f2748 (PduRSrcPdu): PduRSrcPduRef=PT_msg_diag_Uudt_Response_MyECU_PP_msg_diag_Uudt_Response_MyECU_Tx_346f2748_fe6ecc87
          Can_msg_nm_MyECU_oCAN_3abd61be  # msg_nm_MyECU_oCAN
            DST_Can_msg_nm_MyECU_oCAN_3abd61be (PduRDestPdu): PduRDestPduRef=EcucPduCollection/NmUsrData_msg_nm_MyECU_oCAN_3abd61be
            SRC_Can_msg_nm_MyECU_oCAN_3abd61be (PduRSrcPdu): PduRSrcPduRef=EcucPduCollection/NmUsrData_msg_nm_MyECU_oCAN_3abd61be
  module config Xcp
    XcpConfig
      msg_XCP_Request_MyECU_oCAN_3abd61be (XcpPdu)
        msg_XCP_Request_MyECU_oCAN_3abd61be (XcpRxPdu): XcpRxPduRef=PT_msg_XCP_Request_MyECU_PP_msg_XCP_Request_MyECU_Rx_346f2748_fe6ecc87
      msg_XCP_Response_MyECU_oCAN_3abd61be (XcpPdu)
        msg_XCP_Response_MyECU_oCAN_3abd61be (XcpTxPdu): XcpTxPduRef=PT_msg_XCP_Response_MyECU_PP_msg_XCP_Response_MyECU_Tx_346f2748_fe6ecc87
    XcpGeneral
