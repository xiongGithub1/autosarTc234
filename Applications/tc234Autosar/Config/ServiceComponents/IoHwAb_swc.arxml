AUTOSAR XML (schema 4-2-1)
package /MICROSAR/IoHwAb_swc/ComponentTypes
  ecu abstraction sw component type IoHwAb
    behavior IoHwAbInternalBehavior: handle-termination-and-restart=NO-SUPPORT
  swc implementation IoHwAbImplementation: programming-language=C, behavior=IoHwAbInternalBehavior
