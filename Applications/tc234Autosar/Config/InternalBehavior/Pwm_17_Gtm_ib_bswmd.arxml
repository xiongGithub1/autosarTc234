AUTOSAR XML (schema 4-2-1)
package /AURIX/Pwm_ib_bswmd/BswModuleDescriptions
  bsw module description Pwm
    bsw internal behavior PwmBehavior
