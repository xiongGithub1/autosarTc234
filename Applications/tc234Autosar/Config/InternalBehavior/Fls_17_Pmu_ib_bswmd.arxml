AUTOSAR XML (schema 4-2-1)
package /AURIX/Fls_ib_bswmd/BswModuleDescriptions
  bsw module entry Fls_17_Pmu_MainFunction: call-type=SCHEDULED, execution-context=TASK
