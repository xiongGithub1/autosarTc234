AUTOSAR XML (schema 4-2-1)
package /MICROSAR/Xcp_ib_bswmd/BswModuleDescriptions
  bsw module description Xcp: provided-entrys=[Xcp_MainFunction, CanXcp_MainFunction]
    bsw internal behavior XcpBehavior
      8 x exclusive area:
        XCP_EXCLUSIVE_AREA_{0..2}
        CANXCP_EXCLUSIVE_AREA_0
        FRXCP_EXCLUSIVE_AREA_{0..2}
        TCPIPXCP_EXCLUSIVE_AREA_0
      bsw schedulable entity Xcp_MainFunction: implemented-entry=Xcp_MainFunction
      bsw schedulable entity CanXcp_MainFunction: implemented-entry=CanXcp_MainFunction
      bsw timing event Xcp_MainFunctionTimingEvent0: starts-on-event=Xcp_MainFunction, period=0.005
      bsw timing event CanXcp_MainFunctionTimingEvent0: starts-on-event=CanXcp_MainFunction, period=0.005
  bsw module entry Xcp_MainFunction: call-type=SCHEDULED, execution-context=TASK
  bsw module entry CanXcp_MainFunction: call-type=SCHEDULED, execution-context=TASK
