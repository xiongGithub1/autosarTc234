AUTOSAR XML (schema 4-3-0)
package /ActiveEcuC
  ecuc value collection ActiveEcuC: ecuc-values=[EcuM, Resource, Mcu, Port]
  module config EcuM: implementation-config-variant=VARIANT-PRE-COMPILE, module-description=EcuM_Impl
    EcuMFlexGeneral: EcuMAlarmClockPresent=false, EcuMResetLoopDetection=false, EcuMEnableDefBehaviour=false
    EcuMGeneral:
      EcuMDevErrorDetect = true
      EcuMIncludeDem = true
      EcuMIncludeDet = true
      EcuMVersionInfoApi = false
      EcuMMainFunctionPeriod = 0.01
      EcuMDeferredBswMNotification = false
      EcuMSlaveCoreHandling = true
      EcuMEnableFixBehavior = false
      EcuMGeneration: EcuMOutOfBoundsWriteSanitizer=false, EcuMOutOfBoundsReadSanitizer=false, EcuMInterfacesForDeactivatedData=false
    EcuMConfiguration
      EcuMCommonConfiguration: EcuMConfigConsistencyHash=4072020918590118814, EcuMDefaultAppMode=(unset), EcuMOSResource=(unset)
        5 x EcuMWakeupSource, all with EcuMValidationTimeout=0, EcuMCheckWakeupTimeout=0, EcuMWakeupSourcePolling=false:
          ECUM_WKSOURCE_POWER: EcuMWakeupSourceId=0
          ECUM_WKSOURCE_RESET: EcuMWakeupSourceId=1
          ECUM_WKSOURCE_INTERNAL_RESET: EcuMWakeupSourceId=2
          ECUM_WKSOURCE_INTERNAL_WDG: EcuMWakeupSourceId=3
          ECUM_WKSOURCE_EXTERNAL_WDG: EcuMWakeupSourceId=4
        EcuMDefaultShutdownTarget: EcuMDefaultState=EcuMStateOff
      EcuMFlexConfiguration: EcuMNormalMcuModeRef=(unset)
        3 x EcuMResetMode:
          ECUM_RESET_MCU: EcuMResetModeId=0
          ECUM_RESET_WDG: EcuMResetModeId=1
          ECUM_RESET_IO: EcuMResetModeId=2
        4 x EcuMShutdownCause:
          ECUM_CAUSE_UNKNOWN: EcuMShutdownCauseId=0
          ECUM_CAUSE_ECU_STATE: EcuMShutdownCauseId=1
          ECUM_CAUSE_WDGM: EcuMShutdownCauseId=2
          ECUM_CAUSE_DCM: EcuMShutdownCauseId=3
        ECUM_RESET_WAKEUP (EcuMResetMode): EcuMResetModeId=3
package /Resource
  module config Resource: implementation-config-variant=VARIANT-PRE-COMPILE
    ResourceGeneral: ResourceSubDerivative=TC234L_32F200F
package /Mcu
  module config Mcu: implementation-config-variant=VARIANT-POST-BUILD-SELECTABLE, module-description=Mcu_Impl
    CommonPublishedInformation:
      ArMajorVersion = 3
      ArMinorVersion = 2
      ArPatchVersion = 0
      ModuleId = 101
      Release = _TRICORE_TC234
      SwMajorVersion = 5
      SwMinorVersion = 0
      SwPatchVersion = 2
      VendorApiInfix = 
      VendorId = 17
    McuGeneralConfiguration:
      McuClearColdResetApi = false
      McuDeInitApi = false
      McuDevErrorDetect = false
      McuErayPllDisable = false
      McuErayPllInitDelay = 10
      McuFmPllEnable = false
      McuGetRamStateApi = false
      McuInitClock = true
      McuMainOscillatorFrequency = 20
      McuNoPll = false
      McuPBFixedAddress = false
      McuPerformResetApi = false
      McuPllInitDelay = 10
      McuResetSfrAtInit = false
      McuRunningInUser0Mode = false
      McuUserModeDeInitApiEnable = false
      McuUserModeInitApiEnable = false
      McuUserModeRuntimeApiEnable = false
      McuVersionInfoApi = false
    McuModuleConfiguration_0 (McuModuleConfiguration): McuClockSrcFailureNotification=DISABLED, McuNumberOfMcuModes=1, McuRamSectors=0, McuResetSetting=0, McuStm0ResetDisable=false
      AscLinConfiguration: AscLin0=USE_FOR_NONE, AscLin1=USE_FOR_NONE
      McuClockSettingConfig_0 (McuClockSettingConfig): McuClockSettingId=0
        McuClockReferencePoint:
          McuASCLINFDivider = 2
          McuASCLINSDivider = 8
          McuBAUD1Divider = 2
          McuBAUD2Divider = 2
          McuBBBDivider = 2
          McuCANDivider = 2
          McuCPU0Divider = 0
          McuClockASCLINFFrequency = 60000000
          McuClockASCLINSFrequency = 15000000
          McuClockBAUD1Frequency = 60000000
          McuClockBAUD2Frequency = 60000000
          McuClockBBBFrequency = 60000000
          McuClockCANFrequency = 60000000
          McuClockCPU0Frequency = 120000000
          McuClockErayFrequency = 80000000
          McuClockErayPll2Frequency = 80000000
          McuClockErayPllFrequency = 80000000
          McuClockFSI2Frequency = 60000000
          McuClockFSIFrequency = 60000000
          McuClockGTMFrequency = 60000000
          McuClockMAXFrequency = 120000000
          McuClockReferencePoint2Frequency = 100000000
          McuClockReferencePointFrequency = 120000000
          McuClockSPBFrequency = 60000000
          McuClockSRIFrequency = 120000000
          McuClockSTMFrequency = 60000000
          McuClockSettingMode = NORMAL_MODE
          McuETHDivider = 1
          McuETHFrequency = 20000000
          McuErayDivider = 1
          McuErayPllK2Divider = 4
          McuErayPllK3Divider = 4
          McuErayPllNDivider = 19
          McuErayPllPDivider = 0
          McuFMPllModAmp = 1.25
          McuFSI2Divider = 2
          McuFSIDivider = 2
          McuGTMDivider = 2
          McuK2DivRampToBackUpConfDelay = 10
          McuK2DivRampToPllConfDelay = 10
          McuK2DivSteps = 2
          McuMAXDivider = 1
          McuPllK1Divider = 1
          McuPllK2Divider = 4
          McuPllK3Divider = 5
          McuPllNDivider = 29
          McuPllPDivider = 0
          McuSPBDivider = 2
          McuSRIDivider = 1
          McuSTMDivider = 2
      McuModeSettingConf_0 (McuModeSettingConf): McuIdleReqAckSeqDisable=false, McuMode=0
        McuStandbySettingConf:
          McuESR0TristateEnable = false
          McuESR1DigitalFilterEnable = false
          McuESR1EdgeDetection = TRIGGER_ANY_EDGE
          McuESR1WakeUpEnable = false
          McuPORSTDigitalFilterEnable = false
          McuPinADigitalFilterEnable = false
          McuPinAEdgeDetection = TRIGGER_ANY_EDGE
          McuPinAWakeUpEnable = false
          McuPinBDigitalFilterEnable = false
          McuPinBEdgeDetection = TRIGGER_ANY_EDGE
          McuPinBWakeUpEnable = false
          McuRARCrcCheckEnable = false
          McuRampToBackupFreqApi = false
          McuSetStandbyWakeupControlApi = false
          McuStandbyRAMSupplyEnable = true
      McuTriggerReset: ESR0ResetTrigger=0, ESR1ResetTrigger=0, SMUResetTrigger=0, STM0ResetTrigger=0
    McuPublishedInformation
      16 x McuResetReasonConf:
        MCU_CB0_RESET: McuResetReason=8
        MCU_CB1_RESET: McuResetReason=9
        MCU_CB3_RESET: McuResetReason=10
        MCU_ESR0_RESET: McuResetReason=0
        MCU_ESR1_RESET: McuResetReason=1
        MCU_EVR13_RESET: McuResetReason=12
        MCU_POWER_ON_RESET: McuResetReason=7
        MCU_SMU_RESET: McuResetReason=2
        MCU_STBYR_RESET: McuResetReason=15
        MCU_STM0_RESET: McuResetReason=4
        MCU_SUPPLY_WDOG_RESET: McuResetReason=14
        MCU_SW_RESET: McuResetReason=3
        MCU_TP_RESET: McuResetReason=11
        McuResetReasonConf: McuResetReason=0
        McuResetReasonConf_1: McuResetReason=0
        McuResetReasonConf_2: McuResetReason=0
    McuSafety: McuClockMonitoringEnable=true, McuGetModeApi=true, McuInitCheckApi=true, McuSafetyEnable=false
package /Port
  module config Port: implementation-config-variant=VARIANT-POST-BUILD-SELECTABLE, module-description=Port_Impl
    CommonPublishedInformation:
      ArMajorVersion = 3
      ArMinorVersion = 2
      ArPatchVersion = 0
      ModuleId = 124
      Release = _TRICORE_TC234
      SwMajorVersion = 3
      SwMinorVersion = 2
      SwPatchVersion = 0
      VendorId = 17
    PortConfigSet_0 (PortConfigSet)
      15 x PortContainer:
        PortContainer_0: PortNumber=0, PortNumberOfPortPins=11
          11 x PortPin, all with PortPinAnalogInput=DISABLE, PortPinControllerSelect=DISABLE, PortPinDirection=PORT_PIN_IN, PortPinDirectionChangeable=false, PortPinDriverStrength=PORT_CMOS_SPEED_GRADE1, PortPinInitialMode=PORT_PIN_MODE_GPIO, PortPinInputCharacteristic=PORT_PIN_IN_PULL_UP, PortPinLevelValue=PORT_PIN_LEVEL_LOW, PortPinMode=PORT_PIN_MODE_ALL, PortPinModeChangeable=false, PortPinPadLevel=PORT_PDR_CMOS_AUTOMOTIVE_LEVEL:
            PortPin_0: PortPinId=0, PortPinSymbolicName=PORT_0_PIN_0
            PortPin_1: PortPinId=1, PortPinSymbolicName=PORT_0_PIN_1
            PortPin_10: PortPinId=12, PortPinSymbolicName=PORT_0_PIN_12
            PortPin_{2..9}: PortPinId={2..9}, PortPinSymbolicName=PORT_0_PIN_{2..9}
        PortContainer_1: PortNumber=2, PortNumberOfPortPins=9
          9 x PortPin, all with PortPinAnalogInput=DISABLE, PortPinControllerSelect=DISABLE, PortPinDirection=PORT_PIN_IN, PortPinDirectionChangeable=false, PortPinDriverStrength=PORT_CMOS_SPEED_GRADE1, PortPinInitialMode=PORT_PIN_MODE_GPIO, PortPinInputCharacteristic=PORT_PIN_IN_PULL_UP, PortPinLevelValue=PORT_PIN_LEVEL_LOW, PortPinMode=PORT_PIN_MODE_ALL, PortPinModeChangeable=false, PortPinPadLevel=PORT_PDR_CMOS_AUTOMOTIVE_LEVEL:
            PortPin_0: PortPinId=32, PortPinSymbolicName=PORT_2_PIN_0
            PortPin_1: PortPinId=33, PortPinSymbolicName=PORT_2_PIN_1
            PortPin_2: PortPinId=34, PortPinSymbolicName=PORT_2_PIN_2
            PortPin_3: PortPinId=35, PortPinSymbolicName=PORT_2_PIN_3
            PortPin_4: PortPinId=36, PortPinSymbolicName=PORT_2_PIN_4
            PortPin_5: PortPinId=37, PortPinSymbolicName=PORT_2_PIN_5
            PortPin_6: PortPinId=38, PortPinSymbolicName=PORT_2_PIN_6
            PortPin_7: PortPinId=39, PortPinSymbolicName=PORT_2_PIN_7
            PortPin_8: PortPinId=40, PortPinSymbolicName=PORT_2_PIN_8
        PortContainer_10: PortNumber=23, PortNumberOfPortPins=1
          PortPin_0 (PortPin):
            PortPinAnalogInput = DISABLE
            PortPinControllerSelect = DISABLE
            PortPinDirection = PORT_PIN_IN
            PortPinDirectionChangeable = false
            PortPinDriverStrength = PORT_CMOS_SPEED_GRADE1
            PortPinId = 369
            PortPinInitialMode = PORT_PIN_MODE_GPIO
            PortPinInputCharacteristic = PORT_PIN_IN_PULL_UP
            PortPinLevelValue = PORT_PIN_LEVEL_LOW
            PortPinMode = PORT_PIN_MODE_ALL
            PortPinModeChangeable = false
            PortPinPadLevel = PORT_PDR_CMOS_AUTOMOTIVE_LEVEL
            PortPinSymbolicName = PORT_23_PIN_1
        PortContainer_11: PortNumber=33, PortNumberOfPortPins=13
          13 x PortPin, all with PortPinAnalogInput=DISABLE, PortPinControllerSelect=DISABLE, PortPinDirection=PORT_PIN_IN, PortPinDirectionChangeable=false, PortPinDriverStrength=PORT_CMOS_SPEED_GRADE1, PortPinInitialMode=PORT_PIN_MODE_GPIO, PortPinInputCharacteristic=PORT_PIN_IN_PULL_UP, PortPinLevelValue=PORT_PIN_LEVEL_LOW, PortPinMode=PORT_PIN_MODE_ALL, PortPinModeChangeable=false, PortPinPadLevel=PORT_PDR_CMOS_AUTOMOTIVE_LEVEL:
            PortPin_0: PortPinId=528, PortPinSymbolicName=PORT_33_PIN_0
            PortPin_1: PortPinId=529, PortPinSymbolicName=PORT_33_PIN_1
            PortPin_10: PortPinId=538, PortPinSymbolicName=PORT_33_PIN_10
            PortPin_11: PortPinId=539, PortPinSymbolicName=PORT_33_PIN_11
            PortPin_12: PortPinId=540, PortPinSymbolicName=PORT_33_PIN_12
            PortPin_2: PortPinId=530, PortPinSymbolicName=PORT_33_PIN_2
            PortPin_3: PortPinId=531, PortPinSymbolicName=PORT_33_PIN_3
            PortPin_4: PortPinId=532, PortPinSymbolicName=PORT_33_PIN_4
            PortPin_5: PortPinId=533, PortPinSymbolicName=PORT_33_PIN_5
            PortPin_6: PortPinId=534, PortPinSymbolicName=PORT_33_PIN_6
            PortPin_7: PortPinId=535, PortPinSymbolicName=PORT_33_PIN_7
            PortPin_8: PortPinId=536, PortPinSymbolicName=PORT_33_PIN_8
            PortPin_9: PortPinId=537, PortPinSymbolicName=PORT_33_PIN_9
        PortContainer_12: PortNumber=34, PortNumberOfPortPins=4
          4 x PortPin, all with PortPinAnalogInput=DISABLE, PortPinControllerSelect=DISABLE, PortPinDirection=PORT_PIN_IN, PortPinDirectionChangeable=false, PortPinDriverStrength=PORT_CMOS_SPEED_GRADE1, PortPinInitialMode=PORT_PIN_MODE_GPIO, PortPinInputCharacteristic=PORT_PIN_IN_PULL_UP, PortPinLevelValue=PORT_PIN_LEVEL_LOW, PortPinMode=PORT_PIN_MODE_ALL, PortPinModeChangeable=false, PortPinPadLevel=PORT_PDR_CMOS_AUTOMOTIVE_LEVEL:
            PortPin_0: PortPinId=544, PortPinSymbolicName=PORT_34_PIN_0
            PortPin_1: PortPinId=545, PortPinSymbolicName=PORT_34_PIN_1
            PortPin_2: PortPinId=546, PortPinSymbolicName=PORT_34_PIN_2
            PortPin_3: PortPinId=547, PortPinSymbolicName=PORT_34_PIN_3
        PortContainer_13: PortNumber=40, PortNumberOfPortPins=12
          12 x PortPin, all with PortPinAnalogInput=DISABLE, PortPinControllerSelect=DISABLE, PortPinDirection=PORT_PIN_IN, PortPinDirectionChangeable=false, PortPinDriverStrength=PORT_CMOS_SPEED_GRADE1, PortPinInitialMode=PORT_PIN_MODE_GPIO, PortPinInputCharacteristic=PORT_PIN_IN_PULL_UP, PortPinLevelValue=PORT_PIN_LEVEL_LOW, PortPinModeChangeable=false, PortPinPadLevel=PORT_PDR_CMOS_AUTOMOTIVE_LEVEL:
            PortPin_0: PortPinId=640, PortPinSymbolicName=PORT_40_PIN_0
            PortPin_1: PortPinId=641, PortPinSymbolicName=PORT_40_PIN_1
            PortPin_10: PortPinId=650, PortPinSymbolicName=PORT_40_PIN_10
            PortPin_11: PortPinId=651, PortPinSymbolicName=PORT_40_PIN_11
            PortPin_2: PortPinId=642, PortPinSymbolicName=PORT_40_PIN_2
            PortPin_3: PortPinId=643, PortPinSymbolicName=PORT_40_PIN_3
            PortPin_4: PortPinId=644, PortPinSymbolicName=PORT_40_PIN_4
            PortPin_5: PortPinId=645, PortPinSymbolicName=PORT_40_PIN_5
            PortPin_6: PortPinId=646, PortPinSymbolicName=PORT_40_PIN_6
            PortPin_7: PortPinId=647, PortPinSymbolicName=PORT_40_PIN_7
            PortPin_8: PortPinId=648, PortPinSymbolicName=PORT_40_PIN_8
            PortPin_9: PortPinId=649, PortPinSymbolicName=PORT_40_PIN_9
        PortContainer_14: PortNumber=41, PortNumberOfPortPins=12
          12 x PortPin, all with PortPinAnalogInput=DISABLE, PortPinControllerSelect=DISABLE, PortPinDirection=PORT_PIN_IN, PortPinDirectionChangeable=false, PortPinDriverStrength=PORT_CMOS_SPEED_GRADE1, PortPinInitialMode=PORT_PIN_MODE_GPIO, PortPinInputCharacteristic=PORT_PIN_IN_PULL_UP, PortPinLevelValue=PORT_PIN_LEVEL_LOW, PortPinModeChangeable=false, PortPinPadLevel=PORT_PDR_CMOS_AUTOMOTIVE_LEVEL:
            PortPin_0: PortPinId=656, PortPinSymbolicName=PORT_41_PIN_0
            PortPin_1: PortPinId=657, PortPinSymbolicName=PORT_41_PIN_1
            PortPin_10: PortPinId=666, PortPinSymbolicName=PORT_41_PIN_10
            PortPin_11: PortPinId=667, PortPinSymbolicName=PORT_41_PIN_11
            PortPin_2: PortPinId=658, PortPinSymbolicName=PORT_41_PIN_2
            PortPin_3: PortPinId=659, PortPinSymbolicName=PORT_41_PIN_3
            PortPin_4: PortPinId=660, PortPinSymbolicName=PORT_41_PIN_4
            PortPin_5: PortPinId=661, PortPinSymbolicName=PORT_41_PIN_5
            PortPin_6: PortPinId=662, PortPinSymbolicName=PORT_41_PIN_6
            PortPin_7: PortPinId=663, PortPinSymbolicName=PORT_41_PIN_7
            PortPin_8: PortPinId=664, PortPinSymbolicName=PORT_41_PIN_8
            PortPin_9: PortPinId=665, PortPinSymbolicName=PORT_41_PIN_9
        PortContainer_2: PortNumber=10, PortNumberOfPortPins=5
          5 x PortPin, all with PortPinAnalogInput=DISABLE, PortPinControllerSelect=DISABLE, PortPinDirection=PORT_PIN_IN, PortPinDirectionChangeable=false, PortPinDriverStrength=PORT_CMOS_SPEED_GRADE1, PortPinInitialMode=PORT_PIN_MODE_GPIO, PortPinInputCharacteristic=PORT_PIN_IN_PULL_UP, PortPinLevelValue=PORT_PIN_LEVEL_LOW, PortPinMode=PORT_PIN_MODE_ALL, PortPinModeChangeable=false, PortPinPadLevel=PORT_PDR_CMOS_AUTOMOTIVE_LEVEL:
            PortPin_0: PortPinId=161, PortPinSymbolicName=PORT_10_PIN_1
            PortPin_1: PortPinId=162, PortPinSymbolicName=PORT_10_PIN_2
            PortPin_2: PortPinId=163, PortPinSymbolicName=PORT_10_PIN_3
            PortPin_3: PortPinId=165, PortPinSymbolicName=PORT_10_PIN_5
            PortPin_4: PortPinId=166, PortPinSymbolicName=PORT_10_PIN_6
        PortContainer_3: PortNumber=11, PortNumberOfPortPins=8
          8 x PortPin, all with PortPinAnalogInput=DISABLE, PortPinControllerSelect=DISABLE, PortPinDirection=PORT_PIN_IN, PortPinDirectionChangeable=false, PortPinDriverStrength=PORT_CMOS_SPEED_GRADE1, PortPinInitialMode=PORT_PIN_MODE_GPIO, PortPinInputCharacteristic=PORT_PIN_IN_PULL_UP, PortPinLevelValue=PORT_PIN_LEVEL_LOW, PortPinMode=PORT_PIN_MODE_ALL, PortPinModeChangeable=false, PortPinPadLevel=PORT_PDR_CMOS_AUTOMOTIVE_LEVEL:
            PortPin_0: PortPinId=178, PortPinSymbolicName=PORT_11_PIN_2
            PortPin_1: PortPinId=179, PortPinSymbolicName=PORT_11_PIN_3
            PortPin_2: PortPinId=182, PortPinSymbolicName=PORT_11_PIN_6
            PortPin_3: PortPinId=184, PortPinSymbolicName=PORT_11_PIN_8
            PortPin_4: PortPinId=185, PortPinSymbolicName=PORT_11_PIN_9
            PortPin_5: PortPinId=186, PortPinSymbolicName=PORT_11_PIN_10
            PortPin_6: PortPinId=187, PortPinSymbolicName=PORT_11_PIN_11
            PortPin_7: PortPinId=188, PortPinSymbolicName=PORT_11_PIN_12
        PortContainer_4: PortNumber=13, PortNumberOfPortPins=4
          4 x PortPin, all with PortPinAnalogInput=DISABLE, PortPinControllerSelect=DISABLE, PortPinDirection=PORT_PIN_IN, PortPinDirectionChangeable=false, PortPinDriverStrength=PORT_CMOS_SPEED_GRADE1, PortPinInitialMode=PORT_PIN_MODE_GPIO, PortPinInputCharacteristic=PORT_PIN_IN_PULL_UP, PortPinLevelValue=PORT_PIN_LEVEL_LOW, PortPinMode=PORT_PIN_MODE_ALL, PortPinModeChangeable=false, PortPinPadLevel=PORT_PDR_CMOS_AUTOMOTIVE_LEVEL:
            PortPin_0: PortPinId=208, PortPinSymbolicName=PORT_13_PIN_0
            PortPin_1: PortPinId=209, PortPinSymbolicName=PORT_13_PIN_1
            PortPin_2: PortPinId=210, PortPinSymbolicName=PORT_13_PIN_2
            PortPin_3: PortPinId=211, PortPinSymbolicName=PORT_13_PIN_3
        PortContainer_5: PortNumber=14, PortNumberOfPortPins=9
          9 x PortPin, all with PortPinAnalogInput=DISABLE, PortPinControllerSelect=DISABLE, PortPinDirection=PORT_PIN_IN, PortPinDirectionChangeable=false, PortPinDriverStrength=PORT_CMOS_SPEED_GRADE1, PortPinInitialMode=PORT_PIN_MODE_GPIO, PortPinInputCharacteristic=PORT_PIN_IN_PULL_UP, PortPinLevelValue=PORT_PIN_LEVEL_LOW, PortPinMode=PORT_PIN_MODE_ALL, PortPinModeChangeable=false, PortPinPadLevel=PORT_PDR_CMOS_AUTOMOTIVE_LEVEL:
            PortPin_0: PortPinId=224, PortPinSymbolicName=PORT_14_PIN_0
            PortPin_1: PortPinId=225, PortPinSymbolicName=PORT_14_PIN_1
            PortPin_2: PortPinId=226, PortPinSymbolicName=PORT_14_PIN_2
            PortPin_3: PortPinId=227, PortPinSymbolicName=PORT_14_PIN_3
            PortPin_4: PortPinId=228, PortPinSymbolicName=PORT_14_PIN_4
            PortPin_5: PortPinId=229, PortPinSymbolicName=PORT_14_PIN_5
            PortPin_6: PortPinId=230, PortPinSymbolicName=PORT_14_PIN_6
            PortPin_7: PortPinId=231, PortPinSymbolicName=PORT_14_PIN_7
            PortPin_8: PortPinId=232, PortPinSymbolicName=PORT_14_PIN_8
        PortContainer_6: PortNumber=15, PortNumberOfPortPins=9
          9 x PortPin, all with PortPinAnalogInput=DISABLE, PortPinControllerSelect=DISABLE, PortPinDirection=PORT_PIN_IN, PortPinDirectionChangeable=false, PortPinDriverStrength=PORT_CMOS_SPEED_GRADE1, PortPinInitialMode=PORT_PIN_MODE_GPIO, PortPinInputCharacteristic=PORT_PIN_IN_PULL_UP, PortPinLevelValue=PORT_PIN_LEVEL_LOW, PortPinMode=PORT_PIN_MODE_ALL, PortPinModeChangeable=false, PortPinPadLevel=PORT_PDR_CMOS_AUTOMOTIVE_LEVEL:
            PortPin_0: PortPinId=240, PortPinSymbolicName=PORT_15_PIN_0
            PortPin_1: PortPinId=241, PortPinSymbolicName=PORT_15_PIN_1
            PortPin_2: PortPinId=242, PortPinSymbolicName=PORT_15_PIN_2
            PortPin_3: PortPinId=243, PortPinSymbolicName=PORT_15_PIN_3
            PortPin_4: PortPinId=244, PortPinSymbolicName=PORT_15_PIN_4
            PortPin_5: PortPinId=245, PortPinSymbolicName=PORT_15_PIN_5
            PortPin_6: PortPinId=246, PortPinSymbolicName=PORT_15_PIN_6
            PortPin_7: PortPinId=247, PortPinSymbolicName=PORT_15_PIN_7
            PortPin_8: PortPinId=248, PortPinSymbolicName=PORT_15_PIN_8
        PortContainer_7: PortNumber=20, PortNumberOfPortPins=12
          12 x PortPin, all with PortPinAnalogInput=DISABLE, PortPinControllerSelect=DISABLE, PortPinDirection=PORT_PIN_IN, PortPinDirectionChangeable=false, PortPinDriverStrength=PORT_CMOS_SPEED_GRADE1, PortPinInitialMode=PORT_PIN_MODE_GPIO, PortPinInputCharacteristic=PORT_PIN_IN_PULL_UP, PortPinLevelValue=PORT_PIN_LEVEL_LOW, PortPinMode=PORT_PIN_MODE_ALL, PortPinModeChangeable=false, PortPinPadLevel=PORT_PDR_CMOS_AUTOMOTIVE_LEVEL:
            PortPin_0: PortPinId=320, PortPinSymbolicName=PORT_20_PIN_0
            PortPin_1: PortPinId=322, PortPinSymbolicName=PORT_20_PIN_2
            PortPin_10: PortPinId=333, PortPinSymbolicName=PORT_20_PIN_13
            PortPin_11: PortPinId=334, PortPinSymbolicName=PORT_20_PIN_14
            PortPin_2: PortPinId=323, PortPinSymbolicName=PORT_20_PIN_3
            PortPin_3: PortPinId=326, PortPinSymbolicName=PORT_20_PIN_6
            PortPin_4: PortPinId=327, PortPinSymbolicName=PORT_20_PIN_7
            PortPin_5: PortPinId=328, PortPinSymbolicName=PORT_20_PIN_8
            PortPin_6: PortPinId=329, PortPinSymbolicName=PORT_20_PIN_9
            PortPin_7: PortPinId=330, PortPinSymbolicName=PORT_20_PIN_10
            PortPin_8: PortPinId=331, PortPinSymbolicName=PORT_20_PIN_11
            PortPin_9: PortPinId=332, PortPinSymbolicName=PORT_20_PIN_12
        PortContainer_8: PortNumber=21, PortNumberOfPortPins=6
          6 x PortPin, all with PortPinAnalogInput=DISABLE, PortPinControllerSelect=DISABLE, PortPinDirection=PORT_PIN_IN, PortPinDirectionChangeable=false, PortPinDriverStrength=PORT_CMOS_SPEED_GRADE1, PortPinInitialMode=PORT_PIN_MODE_GPIO, PortPinInputCharacteristic=PORT_PIN_IN_PULL_UP, PortPinLevelValue=PORT_PIN_LEVEL_LOW, PortPinMode=PORT_PIN_MODE_ALL, PortPinModeChangeable=false, PortPinPadLevel=PORT_PDR_CMOS_AUTOMOTIVE_LEVEL:
            PortPin_0: PortPinId=338, PortPinSymbolicName=PORT_21_PIN_2
            PortPin_1: PortPinId=339, PortPinSymbolicName=PORT_21_PIN_3
            PortPin_2: PortPinId=340, PortPinSymbolicName=PORT_21_PIN_4
            PortPin_3: PortPinId=341, PortPinSymbolicName=PORT_21_PIN_5
            PortPin_4: PortPinId=342, PortPinSymbolicName=PORT_21_PIN_6
            PortPin_5: PortPinId=343, PortPinSymbolicName=PORT_21_PIN_7
        PortContainer_9: PortNumber=22, PortNumberOfPortPins=5
          5 x PortPin, all with PortPinAnalogInput=DISABLE, PortPinControllerSelect=DISABLE, PortPinDirection=PORT_PIN_IN, PortPinDirectionChangeable=false, PortPinDriverStrength=PORT_CMOS_SPEED_GRADE1, PortPinInitialMode=PORT_PIN_MODE_GPIO, PortPinInputCharacteristic=PORT_PIN_IN_PULL_UP, PortPinLevelValue=PORT_PIN_LEVEL_LOW, PortPinMode=PORT_PIN_MODE_ALL, PortPinModeChangeable=false, PortPinPadLevel=PORT_PDR_CMOS_AUTOMOTIVE_LEVEL:
            PortPin_0: PortPinId=352, PortPinSymbolicName=PORT_22_PIN_0
            PortPin_1: PortPinId=353, PortPinSymbolicName=PORT_22_PIN_1
            PortPin_2: PortPinId=354, PortPinSymbolicName=PORT_22_PIN_2
            PortPin_3: PortPinId=355, PortPinSymbolicName=PORT_22_PIN_3
            PortPin_4: PortPinId=356, PortPinSymbolicName=PORT_22_PIN_4
    PortGeneral:
      PortDevErrorDetect = false
      PortPBFixedAddress = false
      PortRunningInUser0Mode = false
      PortSetPinDirectionApi = false
      PortSetPinModeApi = false
      PortUserModeInitApiEnable = false
      PortUserModeRuntimeApiEnable = false
      PortVersionInfoApi = false
    PortSafety: PortInitCheckApi=false, PortSafetyEnable=false
