AUTOSAR XML (schema 4-0-3)
package /AURIX/Mcu_ib_bswmd/BswModuleDescriptions
  bsw module description Mcu
    bsw internal behavior McuBehavior
